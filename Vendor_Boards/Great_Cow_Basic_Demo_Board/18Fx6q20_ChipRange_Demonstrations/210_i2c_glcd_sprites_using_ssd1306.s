;'Program compiled by GCBASIC (2024.2.16 (Windows 64 bit) : Build 1337) for Microchip PIC-AS using FreeBASIC 1.07.1/2024-02-15 CRC247
;'  See the GCBASIC forums at http://sourceforge.net/projects/gcbasic/forums,
;'  Check the documentation and Help at http://gcbasic.sourceforge.net/help/,
;'or, email:
;'   evanvennn at users dot sourceforge dot net

;'********************************************************************************


;'Set up the assembler options (Chip type, clock source, other bits and pieces)
;'PROCESSOR   18F16Q20
 PAGEWIDTH   180
 RADIX       DEC
 TITLE       "D:\GreatCowBASICGits\Demonstration_Sources.git\Vendor_Boards\Great_Cow_Basic_Demo_Board\18Fx6q20_ChipRange_Demonstrations\210_i2c_glcd_sprites_using_ssd1306.s"
 SUBTITLE    "02-17-2024"

;' Reverse lookup file(s)
;' C:\Program Files\Microchip\xc8\v2.46\pic\include\proc\pic18f16q20.inc
;' C:\Program Files\Microchip\xc8\v2.46\pic\dat\cfgmap\18f16q20.cfgmap
;' Alternative CONFIG file is to be found at C:\Program Files\Microchip\xc8\vX.YY\pic\dat\cfgdata as per Microchip support ticket #00730936 

;'********************************************************************************
;'Explicit PIC-AS constants to resolve the crazyness of the PIC-AS syntax
;'These are therefore the same as MPASM
#define BANKED b
#define ACCESS a
#define UPPER low highword

;'********************************************************************************
;'Explicit CONFIG
 CONFIG CPD=OFF                                  ;C1 Reverselookup  CPD = OFF
 CONFIG CP=OFF                                   ;C1 Reverselookup  CP = OFF
 CONFIG WRTSAF=OFF                               ;C1 Reverselookup  WRTSAF = OFF
 CONFIG WRTD=OFF                                 ;C1 Reverselookup  WRTD = OFF
 CONFIG WRTB=OFF                                 ;C1 Reverselookup  WRTB = OFF
 CONFIG VDDIO3MD=STANDARD_RANGE                  ;C1 Reverselookup  VDDIO3MD = STANDARD_RANGE
 CONFIG VDDIO2MD=STANDARD_RANGE                  ;C1 Reverselookup  VDDIO2MD = STANDARD_RANGE
 CONFIG WDTE=OFF                                 ;C1 Reverselookup  WDTE = OFF
 CONFIG XINST=OFF                                ;C1 Reverselookup  XINST = OFF
 CONFIG LVP=OFF                                  ;C1 Reverselookup  LVP = OFF
 CONFIG MVECEN=OFF                               ;C1 Reverselookup  MVECEN = OFF
 CONFIG MCLRE=INTMCLR                            ;C1 Reverselookup  MCLRE = INTMCLR
 CONFIG FCMEN=ON                                 ;C1 Reverselookup  FCMEN = ON
 CONFIG CLKOUTEN=OFF                             ;C1 Reverselookup  CLKOUTEN = OFF
 CONFIG RSTOSC=HFINTOSC_1MHZ                     ;C1 Reverselookup  RSTOSC = HFINTOSC_1MHZ
 CONFIG FEXTOSC=OFF                              ;C1 Reverselookup  FEXTOSC = OFF
;'Inferred CONFIG
 CONFIG BBEN=OFF                                 ;C1 Reverselookup BBEN=OFF
 CONFIG BBSIZE=BBSIZE_128                        ;C1 Reverselookup BBSIZE=BBSIZE_128
 CONFIG BOREN=OFF                                ;C1 Reverselookup BOREN=OFF
 CONFIG BORV=VBOR_2P85                           ;C1 Reverselookup BORV=VBOR_2P85
 CONFIG CSWEN=ON                                 ;C1 Reverselookup CSWEN=ON
 CONFIG DEBUG=OFF                                ;C1 Reverselookup DEBUG=OFF
 CONFIG FCMENP=OFF                               ;C1 Reverselookup FCMENP=OFF
 CONFIG FCMENS=OFF                               ;C1 Reverselookup FCMENS=OFF
 CONFIG IVT1WAY=OFF                              ;C1 Reverselookup IVT1WAY=OFF
 CONFIG LPBOREN=OFF                              ;C1 Reverselookup LPBOREN=OFF
 CONFIG PPS1WAY=OFF                              ;C1 Reverselookup PPS1WAY=OFF
 CONFIG PR1WAY=OFF                               ;C1 Reverselookup PR1WAY=OFF
 CONFIG PWRTS=PWRT_OFF                           ;C1 Reverselookup PWRTS=PWRT_OFF
 CONFIG STVREN=OFF                               ;C1 Reverselookup STVREN=OFF
 CONFIG WDTCCS=LFINTOSC                          ;C1 Reverselookup WDTCCS=LFINTOSC
 CONFIG WDTCPS=WDTCPS_0                          ;C1 Reverselookup WDTCPS=WDTCPS_0
 CONFIG WDTCWS=WDTCWS_0                          ;C1 Reverselookup WDTCWS=WDTCWS_0
 CONFIG WRTAPP=OFF                               ;C1 Reverselookup WRTAPP=OFF
 CONFIG WRTC=OFF                                 ;C1 Reverselookup WRTC=OFF


;'********************************************************************************
;' The XC8 xc.inc include file.  This MUST be placed after the CONFIG statements.

 #include <xc.inc>

;'********************************************************************************

;'Set aside RAM memory locations for variables. All variables are global.
GLOBAL	CHARCODE
 CHARCODE                         EQU 1291          ; 0X50B
GLOBAL	CHARCOL
 CHARCOL                          EQU 1292          ; 0X50C
GLOBAL	CHARCOLS
 CHARCOLS                         EQU 1294          ; 0X50E
GLOBAL	CHARCOL_H
 CHARCOL_H                        EQU 1293          ; 0X50D
GLOBAL	CHARLOCX
 CHARLOCX                         EQU 1295          ; 0X50F
GLOBAL	CHARLOCX_H
 CHARLOCX_H                       EQU 1296          ; 0X510
GLOBAL	CHARLOCY
 CHARLOCY                         EQU 1297          ; 0X511
GLOBAL	CHARLOCY_H
 CHARLOCY_H                       EQU 1298          ; 0X512
GLOBAL	CHARROW
 CHARROW                          EQU 1299          ; 0X513
GLOBAL	CHARROWS
 CHARROWS                         EQU 1301          ; 0X515
GLOBAL	CHARROW_H
 CHARROW_H                        EQU 1300          ; 0X514
GLOBAL	COL
 COL                              EQU 1302          ; 0X516
GLOBAL	CURRCHARCOL
 CURRCHARCOL                      EQU 1303          ; 0X517
GLOBAL	CURRCHARROW
 CURRCHARROW                      EQU 1304          ; 0X518
GLOBAL	CURRCHARVAL
 CURRCHARVAL                      EQU 1305          ; 0X519
GLOBAL	CURX
 CURX                             EQU 1306          ; 0X51A
GLOBAL	CURY
 CURY                             EQU 1307          ; 0X51B
GLOBAL	DELAYTEMP
 DELAYTEMP                        EQU 1280          ; 0X500
GLOBAL	DELAYTEMP2
 DELAYTEMP2                       EQU 1281          ; 0X501
GLOBAL	DIRX
 DIRX                             EQU 1308          ; 0X51C
GLOBAL	DIRY
 DIRY                             EQU 1309          ; 0X51D
GLOBAL	DRAWLINE
 DRAWLINE                         EQU 1310          ; 0X51E
GLOBAL	DRAWLINE_H
 DRAWLINE_H                       EQU 1311          ; 0X51F
GLOBAL	GLCDBACKGROUND
 GLCDBACKGROUND                   EQU 1312          ; 0X520
GLOBAL	GLCDBACKGROUND_H
 GLCDBACKGROUND_H                 EQU 1313          ; 0X521
GLOBAL	GLCDBITNO
 GLCDBITNO                        EQU 1314          ; 0X522
GLOBAL	GLCDCHANGE
 GLCDCHANGE                       EQU 1315          ; 0X523
GLOBAL	GLCDCOLOUR
 GLCDCOLOUR                       EQU 1316          ; 0X524
GLOBAL	GLCDCOLOUR_H
 GLCDCOLOUR_H                     EQU 1317          ; 0X525
GLOBAL	GLCDDATATEMP
 GLCDDATATEMP                     EQU 1318          ; 0X526
GLOBAL	GLCDFNTDEFAULT
 GLCDFNTDEFAULT                   EQU 1319          ; 0X527
GLOBAL	GLCDFNTDEFAULTHEIGHT
 GLCDFNTDEFAULTHEIGHT             EQU 1320          ; 0X528
GLOBAL	GLCDFNTDEFAULTSIZE
 GLCDFNTDEFAULTSIZE               EQU 1321          ; 0X529
GLOBAL	GLCDFONTWIDTH
 GLCDFONTWIDTH                    EQU 1322          ; 0X52A
GLOBAL	GLCDFOREGROUND
 GLCDFOREGROUND                   EQU 1323          ; 0X52B
GLOBAL	GLCDFOREGROUND_H
 GLCDFOREGROUND_H                 EQU 1324          ; 0X52C
GLOBAL	GLCDHICHANGE
 GLCDHICHANGE                     EQU 1325          ; 0X52D
GLOBAL	GLCDLOCHANGE
 GLCDLOCHANGE                     EQU 1326          ; 0X52E
GLOBAL	GLCDPRINTLEN
 GLCDPRINTLEN                     EQU 1327          ; 0X52F
GLOBAL	GLCDPRINTLOC
 GLCDPRINTLOC                     EQU 1328          ; 0X530
GLOBAL	GLCDPRINTLOC_H
 GLCDPRINTLOC_H                   EQU 1329          ; 0X531
GLOBAL	GLCDPRINT_STRING_COUNTER
 GLCDPRINT_STRING_COUNTER         EQU 1330          ; 0X532
GLOBAL	GLCDROTATEBITS
 GLCDROTATEBITS                   EQU 1331          ; 0X533
GLOBAL	GLCDTEMP
 GLCDTEMP                         EQU 1332          ; 0X534
GLOBAL	GLCDTEMP_H
 GLCDTEMP_H                       EQU 1333          ; 0X535
GLOBAL	GLCDX
 GLCDX                            EQU 1334          ; 0X536
GLOBAL	GLCDY
 GLCDY                            EQU 1335          ; 0X537
GLOBAL	GLCD_YORDINATE
 GLCD_YORDINATE                   EQU 1336          ; 0X538
GLOBAL	GLCD_YORDINATE_H
 GLCD_YORDINATE_H                 EQU 1337          ; 0X539
GLOBAL	HI2C1LASTERROR
 HI2C1LASTERROR                   EQU 1338          ; 0X53A
GLOBAL	HI2C1STATEMACHINE
 HI2C1STATEMACHINE                EQU 1339          ; 0X53B
GLOBAL	HI2CACKPOLLSTATE
 HI2CACKPOLLSTATE                 EQU 1340          ; 0X53C
GLOBAL	HI2CCURRENTMODE
 HI2CCURRENTMODE                  EQU 1341          ; 0X53D
GLOBAL	HI2CWAITMSSPTIMEOUT
 HI2CWAITMSSPTIMEOUT              EQU 1342          ; 0X53E
GLOBAL	I2CBYTE
 I2CBYTE                          EQU 1343          ; 0X53F
GLOBAL	LINECOLOUR
 LINECOLOUR                       EQU 1344          ; 0X540
GLOBAL	LINECOLOUR_H
 LINECOLOUR_H                     EQU 1345          ; 0X541
GLOBAL	LINEX1
 LINEX1                           EQU 1346          ; 0X542
GLOBAL	LINEX1_H
 LINEX1_H                         EQU 1347          ; 0X543
GLOBAL	LINEX2
 LINEX2                           EQU 1348          ; 0X544
GLOBAL	LINEX2_H
 LINEX2_H                         EQU 1349          ; 0X545
GLOBAL	LINEY1
 LINEY1                           EQU 1350          ; 0X546
GLOBAL	LINEY1_H
 LINEY1_H                         EQU 1351          ; 0X547
GLOBAL	LINEY2
 LINEY2                           EQU 1352          ; 0X548
GLOBAL	LINEY2_H
 LINEY2_H                         EQU 1353          ; 0X549
GLOBAL	LOCX
 LOCX                             EQU 1354          ; 0X54A
GLOBAL	LOCY
 LOCY                             EQU 1355          ; 0X54B
GLOBAL	OLDX
 OLDX                             EQU 1356          ; 0X54C
GLOBAL	OLDY
 OLDY                             EQU 1357          ; 0X54D
GLOBAL	POSCHARX
 POSCHARX                         EQU 1358          ; 0X54E
GLOBAL	POSCHARX_H
 POSCHARX_H                       EQU 1359          ; 0X54F
GLOBAL	POSCHARY
 POSCHARY                         EQU 1360          ; 0X550
GLOBAL	PRINTLOCX
 PRINTLOCX                        EQU 1361          ; 0X551
GLOBAL	PRINTLOCX_H
 PRINTLOCX_H                      EQU 1362          ; 0X552
GLOBAL	PRINTLOCY
 PRINTLOCY                        EQU 1363          ; 0X553
GLOBAL	PRINTLOCY_H
 PRINTLOCY_H                      EQU 1364          ; 0X554
GLOBAL	RANDOM
 RANDOM                           EQU 1365          ; 0X555
GLOBAL	RANDOMSEED
 RANDOMSEED                       EQU 1366          ; 0X556
GLOBAL	RANDOMSEED_H
 RANDOMSEED_H                     EQU 1367          ; 0X557
GLOBAL	RANDOMTEMP
 RANDOMTEMP                       EQU 1368          ; 0X558
GLOBAL	RANDOMTEMP_H
 RANDOMTEMP_H                     EQU 1369          ; 0X559
GLOBAL	ROW
 ROW                              EQU 1370          ; 0X55A
GLOBAL	SSD1306SENDBYTE
 SSD1306SENDBYTE                  EQU 1371          ; 0X55B
GLOBAL	SSD1306_BUFFERALIAS
 SSD1306_BUFFERALIAS              EQU 4351          ; 0X10FF
GLOBAL	SSD1306_BUFFERLOCATIONCALC
 SSD1306_BUFFERLOCATIONCALC       EQU 1372          ; 0X55C
GLOBAL	SSD1306_BUFFERLOCATIONCALC_H
 SSD1306_BUFFERLOCATIONCALC_H     EQU 1373          ; 0X55D
GLOBAL	SSD1306_PAGE
 SSD1306_PAGE                     EQU 1374          ; 0X55E
GLOBAL	STRINGPOINTER
 STRINGPOINTER                    EQU 1375          ; 0X55F
GLOBAL	SWAP4
 SWAP4                            EQU 1376          ; 0X560
GLOBAL	SWAP4IN
 SWAP4IN                          EQU 1377          ; 0X561
GLOBAL	SYSBYTETEMPA
 SYSBYTETEMPA                     EQU 1285          ; 0X505
GLOBAL	SYSBYTETEMPB
 SYSBYTETEMPB                     EQU 1289          ; 0X509
GLOBAL	SYSBYTETEMPX
 SYSBYTETEMPX                     EQU 1280          ; 0X500
GLOBAL	SYSCALCTEMPA
 SYSCALCTEMPA                     EQU 1285          ; 0X505
GLOBAL	SYSDIVLOOP
 SYSDIVLOOP                       EQU 1284          ; 0X504
GLOBAL	SYSFORLOOPABSVALUE8
 SYSFORLOOPABSVALUE8              EQU 1378          ; 0X562
GLOBAL	SYSFORLOOPABSVALUE8_H
 SYSFORLOOPABSVALUE8_H            EQU 1379          ; 0X563
GLOBAL	SYSFORLOOPSTEP7
 SYSFORLOOPSTEP7                  EQU 1380          ; 0X564
GLOBAL	SYSFORLOOPSTEP7_H
 SYSFORLOOPSTEP7_H                EQU 1381          ; 0X565
GLOBAL	SYSLCDPRINTDATAHANDLER
 SYSLCDPRINTDATAHANDLER           EQU 1382          ; 0X566
GLOBAL	SYSLCDPRINTDATAHANDLER_H
 SYSLCDPRINTDATAHANDLER_H         EQU 1383          ; 0X567
GLOBAL	SYSREPEATTEMP1
 SYSREPEATTEMP1                   EQU 1384          ; 0X568
GLOBAL	SYSREPEATTEMP5
 SYSREPEATTEMP5                   EQU 1385          ; 0X569
GLOBAL	SYSREPEATTEMP6
 SYSREPEATTEMP6                   EQU 1386          ; 0X56A
GLOBAL	SYSREPEATTEMP9
 SYSREPEATTEMP9                   EQU 1387          ; 0X56B
GLOBAL	SYSSTRINGA
 SYSSTRINGA                       EQU 1287          ; 0X507
GLOBAL	SYSSTRINGA_H
 SYSSTRINGA_H                     EQU 1288          ; 0X508
GLOBAL	SYSSTRINGLENGTH
 SYSSTRINGLENGTH                  EQU 1286          ; 0X506
GLOBAL	SYSSTRINGPARAM1
 SYSSTRINGPARAM1                  EQU 4333          ; 0X10ED
GLOBAL	SYSTEMP1
 SYSTEMP1                         EQU 1388          ; 0X56C
GLOBAL	SYSTEMP1_H
 SYSTEMP1_H                       EQU 1389          ; 0X56D
GLOBAL	SYSTEMP2
 SYSTEMP2                         EQU 1390          ; 0X56E
GLOBAL	SYSTEMP2_H
 SYSTEMP2_H                       EQU 1391          ; 0X56F
GLOBAL	SYSTEMP3
 SYSTEMP3                         EQU 1392          ; 0X570
GLOBAL	SYSWAITTEMPMS
 SYSWAITTEMPMS                    EQU 1282          ; 0X502
GLOBAL	SYSWAITTEMPMS_H
 SYSWAITTEMPMS_H                  EQU 1283          ; 0X503
GLOBAL	SYSWAITTEMPS
 SYSWAITTEMPS                     EQU 1284          ; 0X504
GLOBAL	SYSWAITTEMPUS
 SYSWAITTEMPUS                    EQU 1285          ; 0X505
GLOBAL	SYSWAITTEMPUS_H
 SYSWAITTEMPUS_H                  EQU 1286          ; 0X506
GLOBAL	SYSWORDTEMPA
 SYSWORDTEMPA                     EQU 1285          ; 0X505
GLOBAL	SYSWORDTEMPA_H
 SYSWORDTEMPA_H                   EQU 1286          ; 0X506
GLOBAL	SYSWORDTEMPB
 SYSWORDTEMPB                     EQU 1289          ; 0X509
GLOBAL	SYSWORDTEMPB_H
 SYSWORDTEMPB_H                   EQU 1290          ; 0X50A

;'********************************************************************************

;'ALIAS VARIABLES
GLOBAL	AFSR0
 AFSR0                            EQU 1257
GLOBAL	AFSR0_H
 AFSR0_H                          EQU 1258

;'********************************************************************************

 PSECT   RESETVEC,delta=1, abs
 RESETVEC:
;'VECTORS
	ORG	0
	GOTO	BASPROGRAMSTART
	ORG	8
	RETFIE

;'********************************************************************************

;'PROGRAM_MEMORY_PAGE: 0
	ORG	12
GLOBAL	BASPROGRAMSTART
BASPROGRAMSTART:
;'CALL INITIALISATION ROUTINES
	CALL	INITSYS
	CALL	INITPPS
	CALL	HI2CINIT
	CALL	INITRANDOM
	CALL	INITGLCD_SSD1306

;'START_OF_THE_MAIN_PROGRAM
;''
;''THIS DEMONSTRATION PROGRAM IS A SIMPLE GLCD DEMONSTRATION OF THE SSD1306 GLCD CAPABILITIES.
;''
;''THIS PROGRAM SHOWS HOW TO DRAW SPRITES ON AN SSD1306 I2C DEVICE.
;''ONLY SUPPORT I2C AND FULL GLCD MODE - SUPPORTED FROM V1.XX ONWARDS
;''
;''THE #DEFINE 'SPRITECHOICE' DEFINES THE SPRITE TO BE MANAGED.
;''YOU CAN DEFINE YOUR OWN IN THE SPRITE TABLES. EACH TABLE IS 8 PIXLES VERTICAL - COL1 TO COL8 IN EACH TABLE.
;''
;''
;''************************************************************************
;''AUTHOR  EVANV
;''LICENCE GPL
;''VERSION 1.00
;''DATE    31.11.2022
;'----- CONFIGURATION
;'CHIP SETTINGS.
;'PIC PPS TOOL VERSION: 0.0.6.5
;'ADD THIS CODE SEGMENT TO YOUR GCBASIC SOURCE PROGRAM
;'
;'HARDWARE
;'-------------------PORTA----------------
;'BIT#:  -7---6---5---4---3---2---1---0---
;'IO:    -----------------SW---------ADC--
;'-----------------------------------------
;'
;'
;'-------------------PORTB----------------
;'BIT#:  -7---6---5---4---3---2---1---0---
;'IO:    TX--SCL-SDA----------------------
;'----------------------------------------
;'
;'------------------PORTC-----------------
;'BIT#:  -7---6---5---4---3---2---1---0---
;'IO:    LED-LED-LED-LED------------------
;'----------------------------------------
;'
;'DEFINE CONSTANTS TO MAKE THINGS EASIER. WE CAN REUSE THESE AT ANY TIME.
;'SET THE PORTS AS AN OUTPUT
;'DIR LEDD7 OUT
	BCF	TRISC,7,ACCESS
;'DIR LEDD6 OUT
	BCF	TRISC,6,ACCESS
;'DIR LEDD5 OUT
	BCF	TRISC,5,ACCESS
;'DIR LEDD4 OUT
	BCF	TRISC,4,ACCESS
;'THIS IS THE PORTA.0 PORT
;'DIR POTENTIOMETER IN
	BSF	TRISA,0,ACCESS
;'DIR     SWITCHIN      IN
	BSF	TRISA,3,ACCESS
;'DEFINE I2C SETTINGS
;'HI2CMODE (MASTER)
	MOVLW	12
	MOVWF	HI2CCURRENTMODE,ACCESS
	CALL	HI2CMODE
;'THESE CONSTANTS ALLOW YOU TO CHANGE THE GLCD MEMORY USAGE.
;'*****************************************************************************************************
;'MAIN PROGRAM COMMENCES HERE.. EVERYTHING BEFORE THIS IS SETUP FOR THE BOARD.
;'SELECT THE SPRITE AND THE USER DELAY
;'2MS IS THE LOWER LIMIT OF USER VISUAL PERCEPTION
;'*******************************************************************************************
;'DRAW INITIAL SCREEN
;'BOX 0,0,127,63
	CLRF	LINEX1,ACCESS
	CLRF	LINEX1_H,ACCESS
	CLRF	LINEY1,ACCESS
	CLRF	LINEY1_H,ACCESS
	MOVLW	127
	MOVWF	LINEX2,ACCESS
	CLRF	LINEX2_H,ACCESS
	MOVLW	63
	MOVWF	LINEY2,ACCESS
	CLRF	LINEY2_H,ACCESS
	MOVFF	GLCDFOREGROUND,LINECOLOUR
	MOVFF	GLCDFOREGROUND_H,LINECOLOUR_H
	RCALL	BOX19
;'GLCDPRINT ( 2, 36, "GCBASIC")
	MOVLW	2
	MOVWF	PRINTLOCX,ACCESS
	CLRF	PRINTLOCX_H,ACCESS
	MOVLW	36
	MOVWF	PRINTLOCY,ACCESS
	CLRF	PRINTLOCY_H,ACCESS
	LFSR	1,SYSSTRINGPARAM1
	MOVLW	LOW STRINGTABLE1
	MOVWF	TBLPTR,ACCESS
	MOVLW	HIGH STRINGTABLE1
	MOVWF	TBLPTRH,ACCESS
	MOVLW	UPPER STRINGTABLE1
	MOVWF	TBLPTRU,ACCESS
	CALL	SYSREADSTRING
	MOVLW	LOW SYSSTRINGPARAM1
	BANKSEL	SYSLCDPRINTDATAHANDLER
	MOVWF	SYSLCDPRINTDATAHANDLER,BANKED
	MOVLW	HIGH SYSSTRINGPARAM1
	MOVWF	SYSLCDPRINTDATAHANDLER_H,BANKED
;'USING SYSSTRINGPARAM1*7
	BANKSEL	0
	CALL	GLCDPRINT7
;'GLCDPRINT ( 2, 46, "GLCD LIBRARY 2024")
	MOVLW	2
	MOVWF	PRINTLOCX,ACCESS
	CLRF	PRINTLOCX_H,ACCESS
	MOVLW	46
	MOVWF	PRINTLOCY,ACCESS
	CLRF	PRINTLOCY_H,ACCESS
	LFSR	1,SYSSTRINGPARAM1
	MOVLW	LOW STRINGTABLE2
	MOVWF	TBLPTR,ACCESS
	MOVLW	HIGH STRINGTABLE2
	MOVWF	TBLPTRH,ACCESS
	MOVLW	UPPER STRINGTABLE2
	MOVWF	TBLPTRU,ACCESS
	CALL	SYSREADSTRING
	MOVLW	LOW SYSSTRINGPARAM1
	BANKSEL	SYSLCDPRINTDATAHANDLER
	MOVWF	SYSLCDPRINTDATAHANDLER,BANKED
	MOVLW	HIGH SYSSTRINGPARAM1
	MOVWF	SYSLCDPRINTDATAHANDLER_H,BANKED
;'USING SYSSTRINGPARAM1*17
	BANKSEL	0
	CALL	GLCDPRINT7
;'GLCDPRINT ( 2, 54, "SPRITE SUPPORT")
	MOVLW	2
	MOVWF	PRINTLOCX,ACCESS
	CLRF	PRINTLOCX_H,ACCESS
	MOVLW	54
	MOVWF	PRINTLOCY,ACCESS
	CLRF	PRINTLOCY_H,ACCESS
	LFSR	1,SYSSTRINGPARAM1
	MOVLW	LOW STRINGTABLE3
	MOVWF	TBLPTR,ACCESS
	MOVLW	HIGH STRINGTABLE3
	MOVWF	TBLPTRH,ACCESS
	MOVLW	UPPER STRINGTABLE3
	MOVWF	TBLPTRU,ACCESS
	CALL	SYSREADSTRING
	MOVLW	LOW SYSSTRINGPARAM1
	BANKSEL	SYSLCDPRINTDATAHANDLER
	MOVWF	SYSLCDPRINTDATAHANDLER,BANKED
	MOVLW	HIGH SYSSTRINGPARAM1
	MOVWF	SYSLCDPRINTDATAHANDLER_H,BANKED
;'USING SYSSTRINGPARAM1*14
	BANKSEL	0
	CALL	GLCDPRINT7
;'WAIT 3 S
	MOVLW	3
	MOVWF	SYSWAITTEMPS,ACCESS
	RCALL	DELAY_S
;'GLCDCLS
	RCALL	GLCDCLS_SSD1306
;'BOX 0,0,127,63
	CLRF	LINEX1,ACCESS
	CLRF	LINEX1_H,ACCESS
	CLRF	LINEY1,ACCESS
	CLRF	LINEY1_H,ACCESS
	MOVLW	127
	MOVWF	LINEX2,ACCESS
	CLRF	LINEX2_H,ACCESS
	MOVLW	63
	MOVWF	LINEY2,ACCESS
	CLRF	LINEY2_H,ACCESS
	MOVFF	GLCDFOREGROUND,LINECOLOUR
	MOVFF	GLCDFOREGROUND_H,LINECOLOUR_H
	RCALL	BOX19
;'DIMENSION AND INITIALISE VARIABLES
;'DIM OLDX, OLDY AS BYTE
;'DIM CURX, CURY AS BYTE
;'DIM DIRX, DIRY AS BYTE
;'CURX = 63
	MOVLW	63
	MOVWF	CURX,ACCESS
;'CURY = 31
	MOVLW	31
	MOVWF	CURY,ACCESS
;'OLDX = CURX
	MOVFF	CURX,OLDX
;'OLDY = CURY
	MOVFF	CURY,OLDY
;'DRAW INITIAL SPRITE
;'GLCDDRAWSPRITE_SSD1306 CURX,CURY, SPRITECHOICE, GLCDFOREGROUND
	MOVFF	CURX,GLCDX
	MOVFF	CURY,GLCDY
	MOVLW	2
	MOVWF	CHARCODE,ACCESS
	CALL	GLCDDRAWSPRITE_SSD1306
;'SET INITIAL DIRECTION
;'IF RANDOM > 127 THEN
	CALL	FN_RANDOM
	MOVF	RANDOM,W,ACCESS
	SUBLW	127
	BTFSC	STATUS,0,ACCESS
	BRA	ELSE1_1
;'DIRX=1
	MOVLW	1
	MOVWF	DIRX,ACCESS
;'ELSE
	BRA	ENDIF1
GLOBAL	ELSE1_1
ELSE1_1:
;'DIRX=255
	SETF	DIRX,ACCESS
;'END IF
GLOBAL	ENDIF1
ENDIF1:
;'IF RANDOM > 127 THEN
	CALL	FN_RANDOM
	MOVF	RANDOM,W,ACCESS
	SUBLW	127
	BTFSC	STATUS,0,ACCESS
	BRA	ELSE2_1
;'DIRY=1
	MOVLW	1
	MOVWF	DIRY,ACCESS
;'ELSE
	BRA	ENDIF2
GLOBAL	ELSE2_1
ELSE2_1:
;'DIRY=255
	SETF	DIRY,ACCESS
;'END IF
GLOBAL	ENDIF2
ENDIF2:
;'DO
GLOBAL	SYSDOLOOP_S1
SYSDOLOOP_S1:
;'HANDLE BOUNCE
;'IF  CURX>0 AND CURX<119  THEN
	MOVFF	CURX,SYSBYTETEMPB
	CLRF	SYSBYTETEMPA,ACCESS
	CALL	SYSCOMPLESSTHAN
	MOVFF	SYSBYTETEMPX,SYSTEMP1
	MOVFF	CURX,SYSBYTETEMPA
	MOVLW	119
	MOVWF	SYSBYTETEMPB,ACCESS
	CALL	SYSCOMPLESSTHAN
	BANKSEL	SYSTEMP1
	MOVF	SYSTEMP1,W,BANKED
	ANDWF	SYSBYTETEMPX,W,ACCESS
	MOVWF	SYSTEMP2,BANKED
	BTFSS	SYSTEMP2,0,BANKED
	BRA	ELSE3_1
;'OLDX = CURX
	MOVFF	CURX,OLDX
;'CURX=CURX+DIRX
	MOVF	DIRX,W,ACCESS
	ADDWF	CURX,F,ACCESS
;'ELSE
	BRA	ENDIF3
GLOBAL	ELSE3_1
ELSE3_1:
;'IF DIRX = 1 THEN
	DECF	DIRX,W,ACCESS
	BTFSS	STATUS,2,ACCESS
	BRA	ELSE5_1
;'DIRX=255
	SETF	DIRX,ACCESS
;'ELSE
	BRA	ENDIF5
GLOBAL	ELSE5_1
ELSE5_1:
;'DIRX=1
	MOVLW	1
	MOVWF	DIRX,ACCESS
;'END IF
GLOBAL	ENDIF5
ENDIF5:
;'OLDX = CURX
	MOVFF	CURX,OLDX
;'CURX=CURX+DIRX
	MOVF	DIRX,W,ACCESS
	ADDWF	CURX,F,ACCESS
;'END IF
GLOBAL	ENDIF3
ENDIF3:
;'IF CURY >1 AND CURY<55 THEN
	MOVFF	CURY,SYSBYTETEMPB
	MOVLW	1
	MOVWF	SYSBYTETEMPA,ACCESS
	BANKSEL	0
	CALL	SYSCOMPLESSTHAN
	MOVFF	SYSBYTETEMPX,SYSTEMP1
	MOVFF	CURY,SYSBYTETEMPA
	MOVLW	55
	MOVWF	SYSBYTETEMPB,ACCESS
	CALL	SYSCOMPLESSTHAN
	BANKSEL	SYSTEMP1
	MOVF	SYSTEMP1,W,BANKED
	ANDWF	SYSBYTETEMPX,W,ACCESS
	MOVWF	SYSTEMP2,BANKED
	BTFSS	SYSTEMP2,0,BANKED
	BRA	ELSE4_1
;'OLDY = CURY
	MOVFF	CURY,OLDY
;'CURY=CURY+DIRY
	MOVF	DIRY,W,ACCESS
	ADDWF	CURY,F,ACCESS
;'ELSE
	BRA	ENDIF4
GLOBAL	ELSE4_1
ELSE4_1:
;'IF DIRY = 1 THEN
	DECF	DIRY,W,ACCESS
	BTFSS	STATUS,2,ACCESS
	BRA	ELSE6_1
;'DIRY=255
	SETF	DIRY,ACCESS
;'ELSE
	BRA	ENDIF6
GLOBAL	ELSE6_1
ELSE6_1:
;'DIRY=1
	MOVLW	1
	MOVWF	DIRY,ACCESS
;'END IF
GLOBAL	ENDIF6
ENDIF6:
;'OLDY = CURY
	MOVFF	CURY,OLDY
;'CURY=CURY+DIRY
	MOVF	DIRY,W,ACCESS
	ADDWF	CURY,F,ACCESS
;'END IF
GLOBAL	ENDIF4
ENDIF4:
;'END OF HANDLE BOUNCE
;'DRAW SPRITE
;'GLCDDRAWSPRITE_SSD1306 OLDX,OLDY, SPRITECHOICE
	MOVFF	OLDX,GLCDX
	MOVFF	OLDY,GLCDY
	MOVLW	2
	MOVWF	CHARCODE,ACCESS
	BANKSEL	0
	RCALL	GLCDDRAWSPRITE_SSD1306
;'GLCDDRAWSPRITE_SSD1306 CURX,CURY, SPRITECHOICE
	MOVFF	CURX,GLCDX
	MOVFF	CURY,GLCDY
	MOVLW	2
	MOVWF	CHARCODE,ACCESS
	RCALL	GLCDDRAWSPRITE_SSD1306
;'USER DELAY
;'SO YOU CAN SEE IT!
;'WAIT SPRITEDELAY
	MOVLW	10
	MOVWF	SYSWAITTEMPMS,ACCESS
	CLRF	SYSWAITTEMPMS_H,ACCESS
	RCALL	DELAY_MS
;'LOOP
	BRA	SYSDOLOOP_S1
GLOBAL	SYSDOLOOP_E1
SYSDOLOOP_E1:
;'END
	BRA	BASPROGRAMEND
;'SPRITE SHAPE DATA
;'SPRITE SHAPE DATA
;'SPRITE SHAPE DATA
;'SPRITE SHAPE DATA
;'SPRITE SHAPE DATA
;'SPRITE SHAPE DATA
;'SPRITE SHAPE DATA
;'SPRITE SHAPE DATA
;'ASM SHOWDEBUG  GGLCD SSD1306 BUFFER IS 1024BYTES
GLOBAL	BASPROGRAMEND
BASPROGRAMEND:
	SLEEP
	BRA	BASPROGRAMEND

;'********************************************************************************

;'OVERLOADED SIGNATURE: WORD:WORD:WORD:WORD:WORD:, SOURCE: GLCD.H (1732)
GLOBAL	BOX19
BOX19:
;'DIM GLCDTEMP AS WORD
;'MAKE SURE THAT STARTING POINT (1) IS ALWAYS LESS THAN END POINT (2)
;'IF LINEX1 > LINEX2 THEN
	MOVFF	LINEX1,SYSWORDTEMPB
	MOVFF	LINEX1_H,SYSWORDTEMPB_H
	MOVFF	LINEX2,SYSWORDTEMPA
	MOVFF	LINEX2_H,SYSWORDTEMPA_H
	CALL	SYSCOMPLESSTHAN16
	BTFSS	SYSBYTETEMPX,0,ACCESS
	BRA	ENDIF13
;'GLCDTEMP = LINEX1
	MOVFF	LINEX1,GLCDTEMP
	MOVFF	LINEX1_H,GLCDTEMP_H
;'LINEX1 = LINEX2
	MOVFF	LINEX2,LINEX1
	MOVFF	LINEX2_H,LINEX1_H
;'LINEX2 = GLCDTEMP
	MOVFF	GLCDTEMP,LINEX2
	MOVFF	GLCDTEMP_H,LINEX2_H
;'END IF
GLOBAL	ENDIF13
ENDIF13:
;'IF LINEY1 > LINEY2 THEN
	MOVFF	LINEY1,SYSWORDTEMPB
	MOVFF	LINEY1_H,SYSWORDTEMPB_H
	MOVFF	LINEY2,SYSWORDTEMPA
	MOVFF	LINEY2_H,SYSWORDTEMPA_H
	CALL	SYSCOMPLESSTHAN16
	BTFSS	SYSBYTETEMPX,0,ACCESS
	BRA	ENDIF14
;'GLCDTEMP = LINEY1
	MOVFF	LINEY1,GLCDTEMP
	MOVFF	LINEY1_H,GLCDTEMP_H
;'LINEY1 = LINEY2
	MOVFF	LINEY2,LINEY1
	MOVFF	LINEY2_H,LINEY1_H
;'LINEY2 = GLCDTEMP
	MOVFF	GLCDTEMP,LINEY2
	MOVFF	GLCDTEMP_H,LINEY2_H
;'END IF
GLOBAL	ENDIF14
ENDIF14:
;'DIM DRAWLINE AS WORD
;'DRAW LINES GOING ACROSS
;'FOR DRAWLINE = LINEX1 TO LINEX2
	MOVFF	LINEX1,DRAWLINE
	MOVFF	LINEX1_H,DRAWLINE_H
GLOBAL	SYSFORLOOP5
SYSFORLOOP5:
;'PSET DRAWLINE, LINEY1, LINECOLOUR
	MOVFF	DRAWLINE,GLCDX
	MOVFF	LINEY1,GLCDY
	MOVFF	LINECOLOUR,GLCDCOLOUR
	MOVFF	LINECOLOUR_H,GLCDCOLOUR_H
	CALL	PSET_SSD1306
;'PSET DRAWLINE, LINEY2, LINECOLOUR
	MOVFF	DRAWLINE,GLCDX
	MOVFF	LINEY2,GLCDY
	MOVFF	LINECOLOUR,GLCDCOLOUR
	MOVFF	LINECOLOUR_H,GLCDCOLOUR_H
	CALL	PSET_SSD1306
;'NEXT
;'POSITIVE VALUE STEP HANDLER IN FOR-NEXT STATEMENT :#4P 
	MOVF	DRAWLINE,W,ACCESS
	SUBWF	LINEX2,W,ACCESS
	BANKSEL	SYSTEMP2
	MOVWF	SYSTEMP2,BANKED
	MOVF	DRAWLINE_H,W,ACCESS
	SUBWFB	LINEX2_H,W,ACCESS
	MOVWF	SYSTEMP2_H,BANKED
	MOVFF	SYSTEMP2,SYSWORDTEMPA
	MOVFF	SYSTEMP2_H,SYSWORDTEMPA_H
	CLRF	SYSWORDTEMPB,ACCESS
	CLRF	SYSWORDTEMPB_H,ACCESS
	BANKSEL	0
	CALL	SYSCOMPEQUAL16
	COMF	SYSBYTETEMPX,F,ACCESS
	BTFSS	SYSBYTETEMPX,0,ACCESS
	BRA	ENDIF15
;'SET LOOPVAR TO LOOPVAR + STEPVALUE WHERE STEPVALUE IS A POSITIVE VALUE
	INCF	DRAWLINE,F,ACCESS
	BTFSC	STATUS,2,ACCESS
	INCF	DRAWLINE_H,F,ACCESS
	BRA	SYSFORLOOP5
;'END IF
GLOBAL	ENDIF15
ENDIF15:
GLOBAL	SYSFORLOOPEND5
SYSFORLOOPEND5:
;'DRAW LINES GOING DOWN
;'FOR DRAWLINE = LINEY1 TO LINEY2
	MOVFF	LINEY1,DRAWLINE
	MOVFF	LINEY1_H,DRAWLINE_H
GLOBAL	SYSFORLOOP6
SYSFORLOOP6:
;'PSET LINEX1, DRAWLINE, LINECOLOUR
	MOVFF	LINEX1,GLCDX
	MOVFF	DRAWLINE,GLCDY
	MOVFF	LINECOLOUR,GLCDCOLOUR
	MOVFF	LINECOLOUR_H,GLCDCOLOUR_H
	CALL	PSET_SSD1306
;'PSET LINEX2, DRAWLINE, LINECOLOUR
	MOVFF	LINEX2,GLCDX
	MOVFF	DRAWLINE,GLCDY
	MOVFF	LINECOLOUR,GLCDCOLOUR
	MOVFF	LINECOLOUR_H,GLCDCOLOUR_H
	CALL	PSET_SSD1306
;'NEXT
;'POSITIVE VALUE STEP HANDLER IN FOR-NEXT STATEMENT :#4P 
	MOVF	DRAWLINE,W,ACCESS
	SUBWF	LINEY2,W,ACCESS
	BANKSEL	SYSTEMP2
	MOVWF	SYSTEMP2,BANKED
	MOVF	DRAWLINE_H,W,ACCESS
	SUBWFB	LINEY2_H,W,ACCESS
	MOVWF	SYSTEMP2_H,BANKED
	MOVFF	SYSTEMP2,SYSWORDTEMPA
	MOVFF	SYSTEMP2_H,SYSWORDTEMPA_H
	CLRF	SYSWORDTEMPB,ACCESS
	CLRF	SYSWORDTEMPB_H,ACCESS
	BANKSEL	0
	CALL	SYSCOMPEQUAL16
	COMF	SYSBYTETEMPX,F,ACCESS
	BTFSS	SYSBYTETEMPX,0,ACCESS
	BRA	ENDIF16
;'SET LOOPVAR TO LOOPVAR + STEPVALUE WHERE STEPVALUE IS A POSITIVE VALUE
	INCF	DRAWLINE,F,ACCESS
	BTFSC	STATUS,2,ACCESS
	INCF	DRAWLINE_H,F,ACCESS
	BRA	SYSFORLOOP6
;'END IF
GLOBAL	ENDIF16
ENDIF16:
GLOBAL	SYSFORLOOPEND6
SYSFORLOOPEND6:
	RETURN

;'********************************************************************************

;'SOURCE: GLCD_SSD1306.H (1063)
GLOBAL	CURSOR_POSITION_SSD1306
CURSOR_POSITION_SSD1306:
;'DIM POSCHARX, POSCHARX AS WORD
;'POSCHARY = LOCY / 8
;'FASTER THAN /8
;'POSCHARY = LOCY
	MOVFF	LOCY,POSCHARY
;'REPEAT 3
	MOVLW	3
	BANKSEL	SYSREPEATTEMP9
	MOVWF	SYSREPEATTEMP9,BANKED
GLOBAL	SYSREPEATLOOP9
SYSREPEATLOOP9:
;'SET C OFF
	BCF	STATUS,0,ACCESS
;'ROTATE POSCHARY RIGHT
	RRCF	POSCHARY,F,ACCESS
;'END REPEAT
	DECFSZ	SYSREPEATTEMP9,F,BANKED
	BRA	SYSREPEATLOOP9
GLOBAL	SYSREPEATLOOPEND9
SYSREPEATLOOPEND9:
;'WRITE_COMMAND_SSD1306( 0XB0 + POSCHARY )   ' SET PAGE ADDRESS
	MOVLW	176
	ADDWF	POSCHARY,W,ACCESS
	MOVWF	SSD1306SENDBYTE,ACCESS
	BANKSEL	0
	CALL	WRITE_COMMAND_SSD1306
;'POSCHARX = ( LOCX  & 0X0F )  ' LOWER NIBBLE
	MOVLW	15
	ANDWF	LOCX,W,ACCESS
	MOVWF	POSCHARX,ACCESS
	CLRF	POSCHARX_H,ACCESS
;'WRITE_COMMAND_SSD1306( POSCHARX )
	MOVFF	POSCHARX,SSD1306SENDBYTE
	CALL	WRITE_COMMAND_SSD1306
;'POSCHARX = LOCX
	MOVFF	LOCX,POSCHARX
	CLRF	POSCHARX_H,ACCESS
;'REPEAT 4
	MOVLW	4
	BANKSEL	SYSREPEATTEMP9
	MOVWF	SYSREPEATTEMP9,BANKED
GLOBAL	SYSREPEATLOOP10
SYSREPEATLOOP10:
;'SET C OFF
	BCF	STATUS,0,ACCESS
;'ROTATE POSCHARX RIGHT
	RRCF	POSCHARX_H,F,ACCESS
	RRCF	POSCHARX,F,ACCESS
;'END REPEAT
	DECFSZ	SYSREPEATTEMP9,F,BANKED
	BRA	SYSREPEATLOOP10
GLOBAL	SYSREPEATLOOPEND10
SYSREPEATLOOPEND10:
;'POSCHARX = ( POSCHARX & 0X0F ) + 0X10
	MOVLW	15
	ANDWF	POSCHARX,W,ACCESS
	MOVWF	SYSTEMP1,BANKED
	CLRF	SYSTEMP1_H,BANKED
	MOVLW	16
	ADDWF	SYSTEMP1,W,BANKED
	MOVWF	POSCHARX,ACCESS
	MOVLW	0
	ADDWFC	SYSTEMP1_H,W,BANKED
	MOVWF	POSCHARX_H,ACCESS
;'WRITE_COMMAND_SSD1306 ( POSCHARX )
	MOVFF	POSCHARX,SSD1306SENDBYTE
	BANKSEL	0
	GOTO	WRITE_COMMAND_SSD1306

;'********************************************************************************

GLOBAL	DELAY_MS
DELAY_MS:
	INCF	SYSWAITTEMPMS_H, F,ACCESS
GLOBAL	DMS_START
DMS_START:
	MOVLW	129
	MOVWF	DELAYTEMP2,ACCESS
GLOBAL	DMS_OUTER
DMS_OUTER:
	MOVLW	40
	MOVWF	DELAYTEMP,ACCESS
GLOBAL	DMS_INNER
DMS_INNER:
	DECFSZ	DELAYTEMP, F,ACCESS
	BRA	DMS_INNER
	DECFSZ	DELAYTEMP2, F,ACCESS
	BRA	DMS_OUTER
	DECFSZ	SYSWAITTEMPMS, F,ACCESS
	BRA	DMS_START
	DECFSZ	SYSWAITTEMPMS_H, F,ACCESS
	BRA	DMS_START
	RETURN

;'********************************************************************************

GLOBAL	DELAY_S
DELAY_S:
GLOBAL	DS_START
DS_START:
	MOVLW	232
	MOVWF	SYSWAITTEMPMS,ACCESS
	MOVLW	3
	MOVWF	SYSWAITTEMPMS_H,ACCESS
	RCALL	DELAY_MS
	DECFSZ	SYSWAITTEMPS, F,ACCESS
	BRA	DS_START
	RETURN

;'********************************************************************************

GLOBAL	GLCDCHARCOL3
GLCDCHARCOL3:
	MOVLW	113
	CPFSLT	SYSSTRINGA,ACCESS
	RETLW	0
	MOVF	SYSSTRINGA, W,ACCESS
	ADDLW	LOW TABLEGLCDCHARCOL3
	MOVWF	TBLPTR,ACCESS
	MOVLW	HIGH TABLEGLCDCHARCOL3
	BTFSC	STATUS,0,ACCESS
	ADDLW	1
	MOVWF	TBLPTRH,ACCESS
	MOVLW	UPPER TABLEGLCDCHARCOL3
	BTFSC	STATUS,0,ACCESS
	ADDLW	1
	MOVWF	TBLPTRU,ACCESS
	TBLRD*
	MOVF	TABLAT, W,ACCESS
	RETURN
GLOBAL	TABLEGLCDCHARCOL3
TABLEGLCDCHARCOL3:
	DB	112,0,16,12,10,136,34,56,32,8,32,16,16,128,128,64,4,0,0,0,40,72,70,108,0,0,0,40
	DB	16,0,16,0,64,124,0,132,130,48,78,120,6,108,12,0,0,16,40,0,4,100,248,254,124,254
	DB	254,254,124,254,0,64,254,254,254,254,124,254,124,254,76,2,126,62,126,198,14,194
	DB	0,4,0,8,128,0,64,254,112,112,112,16,16,254,0,64,254,0,248,248,112,248,16,248
	DB	144,16,120,56,120,136,24,136,0,0,0,32,120
	ALIGN	2;X4

;'********************************************************************************

GLOBAL	GLCDCHARCOL4
GLCDCHARCOL4:
	MOVLW	113
	CPFSLT	SYSSTRINGA,ACCESS
	RETLW	0
	MOVF	SYSSTRINGA, W,ACCESS
	ADDLW	LOW TABLEGLCDCHARCOL4
	MOVWF	TBLPTR,ACCESS
	MOVLW	HIGH TABLEGLCDCHARCOL4
	BTFSC	STATUS,0,ACCESS
	ADDLW	1
	MOVWF	TBLPTRH,ACCESS
	MOVLW	UPPER TABLEGLCDCHARCOL4
	BTFSC	STATUS,0,ACCESS
	ADDLW	1
	MOVWF	TBLPTRU,ACCESS
	TBLRD*
	MOVF	TABLAT, W,ACCESS
	RETURN
GLOBAL	TABLEGLCDCHARCOL4
TABLEGLCDCHARCOL4:
	DB	112,254,56,10,6,204,102,124,112,4,64,16,56,136,162,112,28,0,0,14,254,84,38,146
	DB	10,56,130,16,16,160,16,192,32,162,132,194,130,40,138,148,2,146,146,108,172,40
	DB	40,130,2,146,36,146,130,130,146,18,130,16,130,128,16,128,4,8,130,18,130,18,146,2
	DB	128,64,128,40,16,162,254,8,130,4,128,2,168,144,136,136,168,252,168,16,144,128
	DB	32,130,8,16,136,40,40,16,168,124,128,64,128,80,160,200,16,0,130,16,68
	ALIGN	2;X4

;'********************************************************************************

GLOBAL	GLCDCHARCOL5
GLCDCHARCOL5:
	MOVLW	113
	CPFSLT	SYSSTRINGA,ACCESS
	RETLW	0
	MOVF	SYSSTRINGA, W,ACCESS
	ADDLW	LOW TABLEGLCDCHARCOL5
	MOVWF	TBLPTR,ACCESS
	MOVLW	HIGH TABLEGLCDCHARCOL5
	BTFSC	STATUS,0,ACCESS
	ADDLW	1
	MOVWF	TBLPTRH,ACCESS
	MOVLW	UPPER TABLEGLCDCHARCOL5
	BTFSC	STATUS,0,ACCESS
	ADDLW	1
	MOVWF	TBLPTRU,ACCESS
	TBLRD*
	MOVF	TABLAT, W,ACCESS
	RETURN
GLOBAL	TABLEGLCDCHARCOL5
TABLEGLCDCHARCOL5:
	DB	112,124,124,0,0,238,238,124,168,254,254,84,84,148,148,124,124,0,158,0,40,254,16,170
	DB	6,68,68,124,124,96,16,192,16,146,254,162,138,36,138,146,226,146,146,108,108,68
	DB	40,68,162,242,34,146,130,130,146,18,146,16,254,130,40,128,24,16,130,18,162,50
	DB	146,254,128,128,112,16,224,146,130,16,130,2,128,4,168,136,136,136,168,18,168,8
	DB	250,136,80,254,240,8,136,40,40,8,168,144,128,128,96,32,160,168,108,254,108,16
	DB	66
	ALIGN	2;X4

;'********************************************************************************

GLOBAL	GLCDCHARCOL6
GLCDCHARCOL6:
	MOVLW	113
	CPFSLT	SYSSTRINGA,ACCESS
	RETLW	0
	MOVF	SYSSTRINGA, W,ACCESS
	ADDLW	LOW TABLEGLCDCHARCOL6
	MOVWF	TBLPTR,ACCESS
	MOVLW	HIGH TABLEGLCDCHARCOL6
	BTFSC	STATUS,0,ACCESS
	ADDLW	1
	MOVWF	TBLPTRH,ACCESS
	MOVLW	UPPER TABLEGLCDCHARCOL6
	BTFSC	STATUS,0,ACCESS
	ADDLW	1
	MOVWF	TBLPTRU,ACCESS
	TBLRD*
	MOVF	TABLAT, W,ACCESS
	RETURN
GLOBAL	TABLEGLCDCHARCOL6
TABLEGLCDCHARCOL6:
	DB	112,56,254,12,10,204,102,124,32,4,64,56,16,162,136,112,28,0,0,14,254,84,200,68
	DB	0,130,56,16,16,0,16,0,8,138,128,146,150,254,138,146,18,146,82,0,0,130,40,40,18,130
	DB	36,146,130,68,146,18,146,16,130,126,68,128,4,32,130,18,66,82,146,2,128,64,128,40
	DB	16,138,130,32,254,4,128,8,168,136,136,144,168,2,168,8,128,122,136,128,8,8,136,40
	DB	48,8,168,128,64,64,128,80,160,152,130,0,16,32,68
	ALIGN	2;X4

;'********************************************************************************

GLOBAL	GLCDCHARCOL7
GLCDCHARCOL7:
	MOVLW	113
	CPFSLT	SYSSTRINGA,ACCESS
	RETLW	0
	MOVF	SYSSTRINGA, W,ACCESS
	ADDLW	LOW TABLEGLCDCHARCOL7
	MOVWF	TBLPTR,ACCESS
	MOVLW	HIGH TABLEGLCDCHARCOL7
	BTFSC	STATUS,0,ACCESS
	ADDLW	1
	MOVWF	TBLPTRH,ACCESS
	MOVLW	UPPER TABLEGLCDCHARCOL7
	BTFSC	STATUS,0,ACCESS
	ADDLW	1
	MOVWF	TBLPTRU,ACCESS
	TBLRD*
	MOVF	TABLAT, W,ACCESS
	RETURN
GLOBAL	TABLEGLCDCHARCOL7
TABLEGLCDCHARCOL7:
	DB	112,16,0,10,6,136,34,56,62,8,32,16,16,128,128,64,4,0,0,0,40,36,196,160,0,0,0,40
	DB	16,0,16,0,4,124,0,140,98,32,114,96,14,108,60,0,0,0,40,16,12,124,248,108,68,56
	DB	130,2,244,254,0,2,130,128,254,254,124,12,188,140,100,2,126,62,126,198,14,134,0,64
	DB	0,8,128,0,240,112,64,254,48,4,120,240,0,0,0,0,240,240,112,16,248,16,64,64,248,56
	DB	120,136,120,136,0,0,0,16,120
	ALIGN	2;X4

;'********************************************************************************

;'SOURCE: GLCD_SSD1306.H (442)
GLOBAL	GLCDCLS_SSD1306
GLCDCLS_SSD1306:
;'INITIALISE GLOBAL VARIABLE. REQUIRED VARIABLE FOR CIRCLE IN ALL DEVICE DRIVERS- DO NOT DELETE
;'GLCD_YORDINATE = 0
	CLRF	GLCD_YORDINATE,ACCESS
	CLRF	GLCD_YORDINATE_H,ACCESS
;'FOR SSD1306_BUFFERLOCATIONCALC = 1 TO GLCD_HEIGHT * GLCD_WIDTH / 8
	MOVLW	1
	MOVWF	SSD1306_BUFFERLOCATIONCALC,ACCESS
	CLRF	SSD1306_BUFFERLOCATIONCALC_H,ACCESS
GLOBAL	SYSFORLOOP7
SYSFORLOOP7:
;'SSD1306_BUFFERALIAS(SSD1306_BUFFERLOCATIONCALC) = 0
	LFSR	0,SSD1306_BUFFERALIAS
	MOVF	SSD1306_BUFFERLOCATIONCALC,W,ACCESS
	ADDWF	FSR0,F,ACCESS
	MOVF	SSD1306_BUFFERLOCATIONCALC_H,W,ACCESS
	ADDWFC	FSR0H,F,ACCESS
	CLRF	INDF0,ACCESS
;'NEXT
;'POSITIVE VALUE STEP HANDLER IN FOR-NEXT STATEMENT :#4P 
	MOVF	SSD1306_BUFFERLOCATIONCALC,W,ACCESS
	SUBLW	0
	BANKSEL	SYSTEMP1
	MOVWF	SYSTEMP1,BANKED
	MOVLW	4
	MOVWF	SYSTEMP2,BANKED
	MOVF	SSD1306_BUFFERLOCATIONCALC_H,W,ACCESS
	SUBWFB	SYSTEMP2,W,BANKED
	MOVWF	SYSTEMP1_H,BANKED
	MOVFF	SYSTEMP1,SYSWORDTEMPA
	MOVFF	SYSTEMP1_H,SYSWORDTEMPA_H
	CLRF	SYSWORDTEMPB,ACCESS
	CLRF	SYSWORDTEMPB_H,ACCESS
	BANKSEL	0
	CALL	SYSCOMPEQUAL16
	COMF	SYSBYTETEMPX,F,ACCESS
	BTFSS	SYSBYTETEMPX,0,ACCESS
	BRA	ENDIF34
;'SET LOOPVAR TO LOOPVAR + STEPVALUE WHERE STEPVALUE IS A POSITIVE VALUE
	INCF	SSD1306_BUFFERLOCATIONCALC,F,ACCESS
	BTFSC	STATUS,2,ACCESS
	INCF	SSD1306_BUFFERLOCATIONCALC_H,F,ACCESS
	BRA	SYSFORLOOP7
;'END IF
GLOBAL	ENDIF34
ENDIF34:
GLOBAL	SYSFORLOOPEND7
SYSFORLOOPEND7:
;'1.14 CHANGED TO TRANSACTION
;'FOR SSD1306_BUFFERLOCATIONCALC = 0 TO GLCD_HEIGHT-1 STEP 8
	CLRF	SSD1306_BUFFERLOCATIONCALC,ACCESS
	CLRF	SSD1306_BUFFERLOCATIONCALC_H,ACCESS
GLOBAL	SYSFORLOOP8
SYSFORLOOP8:
;'INIT SYSFORLOOPSTEP7 :#0
	MOVLW	8
	BANKSEL	SYSFORLOOPSTEP7
	MOVWF	SYSFORLOOPSTEP7,BANKED
	CLRF	SYSFORLOOPSTEP7_H,BANKED
;'CURSOR_POSITION_SSD1306 ( 0 , SSD1306_BUFFERLOCATIONCALC )
	CLRF	LOCX,ACCESS
	MOVFF	SSD1306_BUFFERLOCATIONCALC,LOCY
	BANKSEL	0
	RCALL	CURSOR_POSITION_SSD1306
;'OPEN_TRANSACTION_SSD1306
;'MACRO SOURCE: GLCD_SSD1306.H (1241)
;'4WIRE NOT SUPPORTED, SEE WRITE_TRANSACTION_DATA_SSD1306
;'HI2CSTART
	CALL	SI2CSTART
;'HI2CSEND GLCD_I2C_ADDRESS
	MOVLW	120
	MOVWF	I2CBYTE,ACCESS
	CALL	SI2CSEND
;'HI2CSEND 0X40
	MOVLW	64
	MOVWF	I2CBYTE,ACCESS
	CALL	SI2CSEND
;'FOR GLCDTEMP = 0 TO 127
;'LEGACY METHOD
	SETF	GLCDTEMP,ACCESS
GLOBAL	SYSFORLOOP9
SYSFORLOOP9:
	INCF	GLCDTEMP,F,ACCESS
;'WRITE_TRANSACTION_DATA_SSD1306(GLCDBACKGROUND)
;'MACRO SOURCE: GLCD_SSD1306.H (1272)
;'HI2CSEND SSD1306SENDBYTE
	MOVFF	GLCDBACKGROUND,I2CBYTE
	CALL	SI2CSEND
;'NEXT
	MOVLW	127
	SUBWF	GLCDTEMP,W,ACCESS
	BTFSS	STATUS,0,ACCESS
	BRA	SYSFORLOOP9
GLOBAL	SYSFORLOOPEND9
SYSFORLOOPEND9:
;'CLOSE_TRANSACTION_SSD1306
;'MACRO SOURCE: GLCD_SSD1306.H (1305)
;'4WIRE NOT SUPPORTED, SEE WRITE_TRANSACTION_DATA_SSD1306
;'HI2CSTOP
	CALL	SI2CSTOP
;'NEXT
;'INTEGER NEGATIVE STEP HANDLER IN FOR-NEXT STATEMENT
	BANKSEL	SYSFORLOOPSTEP7_H
	BTFSS	SYSFORLOOPSTEP7_H,7,BANKED
	BRA	ELSE36_1
;'SET SYSFORLOOPABSVALUE TO -STEPVALUE :#1 
	COMF	SYSFORLOOPSTEP7,W,BANKED
	MOVWF	SYSFORLOOPABSVALUE8,BANKED
	COMF	SYSFORLOOPSTEP7_H,W,BANKED
	MOVWF	SYSFORLOOPABSVALUE8_H,BANKED
	INCF	SYSFORLOOPABSVALUE8,F,BANKED
	BTFSC	STATUS,2,ACCESS
	INCF	SYSFORLOOPABSVALUE8_H,F,BANKED
;'IF ( SSD1306_BUFFERLOCATIONCALC - 64-1) } [WORD]SYSFORLOOPABSVALUE8 THEN  :#1N 
	MOVLW	64
	SUBWF	SSD1306_BUFFERLOCATIONCALC,W,ACCESS
	MOVWF	SYSTEMP1,BANKED
	MOVLW	0
	SUBWFB	SSD1306_BUFFERLOCATIONCALC_H,W,ACCESS
	MOVWF	SYSTEMP1_H,BANKED
	MOVLW	1
	SUBWF	SYSTEMP1,W,BANKED
	MOVWF	SYSTEMP2,BANKED
	MOVLW	0
	SUBWFB	SYSTEMP1_H,W,BANKED
	MOVWF	SYSTEMP2_H,BANKED
	MOVFF	SYSTEMP2,SYSWORDTEMPA
	MOVFF	SYSTEMP2_H,SYSWORDTEMPA_H
	MOVFF	SYSFORLOOPABSVALUE8,SYSWORDTEMPB
	MOVFF	SYSFORLOOPABSVALUE8_H,SYSWORDTEMPB_H
	BANKSEL	0
	CALL	SYSCOMPLESSTHAN16
	COMF	SYSBYTETEMPX,F,ACCESS
	BTFSS	SYSBYTETEMPX,0,ACCESS
	BRA	ENDIF37
;'SET LOOPVAR TO LOOPVAR + STEPVALUE WHERE STEPVALUE IS A NEGATIVE VALUE
	BANKSEL	SYSFORLOOPSTEP7
	MOVF	SYSFORLOOPSTEP7,W,BANKED
	ADDWF	SSD1306_BUFFERLOCATIONCALC,F,ACCESS
	MOVF	SYSFORLOOPSTEP7_H,W,BANKED
	ADDWFC	SSD1306_BUFFERLOCATIONCALC_H,F,ACCESS
	BRA	SYSFORLOOP8
;'END IF
GLOBAL	ENDIF37
ENDIF37:
	BRA	ENDIF36
GLOBAL	ELSE36_1
ELSE36_1:
;'INTEGER POSITIVE STEP HANDLER IN FOR-NEXT STATEMENT
;'IF ([WORD]64-1 - [WORD]SSD1306_BUFFERLOCATIONCALC) } [WORD]SYSFORLOOPSTEP7 THEN :#1P 
	MOVF	SSD1306_BUFFERLOCATIONCALC,W,ACCESS
	SUBLW	63
	MOVWF	SYSTEMP1,BANKED
	CLRF	SYSTEMP3,BANKED
	MOVF	SSD1306_BUFFERLOCATIONCALC_H,W,ACCESS
	SUBWFB	SYSTEMP3,W,BANKED
	MOVWF	SYSTEMP1_H,BANKED
	MOVFF	SYSTEMP1,SYSWORDTEMPA
	MOVFF	SYSTEMP1_H,SYSWORDTEMPA_H
	MOVFF	SYSFORLOOPSTEP7,SYSWORDTEMPB
	MOVFF	SYSFORLOOPSTEP7_H,SYSWORDTEMPB_H
	BANKSEL	0
	CALL	SYSCOMPLESSTHAN16
	COMF	SYSBYTETEMPX,F,ACCESS
	BTFSS	SYSBYTETEMPX,0,ACCESS
	BRA	ENDIF38
;'SET LOOPVAR TO LOOPVAR + STEPVALUE WHERE STEPVALUE IS A POSITIVE VALUE
	BANKSEL	SYSFORLOOPSTEP7
	MOVF	SYSFORLOOPSTEP7,W,BANKED
	ADDWF	SSD1306_BUFFERLOCATIONCALC,F,ACCESS
	MOVF	SYSFORLOOPSTEP7_H,W,BANKED
	ADDWFC	SSD1306_BUFFERLOCATIONCALC_H,F,ACCESS
	BRA	SYSFORLOOP8
;'END IF
GLOBAL	ENDIF38
ENDIF38:
;'END IF
GLOBAL	ENDIF36
ENDIF36:
GLOBAL	SYSFORLOOPEND8
SYSFORLOOPEND8:
;'REMOVED AT 1.14. RETAINED FOR DOCUMENTATION ONLY
;'CURSOR_POSITION_SSD1306 ( 0 , 0 )
;'FOR SSD1306_BUFFERLOCATIONCALC = 0 TO GLCD_HEIGHT-1 STEP 8
;'FOR GLCDTEMP = 0 TO 127
;'WRITE_DATA_SSD1306(GLCDBACKGROUND)
;'NEXT
;'NEXT
;'CURSOR_POSITION_SSD1306 ( 0 , 0 )
	CLRF	LOCX,ACCESS
	CLRF	LOCY,ACCESS
	RCALL	CURSOR_POSITION_SSD1306
;'PRINTLOCX =0
	CLRF	PRINTLOCX,ACCESS
;'PRINTLOCY =0
	CLRF	PRINTLOCY,ACCESS
	RETURN

;'********************************************************************************

;'SOURCE: GLCD_SSD1306.H (490)
GLOBAL	GLCDDRAWCHAR_SSD1306
GLCDDRAWCHAR_SSD1306:
;'THIS IS NOW IN FOUR PARTS
;'1. HANDLER FOR GLCD LM MODE
;'2. PREAMBLE
;'3. GCB FONT SET HANDLER
;'4. OLED FONT SET HANDLER
;'***** HANDLER FOR GLCD LM MODE
;'****** PREAMBLE
;'INVERT COLORS IF REQUIRED
;'IF LINECOLOUR <> GLCDFOREGROUND  THEN
	MOVFF	LINECOLOUR,SYSWORDTEMPA
	MOVFF	LINECOLOUR_H,SYSWORDTEMPA_H
	MOVFF	GLCDFOREGROUND,SYSWORDTEMPB
	MOVFF	GLCDFOREGROUND_H,SYSWORDTEMPB_H
	CALL	SYSCOMPEQUAL16
	COMF	SYSBYTETEMPX,F,ACCESS
	BTFSS	SYSBYTETEMPX,0,ACCESS
	BRA	ENDIF39
;'INVERTED COLOURS
;'GLCDBACKGROUND = 1
	MOVLW	1
	MOVWF	GLCDBACKGROUND,ACCESS
	CLRF	GLCDBACKGROUND_H,ACCESS
;'GLCDFOREGROUND = 0
	CLRF	GLCDFOREGROUND,ACCESS
	CLRF	GLCDFOREGROUND_H,ACCESS
;'END IF
GLOBAL	ENDIF39
ENDIF39:
;'DIM CHARCOL, CHARROW AS WORD
;'CHARCODE -= 15
	MOVLW	15
	SUBWF	CHARCODE,F,ACCESS
;'CHARCOL=0
	CLRF	CHARCOL,ACCESS
	CLRF	CHARCOL_H,ACCESS
;'CURSOR_POSITION_SSD1306 ( CHARLOCX , CHARLOCY )
	MOVFF	CHARLOCX,LOCX
	MOVFF	CHARLOCY,LOCY
	RCALL	CURSOR_POSITION_SSD1306
;'1.14 ADDED TRANSACTION
;'****** GCB FONT SET HANDLER
;'IF CHARCODE>=178 AND CHARCODE<=202 THEN
	MOVFF	CHARCODE,SYSBYTETEMPA
	MOVLW	178
	MOVWF	SYSBYTETEMPB,ACCESS
	CALL	SYSCOMPLESSTHAN
	COMF	SYSBYTETEMPX,F,ACCESS
	MOVFF	SYSBYTETEMPX,SYSTEMP3
	MOVFF	CHARCODE,SYSBYTETEMPB
	MOVLW	202
	MOVWF	SYSBYTETEMPA,ACCESS
	CALL	SYSCOMPLESSTHAN
	COMF	SYSBYTETEMPX,F,ACCESS
	BANKSEL	SYSTEMP3
	MOVF	SYSTEMP3,W,BANKED
	ANDWF	SYSBYTETEMPX,W,ACCESS
	MOVWF	SYSTEMP1,BANKED
	BTFSS	SYSTEMP1,0,BANKED
	BRA	ENDIF40
;'CHARLOCY=CHARLOCY-1
	MOVLW	1
	SUBWF	CHARLOCY,F,ACCESS
	MOVLW	0
	SUBWFB	CHARLOCY_H,F,ACCESS
;'END IF
GLOBAL	ENDIF40
ENDIF40:
;'FOR CURRCHARCOL = 1 TO 5
;'LEGACY METHOD
	CLRF	CURRCHARCOL,ACCESS
GLOBAL	SYSFORLOOP10
SYSFORLOOP10:
	INCF	CURRCHARCOL,F,ACCESS
;'SELECT CASE CURRCHARCOL
;'CASE 1: READTABLE GLCDCHARCOL3, CHARCODE, CURRCHARVAL
GLOBAL	SYSSELECT5CASE1
SYSSELECT5CASE1:
	DECF	CURRCHARCOL,W,ACCESS
	BTFSS	STATUS,2,ACCESS
	BRA	SYSSELECT5CASE2
;'CASE 1: READTABLE GLCDCHARCOL3, CHARCODE, CURRCHARVAL
	MOVFF	CHARCODE,SYSSTRINGA
	BANKSEL	0
	RCALL	GLCDCHARCOL3
	MOVWF	CURRCHARVAL,ACCESS
;'CASE 2: READTABLE GLCDCHARCOL4, CHARCODE, CURRCHARVAL
	BRA	SYSSELECTEND5
GLOBAL	SYSSELECT5CASE2
SYSSELECT5CASE2:
	MOVLW	2
	SUBWF	CURRCHARCOL,W,ACCESS
	BTFSS	STATUS,2,ACCESS
	BRA	SYSSELECT5CASE3
;'CASE 2: READTABLE GLCDCHARCOL4, CHARCODE, CURRCHARVAL
	MOVFF	CHARCODE,SYSSTRINGA
	BANKSEL	0
	RCALL	GLCDCHARCOL4
	MOVWF	CURRCHARVAL,ACCESS
;'CASE 3: READTABLE GLCDCHARCOL5, CHARCODE, CURRCHARVAL
	BRA	SYSSELECTEND5
GLOBAL	SYSSELECT5CASE3
SYSSELECT5CASE3:
	MOVLW	3
	SUBWF	CURRCHARCOL,W,ACCESS
	BTFSS	STATUS,2,ACCESS
	BRA	SYSSELECT5CASE4
;'CASE 3: READTABLE GLCDCHARCOL5, CHARCODE, CURRCHARVAL
	MOVFF	CHARCODE,SYSSTRINGA
	BANKSEL	0
	RCALL	GLCDCHARCOL5
	MOVWF	CURRCHARVAL,ACCESS
;'CASE 4: READTABLE GLCDCHARCOL6, CHARCODE, CURRCHARVAL
	BRA	SYSSELECTEND5
GLOBAL	SYSSELECT5CASE4
SYSSELECT5CASE4:
	MOVLW	4
	SUBWF	CURRCHARCOL,W,ACCESS
	BTFSS	STATUS,2,ACCESS
	BRA	SYSSELECT5CASE5
;'CASE 4: READTABLE GLCDCHARCOL6, CHARCODE, CURRCHARVAL
	MOVFF	CHARCODE,SYSSTRINGA
	BANKSEL	0
	RCALL	GLCDCHARCOL6
	MOVWF	CURRCHARVAL,ACCESS
;'CASE 5: READTABLE GLCDCHARCOL7, CHARCODE, CURRCHARVAL
	BRA	SYSSELECTEND5
GLOBAL	SYSSELECT5CASE5
SYSSELECT5CASE5:
	MOVLW	5
	SUBWF	CURRCHARCOL,W,ACCESS
	BTFSS	STATUS,2,ACCESS
	BRA	SYSSELECTEND5
;'CASE 5: READTABLE GLCDCHARCOL7, CHARCODE, CURRCHARVAL
	MOVFF	CHARCODE,SYSSTRINGA
	BANKSEL	0
	RCALL	GLCDCHARCOL7
	MOVWF	CURRCHARVAL,ACCESS
;'END SELECT
GLOBAL	SYSSELECTEND5
SYSSELECTEND5:
;'FULL MEMORY GLCD MODE
;'CHARROW=0
	CLRF	CHARROW,ACCESS
	CLRF	CHARROW_H,ACCESS
;'FOR CURRCHARROW = 1 TO 8
;'LEGACY METHOD
	CLRF	CURRCHARROW,ACCESS
GLOBAL	SYSFORLOOP11
SYSFORLOOP11:
	INCF	CURRCHARROW,F,ACCESS
;'CHARCOLS=0
	CLRF	CHARCOLS,ACCESS
;'FOR COL=1 TO GLCDFNTDEFAULTSIZE
	MOVLW	1
	MOVWF	COL,ACCESS
GLOBAL	SYSFORLOOP12
SYSFORLOOP12:
;'CHARROWS=0
	CLRF	CHARROWS,ACCESS
;'FOR ROW=1 TO GLCDFNTDEFAULTSIZE
	MOVLW	1
	MOVWF	ROW,ACCESS
GLOBAL	SYSFORLOOP13
SYSFORLOOP13:
;'IF CURRCHARVAL.0=1 THEN
	BTFSS	CURRCHARVAL,0,ACCESS
	BRA	ELSE41_1
;'PSET [WORD]CHARLOCX + CHARCOL + CHARCOLS, [WORD]CHARLOCY + CHARROW + CHARROWS, LINECOLOUR
	MOVF	CHARCOL,W,ACCESS
	ADDWF	CHARLOCX,W,ACCESS
	BANKSEL	SYSTEMP3
	MOVWF	SYSTEMP3,BANKED
	MOVF	CHARCOLS,W,ACCESS
	ADDWF	SYSTEMP3,W,BANKED
	MOVWF	GLCDX,ACCESS
	MOVF	CHARROW,W,ACCESS
	ADDWF	CHARLOCY,W,ACCESS
	MOVWF	SYSTEMP3,BANKED
	MOVF	CHARROWS,W,ACCESS
	ADDWF	SYSTEMP3,W,BANKED
	MOVWF	GLCDY,ACCESS
	MOVFF	LINECOLOUR,GLCDCOLOUR
	MOVFF	LINECOLOUR_H,GLCDCOLOUR_H
	BANKSEL	0
	RCALL	PSET_SSD1306
;'ELSE
	BRA	ENDIF41
GLOBAL	ELSE41_1
ELSE41_1:
;'PSET [WORD]CHARLOCX + CHARCOL + CHARCOLS, [WORD]CHARLOCY + CHARROW + CHARROWS, GLCDBACKGROUND
	MOVF	CHARCOL,W,ACCESS
	ADDWF	CHARLOCX,W,ACCESS
	BANKSEL	SYSTEMP3
	MOVWF	SYSTEMP3,BANKED
	MOVF	CHARCOLS,W,ACCESS
	ADDWF	SYSTEMP3,W,BANKED
	MOVWF	GLCDX,ACCESS
	MOVF	CHARROW,W,ACCESS
	ADDWF	CHARLOCY,W,ACCESS
	MOVWF	SYSTEMP3,BANKED
	MOVF	CHARROWS,W,ACCESS
	ADDWF	SYSTEMP3,W,BANKED
	MOVWF	GLCDY,ACCESS
	MOVFF	GLCDBACKGROUND,GLCDCOLOUR
	MOVFF	GLCDBACKGROUND_H,GLCDCOLOUR_H
	BANKSEL	0
	RCALL	PSET_SSD1306
;'END IF
GLOBAL	ENDIF41
ENDIF41:
;'PUT OUT A WHITE INTERCHARACTER PIXEL/SPACE
;'PSET [WORD]CHARLOCX + ( GLCDFONTWIDTH * GLCDFNTDEFAULTSIZE) , [WORD]CHARLOCY + CHARROW + CHARROWS , GLCDBACKGROUND
	MOVF	GLCDFONTWIDTH,W,ACCESS
	MULWF	GLCDFNTDEFAULTSIZE,ACCESS
	MOVFF	PRODL,SYSTEMP3
	BANKSEL	SYSTEMP3
	MOVF	SYSTEMP3,W,BANKED
	ADDWF	CHARLOCX,W,ACCESS
	MOVWF	GLCDX,ACCESS
	MOVF	CHARROW,W,ACCESS
	ADDWF	CHARLOCY,W,ACCESS
	MOVWF	SYSTEMP3,BANKED
	MOVF	CHARROWS,W,ACCESS
	ADDWF	SYSTEMP3,W,BANKED
	MOVWF	GLCDY,ACCESS
	MOVFF	GLCDBACKGROUND,GLCDCOLOUR
	MOVFF	GLCDBACKGROUND_H,GLCDCOLOUR_H
	BANKSEL	0
	RCALL	PSET_SSD1306
;'CHARROWS +=1
	INCF	CHARROWS,F,ACCESS
;'NEXT ROW
;'POSITIVE VALUE STEP HANDLER IN FOR-NEXT STATEMENT :#4P 
	MOVF	ROW,W,ACCESS
	SUBWF	GLCDFNTDEFAULTSIZE,W,ACCESS
	BANKSEL	SYSTEMP3
	MOVWF	SYSTEMP3,BANKED
	MOVFF	SYSTEMP3,SYSBYTETEMPA
	CLRF	SYSBYTETEMPB,ACCESS
	BANKSEL	0
	CALL	SYSCOMPEQUAL
	COMF	SYSBYTETEMPX,F,ACCESS
	BTFSS	SYSBYTETEMPX,0,ACCESS
	BRA	ENDIF42
;'SET LOOPVAR TO LOOPVAR + STEPVALUE WHERE STEPVALUE IS A POSITIVE VALUE
	INCF	ROW,F,ACCESS
	BRA	SYSFORLOOP13
;'END IF
GLOBAL	ENDIF42
ENDIF42:
GLOBAL	SYSFORLOOPEND13
SYSFORLOOPEND13:
;'CHARCOLS +=1
	INCF	CHARCOLS,F,ACCESS
;'NEXT COL
;'POSITIVE VALUE STEP HANDLER IN FOR-NEXT STATEMENT :#4P 
	MOVF	COL,W,ACCESS
	SUBWF	GLCDFNTDEFAULTSIZE,W,ACCESS
	BANKSEL	SYSTEMP3
	MOVWF	SYSTEMP3,BANKED
	MOVFF	SYSTEMP3,SYSBYTETEMPA
	CLRF	SYSBYTETEMPB,ACCESS
	BANKSEL	0
	CALL	SYSCOMPEQUAL
	COMF	SYSBYTETEMPX,F,ACCESS
	BTFSS	SYSBYTETEMPX,0,ACCESS
	BRA	ENDIF43
;'SET LOOPVAR TO LOOPVAR + STEPVALUE WHERE STEPVALUE IS A POSITIVE VALUE
	INCF	COL,F,ACCESS
	BRA	SYSFORLOOP12
;'END IF
GLOBAL	ENDIF43
ENDIF43:
GLOBAL	SYSFORLOOPEND12
SYSFORLOOPEND12:
;'ROTATE CURRCHARVAL RIGHT
	RRCF	CURRCHARVAL,F,ACCESS
;'CHARROW +=GLCDFNTDEFAULTSIZE
	MOVF	GLCDFNTDEFAULTSIZE,W,ACCESS
	ADDWF	CHARROW,F,ACCESS
	MOVLW	0
	ADDWFC	CHARROW_H,F,ACCESS
;'NEXT
	MOVLW	8
	SUBWF	CURRCHARROW,W,ACCESS
	BTFSS	STATUS,0,ACCESS
	BRA	SYSFORLOOP11
GLOBAL	SYSFORLOOPEND11
SYSFORLOOPEND11:
;'CHARCOL +=GLCDFNTDEFAULTSIZE
	MOVF	GLCDFNTDEFAULTSIZE,W,ACCESS
	ADDWF	CHARCOL,F,ACCESS
	MOVLW	0
	ADDWFC	CHARCOL_H,F,ACCESS
;'1.14 LOW MEMORY GLCD MODE
;'1.12 CHARACTER GLCD MODE
;'HANDLES SPECIFIC DRAW SEQUENCE. THIS CATERS FOR WRITE ONLY OF A BIT VALUE. NO READ OPERATION.
;'NEXT
	MOVLW	5
	SUBWF	CURRCHARCOL,W,ACCESS
	BTFSS	STATUS,0,ACCESS
	BRA	SYSFORLOOP10
GLOBAL	SYSFORLOOPEND10
SYSFORLOOPEND10:
;'****** OLED FONT SET HANDLER
;'1.14 ADDED TRANSACTION
;'RESTORE
;'GLCDBACKGROUND = 0
	CLRF	GLCDBACKGROUND,ACCESS
	CLRF	GLCDBACKGROUND_H,ACCESS
;'GLCDFOREGROUND = 1
	MOVLW	1
	MOVWF	GLCDFOREGROUND,ACCESS
	CLRF	GLCDFOREGROUND_H,ACCESS
	RETURN

;'********************************************************************************

;'SOURCE: 210_I2C_GLCD_SPRITES_USING_SSD1306.GCB (200)
GLOBAL	GLCDDRAWSPRITE_SSD1306
GLCDDRAWSPRITE_SSD1306:
;'DIM CURRCHARVAL, CURRCHARCOL, SSD1306_PAGE, GLCDHICHANGE, GLCDLOCHANGE, GLCDROTATEBITS, GLCDTEMP AS BYTE
;'CALCULATE DEVICE ROW
;'SSD1306_PAGE = GLCDY
	MOVFF	GLCDY,SSD1306_PAGE
;'REPEAT 3
	MOVLW	3
	BANKSEL	SYSREPEATTEMP1
	MOVWF	SYSREPEATTEMP1,BANKED
GLOBAL	SYSREPEATLOOP1
SYSREPEATLOOP1:
;'SET C OFF
	BCF	STATUS,0,ACCESS
;'ROTATE SSD1306_PAGE RIGHT
	RRCF	SSD1306_PAGE,F,ACCESS
;'END REPEAT
	DECFSZ	SYSREPEATTEMP1,F,BANKED
	BRA	SYSREPEATLOOP1
GLOBAL	SYSREPEATLOOPEND1
SYSREPEATLOOPEND1:
;'SSD1306_PAGE IS NOW THE CORRECT ROW
;'CALCULATE BUFFER ELEMENT
;'SSD1306_BUFFERLOCATIONCALC = GLCDY AND 0XF8
	MOVLW	248
	ANDWF	GLCDY,W,ACCESS
	MOVWF	SSD1306_BUFFERLOCATIONCALC,ACCESS
	CLRF	SSD1306_BUFFERLOCATIONCALC_H,ACCESS
;'REPEAT 4
	MOVLW	4
	MOVWF	SYSREPEATTEMP1,BANKED
GLOBAL	SYSREPEATLOOP2
SYSREPEATLOOP2:
;'SET C OFF
	BCF	STATUS,0,ACCESS
;'ROTATE SSD1306_BUFFERLOCATIONCALC LEFT
	RLCF	SSD1306_BUFFERLOCATIONCALC,F,ACCESS
	RLCF	SSD1306_BUFFERLOCATIONCALC_H,F,ACCESS
;'END REPEAT
	DECFSZ	SYSREPEATTEMP1,F,BANKED
	BRA	SYSREPEATLOOP2
GLOBAL	SYSREPEATLOOPEND2
SYSREPEATLOOPEND2:
;'SSD1306_BUFFERLOCATIONCALC = (SSD1306_BUFFERLOCATIONCALC OR GLCDX)
	MOVF	SSD1306_BUFFERLOCATIONCALC,W,ACCESS
	IORWF	GLCDX,W,ACCESS
	MOVWF	SSD1306_BUFFERLOCATIONCALC,ACCESS
;'INCREMENT AS WE DO NOT USE ELEMENT 0 IN THE ARRAY
;'SSD1306_BUFFERLOCATIONCALC++
	INCF	SSD1306_BUFFERLOCATIONCALC,F,ACCESS
	BTFSC	STATUS,2,ACCESS
	INCF	SSD1306_BUFFERLOCATIONCALC_H,F,ACCESS
;'SSD1306_BUFFERLOCATIONCALC IS NOW THE CORRECT BUFFER ELEMENT
;'IS THE Y POSITION OF SPRITE ON A ROW POSITIN 0?
;'IF ( GLCDY MOD 8 ) = 0 THEN
	MOVFF	GLCDY,SYSBYTETEMPA
	MOVLW	8
	MOVWF	SYSBYTETEMPB,ACCESS
	BANKSEL	0
	CALL	SYSDIVSUB
	MOVFF	SYSBYTETEMPX,SYSTEMP1
	MOVFF	SYSTEMP1,SYSBYTETEMPA
	CLRF	SYSBYTETEMPB,ACCESS
	CALL	SYSCOMPEQUAL
	BTFSS	SYSBYTETEMPX,0,ACCESS
	BRA	ELSE7_1
;'USES GLDX AND SS1306_PAGE VARIABLES
;'CURSOR_POSITION_SSD1306_FAST
;'MACRO SOURCE: 210_I2C_GLCD_SPRITES_USING_SSD1306.GCB (429)
;'DIM I2CBYTE AS BYTE
;'HI2CSTART
	CALL	SI2CSTART
;'HI2CSEND GLCD_I2C_ADDRESS
	MOVLW	120
	MOVWF	I2CBYTE,ACCESS
	RCALL	SI2CSEND
;'HI2CSEND 0X00
	CLRF	I2CBYTE,ACCESS
	RCALL	SI2CSEND
;'HI2CSEND 0XB0 + SSD1306_PAGE
	MOVLW	176
	ADDWF	SSD1306_PAGE,W,ACCESS
	MOVWF	I2CBYTE,ACCESS
	RCALL	SI2CSEND
;'HI2CSTOP
	CALL	SI2CSTOP
;'HI2CSTART
	RCALL	SI2CSTART
;'HI2CSEND GLCD_I2C_ADDRESS
	MOVLW	120
	MOVWF	I2CBYTE,ACCESS
	RCALL	SI2CSEND
;'HI2CSEND 0X00
	CLRF	I2CBYTE,ACCESS
	RCALL	SI2CSEND
;'LOWER NIBBLE
;'I2CBYTE = ( GLCDX  & 0X0F )
	MOVLW	15
	ANDWF	GLCDX,W,ACCESS
	MOVWF	I2CBYTE,ACCESS
;'HI2CSEND I2CBYTE
	RCALL	SI2CSEND
;'HI2CSTOP
	RCALL	SI2CSTOP
;'HI2CSTART
	RCALL	SI2CSTART
;'HI2CSEND GLCD_I2C_ADDRESS
	MOVLW	120
	MOVWF	I2CBYTE,ACCESS
	RCALL	SI2CSEND
;'HI2CSEND 0X00
	CLRF	I2CBYTE,ACCESS
	RCALL	SI2CSEND
;'I2CBYTE = ( SWAP4(GLCDX) & 0X0F ) + 0X10
	MOVFF	GLCDX,SWAP4IN
	CALL	FN_SWAP4
	MOVLW	15
	BANKSEL	SWAP4
	ANDWF	SWAP4,W,BANKED
	MOVWF	SYSTEMP1,BANKED
	MOVLW	16
	ADDWF	SYSTEMP1,W,BANKED
	MOVWF	I2CBYTE,ACCESS
;'HI2CSEND I2CBYTE
	BANKSEL	0
	RCALL	SI2CSEND
;'HI2CSTOP
	RCALL	SI2CSTOP
;'READ 8 PIXELS VALUE INTO CURRCHARVAL THEN WRITE TO DISPLAY
;'OPEN_TRANSACTION_SSD1306
;'MACRO SOURCE: GLCD_SSD1306.H (1241)
;'4WIRE NOT SUPPORTED, SEE WRITE_TRANSACTION_DATA_SSD1306
;'HI2CSTART
	RCALL	SI2CSTART
;'HI2CSEND GLCD_I2C_ADDRESS
	MOVLW	120
	MOVWF	I2CBYTE,ACCESS
	RCALL	SI2CSEND
;'HI2CSEND 0X40
	MOVLW	64
	MOVWF	I2CBYTE,ACCESS
	RCALL	SI2CSEND
;'FOR CURRCHARCOL = 1 TO 8
;'LEGACY METHOD
	CLRF	CURRCHARCOL,ACCESS
GLOBAL	SYSFORLOOP1
SYSFORLOOP1:
	INCF	CURRCHARCOL,F,ACCESS
;'SELECT CASE CURRCHARCOL
;'CASE 1: READTABLE SPRITE1, CHARCODE, CURRCHARVAL
GLOBAL	SYSSELECT1CASE1
SYSSELECT1CASE1:
	DECF	CURRCHARCOL,W,ACCESS
	BTFSS	STATUS,2,ACCESS
	BRA	SYSSELECT1CASE2
;'CASE 1: READTABLE SPRITE1, CHARCODE, CURRCHARVAL
	MOVFF	CHARCODE,SYSSTRINGA
	CALL	SPRITE1
	MOVWF	CURRCHARVAL,ACCESS
;'CASE 2: READTABLE SPRITE2, CHARCODE, CURRCHARVAL
	BRA	SYSSELECTEND1
GLOBAL	SYSSELECT1CASE2
SYSSELECT1CASE2:
	MOVLW	2
	SUBWF	CURRCHARCOL,W,ACCESS
	BTFSS	STATUS,2,ACCESS
	BRA	SYSSELECT1CASE3
;'CASE 2: READTABLE SPRITE2, CHARCODE, CURRCHARVAL
	MOVFF	CHARCODE,SYSSTRINGA
	CALL	SPRITE2
	MOVWF	CURRCHARVAL,ACCESS
;'CASE 3: READTABLE SPRITE3, CHARCODE, CURRCHARVAL
	BRA	SYSSELECTEND1
GLOBAL	SYSSELECT1CASE3
SYSSELECT1CASE3:
	MOVLW	3
	SUBWF	CURRCHARCOL,W,ACCESS
	BTFSS	STATUS,2,ACCESS
	BRA	SYSSELECT1CASE4
;'CASE 3: READTABLE SPRITE3, CHARCODE, CURRCHARVAL
	MOVFF	CHARCODE,SYSSTRINGA
	CALL	SPRITE3
	MOVWF	CURRCHARVAL,ACCESS
;'CASE 4: READTABLE SPRITE4, CHARCODE, CURRCHARVAL
	BRA	SYSSELECTEND1
GLOBAL	SYSSELECT1CASE4
SYSSELECT1CASE4:
	MOVLW	4
	SUBWF	CURRCHARCOL,W,ACCESS
	BTFSS	STATUS,2,ACCESS
	BRA	SYSSELECT1CASE5
;'CASE 4: READTABLE SPRITE4, CHARCODE, CURRCHARVAL
	MOVFF	CHARCODE,SYSSTRINGA
	CALL	SPRITE4
	MOVWF	CURRCHARVAL,ACCESS
;'CASE 5: READTABLE SPRITE5, CHARCODE, CURRCHARVAL
	BRA	SYSSELECTEND1
GLOBAL	SYSSELECT1CASE5
SYSSELECT1CASE5:
	MOVLW	5
	SUBWF	CURRCHARCOL,W,ACCESS
	BTFSS	STATUS,2,ACCESS
	BRA	SYSSELECT1CASE6
;'CASE 5: READTABLE SPRITE5, CHARCODE, CURRCHARVAL
	MOVFF	CHARCODE,SYSSTRINGA
	CALL	SPRITE5
	MOVWF	CURRCHARVAL,ACCESS
;'CASE 6: READTABLE SPRITE6, CHARCODE, CURRCHARVAL
	BRA	SYSSELECTEND1
GLOBAL	SYSSELECT1CASE6
SYSSELECT1CASE6:
	MOVLW	6
	SUBWF	CURRCHARCOL,W,ACCESS
	BTFSS	STATUS,2,ACCESS
	BRA	SYSSELECT1CASE7
;'CASE 6: READTABLE SPRITE6, CHARCODE, CURRCHARVAL
	MOVFF	CHARCODE,SYSSTRINGA
	CALL	SPRITE6
	MOVWF	CURRCHARVAL,ACCESS
;'CASE 7: READTABLE SPRITE7, CHARCODE, CURRCHARVAL
	BRA	SYSSELECTEND1
GLOBAL	SYSSELECT1CASE7
SYSSELECT1CASE7:
	MOVLW	7
	SUBWF	CURRCHARCOL,W,ACCESS
	BTFSS	STATUS,2,ACCESS
	BRA	SYSSELECT1CASE8
;'CASE 7: READTABLE SPRITE7, CHARCODE, CURRCHARVAL
	MOVFF	CHARCODE,SYSSTRINGA
	CALL	SPRITE7
	MOVWF	CURRCHARVAL,ACCESS
;'CASE 8: READTABLE SPRITE8, CHARCODE, CURRCHARVAL
	BRA	SYSSELECTEND1
GLOBAL	SYSSELECT1CASE8
SYSSELECT1CASE8:
	MOVLW	8
	SUBWF	CURRCHARCOL,W,ACCESS
	BTFSS	STATUS,2,ACCESS
	BRA	SYSSELECTEND1
;'CASE 8: READTABLE SPRITE8, CHARCODE, CURRCHARVAL
	MOVFF	CHARCODE,SYSSTRINGA
	CALL	SPRITE8
	MOVWF	CURRCHARVAL,ACCESS
;'END SELECT
GLOBAL	SYSSELECTEND1
SYSSELECTEND1:
;'XOR PIXELS INTO BUFFER
;'GLCDTEMP = SSD1306_BUFFERALIAS(SSD1306_BUFFERLOCATIONCALC) XOR CURRCHARVAL
	LFSR	0,SSD1306_BUFFERALIAS
	MOVF	SSD1306_BUFFERLOCATIONCALC,W,ACCESS
	ADDWF	FSR0,F,ACCESS
	MOVF	SSD1306_BUFFERLOCATIONCALC_H,W,ACCESS
	ADDWFC	FSR0H,F,ACCESS
	MOVF	INDF0,W,ACCESS
	XORWF	CURRCHARVAL,W,ACCESS
	MOVWF	GLCDTEMP,ACCESS
;'SSD1306_BUFFERALIAS(SSD1306_BUFFERLOCATIONCALC) = GLCDTEMP
	LFSR	0,SSD1306_BUFFERALIAS
	MOVF	SSD1306_BUFFERLOCATIONCALC,W,ACCESS
	ADDWF	FSR0,F,ACCESS
	MOVF	SSD1306_BUFFERLOCATIONCALC_H,W,ACCESS
	ADDWFC	FSR0H,F,ACCESS
	MOVFF	GLCDTEMP,INDF0
;'WRITE BUFFER THIS WILL INCREMENT THE DEVICE POINT AS PART OF THE WRITE OPERATION
;'WRITE_TRANSACTION_DATA_SSD1306(GLCDTEMP)
;'MACRO SOURCE: GLCD_SSD1306.H (1272)
;'HI2CSEND SSD1306SENDBYTE
	MOVFF	GLCDTEMP,I2CBYTE
	RCALL	SI2CSEND
;'INCREMENT BUFFER BY 1 TO MATCH DEVICE INCREMENT
;'SSD1306_BUFFERLOCATIONCALC++
	INCF	SSD1306_BUFFERLOCATIONCALC,F,ACCESS
	BTFSC	STATUS,2,ACCESS
	INCF	SSD1306_BUFFERLOCATIONCALC_H,F,ACCESS
;'NEXT
	MOVLW	8
	SUBWF	CURRCHARCOL,W,ACCESS
	BTFSS	STATUS,0,ACCESS
	BRA	SYSFORLOOP1
GLOBAL	SYSFORLOOPEND1
SYSFORLOOPEND1:
;'CLOSE_TRANSACTION_SSD1306
;'MACRO SOURCE: GLCD_SSD1306.H (1305)
;'4WIRE NOT SUPPORTED, SEE WRITE_TRANSACTION_DATA_SSD1306
;'HI2CSTOP
	RCALL	SI2CSTOP
;'ELSE
	BRA	ENDIF7
GLOBAL	ELSE7_1
ELSE7_1:
;'HANDLE TOP PORTION OF THE SPRITE AS WE ARE NOT AT 0 PIXEL OF A ROW
;'SEND THE TOP PIXELS
;'CURSOR_POSITION_SSD1306_FAST
;'MACRO SOURCE: 210_I2C_GLCD_SPRITES_USING_SSD1306.GCB (429)
;'DIM I2CBYTE AS BYTE
;'HI2CSTART
	RCALL	SI2CSTART
;'HI2CSEND GLCD_I2C_ADDRESS
	MOVLW	120
	MOVWF	I2CBYTE,ACCESS
	RCALL	SI2CSEND
;'HI2CSEND 0X00
	CLRF	I2CBYTE,ACCESS
	RCALL	SI2CSEND
;'HI2CSEND 0XB0 + SSD1306_PAGE
	MOVLW	176
	ADDWF	SSD1306_PAGE,W,ACCESS
	MOVWF	I2CBYTE,ACCESS
	RCALL	SI2CSEND
;'HI2CSTOP
	RCALL	SI2CSTOP
;'HI2CSTART
	RCALL	SI2CSTART
;'HI2CSEND GLCD_I2C_ADDRESS
	MOVLW	120
	MOVWF	I2CBYTE,ACCESS
	RCALL	SI2CSEND
;'HI2CSEND 0X00
	CLRF	I2CBYTE,ACCESS
	RCALL	SI2CSEND
;'LOWER NIBBLE
;'I2CBYTE = ( GLCDX  & 0X0F )
	MOVLW	15
	ANDWF	GLCDX,W,ACCESS
	MOVWF	I2CBYTE,ACCESS
;'HI2CSEND I2CBYTE
	RCALL	SI2CSEND
;'HI2CSTOP
	RCALL	SI2CSTOP
;'HI2CSTART
	RCALL	SI2CSTART
;'HI2CSEND GLCD_I2C_ADDRESS
	MOVLW	120
	MOVWF	I2CBYTE,ACCESS
	RCALL	SI2CSEND
;'HI2CSEND 0X00
	CLRF	I2CBYTE,ACCESS
	RCALL	SI2CSEND
;'I2CBYTE = ( SWAP4(GLCDX) & 0X0F ) + 0X10
	MOVFF	GLCDX,SWAP4IN
	CALL	FN_SWAP4
	MOVLW	15
	BANKSEL	SWAP4
	ANDWF	SWAP4,W,BANKED
	MOVWF	SYSTEMP1,BANKED
	MOVLW	16
	ADDWF	SYSTEMP1,W,BANKED
	MOVWF	I2CBYTE,ACCESS
;'HI2CSEND I2CBYTE
	BANKSEL	0
	RCALL	SI2CSEND
;'HI2CSTOP
	RCALL	SI2CSTOP
;'OPEN_TRANSACTION_SSD1306
;'MACRO SOURCE: GLCD_SSD1306.H (1241)
;'4WIRE NOT SUPPORTED, SEE WRITE_TRANSACTION_DATA_SSD1306
;'HI2CSTART
	RCALL	SI2CSTART
;'HI2CSEND GLCD_I2C_ADDRESS
	MOVLW	120
	MOVWF	I2CBYTE,ACCESS
	RCALL	SI2CSEND
;'HI2CSEND 0X40
	MOVLW	64
	MOVWF	I2CBYTE,ACCESS
	RCALL	SI2CSEND
;'FOR CURRCHARCOL = 1 TO 8
;'LEGACY METHOD
	CLRF	CURRCHARCOL,ACCESS
GLOBAL	SYSFORLOOP2
SYSFORLOOP2:
	INCF	CURRCHARCOL,F,ACCESS
;'SELECT CASE CURRCHARCOL
;'CASE 1: READTABLE SPRITE1, CHARCODE, GLCDHICHANGE
GLOBAL	SYSSELECT2CASE1
SYSSELECT2CASE1:
	DECF	CURRCHARCOL,W,ACCESS
	BTFSS	STATUS,2,ACCESS
	BRA	SYSSELECT2CASE2
;'CASE 1: READTABLE SPRITE1, CHARCODE, GLCDHICHANGE
	MOVFF	CHARCODE,SYSSTRINGA
	RCALL	SPRITE1
	MOVWF	GLCDHICHANGE,ACCESS
;'CASE 2: READTABLE SPRITE2, CHARCODE, GLCDHICHANGE
	BRA	SYSSELECTEND2
GLOBAL	SYSSELECT2CASE2
SYSSELECT2CASE2:
	MOVLW	2
	SUBWF	CURRCHARCOL,W,ACCESS
	BTFSS	STATUS,2,ACCESS
	BRA	SYSSELECT2CASE3
;'CASE 2: READTABLE SPRITE2, CHARCODE, GLCDHICHANGE
	MOVFF	CHARCODE,SYSSTRINGA
	RCALL	SPRITE2
	MOVWF	GLCDHICHANGE,ACCESS
;'CASE 3: READTABLE SPRITE3, CHARCODE, GLCDHICHANGE
	BRA	SYSSELECTEND2
GLOBAL	SYSSELECT2CASE3
SYSSELECT2CASE3:
	MOVLW	3
	SUBWF	CURRCHARCOL,W,ACCESS
	BTFSS	STATUS,2,ACCESS
	BRA	SYSSELECT2CASE4
;'CASE 3: READTABLE SPRITE3, CHARCODE, GLCDHICHANGE
	MOVFF	CHARCODE,SYSSTRINGA
	RCALL	SPRITE3
	MOVWF	GLCDHICHANGE,ACCESS
;'CASE 4: READTABLE SPRITE4, CHARCODE, GLCDHICHANGE
	BRA	SYSSELECTEND2
GLOBAL	SYSSELECT2CASE4
SYSSELECT2CASE4:
	MOVLW	4
	SUBWF	CURRCHARCOL,W,ACCESS
	BTFSS	STATUS,2,ACCESS
	BRA	SYSSELECT2CASE5
;'CASE 4: READTABLE SPRITE4, CHARCODE, GLCDHICHANGE
	MOVFF	CHARCODE,SYSSTRINGA
	RCALL	SPRITE4
	MOVWF	GLCDHICHANGE,ACCESS
;'CASE 5: READTABLE SPRITE5, CHARCODE, GLCDHICHANGE
	BRA	SYSSELECTEND2
GLOBAL	SYSSELECT2CASE5
SYSSELECT2CASE5:
	MOVLW	5
	SUBWF	CURRCHARCOL,W,ACCESS
	BTFSS	STATUS,2,ACCESS
	BRA	SYSSELECT2CASE6
;'CASE 5: READTABLE SPRITE5, CHARCODE, GLCDHICHANGE
	MOVFF	CHARCODE,SYSSTRINGA
	RCALL	SPRITE5
	MOVWF	GLCDHICHANGE,ACCESS
;'CASE 6: READTABLE SPRITE6, CHARCODE, GLCDHICHANGE
	BRA	SYSSELECTEND2
GLOBAL	SYSSELECT2CASE6
SYSSELECT2CASE6:
	MOVLW	6
	SUBWF	CURRCHARCOL,W,ACCESS
	BTFSS	STATUS,2,ACCESS
	BRA	SYSSELECT2CASE7
;'CASE 6: READTABLE SPRITE6, CHARCODE, GLCDHICHANGE
	MOVFF	CHARCODE,SYSSTRINGA
	RCALL	SPRITE6
	MOVWF	GLCDHICHANGE,ACCESS
;'CASE 7: READTABLE SPRITE7, CHARCODE, GLCDHICHANGE
	BRA	SYSSELECTEND2
GLOBAL	SYSSELECT2CASE7
SYSSELECT2CASE7:
	MOVLW	7
	SUBWF	CURRCHARCOL,W,ACCESS
	BTFSS	STATUS,2,ACCESS
	BRA	SYSSELECT2CASE8
;'CASE 7: READTABLE SPRITE7, CHARCODE, GLCDHICHANGE
	MOVFF	CHARCODE,SYSSTRINGA
	RCALL	SPRITE7
	MOVWF	GLCDHICHANGE,ACCESS
;'CASE 8: READTABLE SPRITE8, CHARCODE, GLCDHICHANGE
	BRA	SYSSELECTEND2
GLOBAL	SYSSELECT2CASE8
SYSSELECT2CASE8:
	MOVLW	8
	SUBWF	CURRCHARCOL,W,ACCESS
	BTFSS	STATUS,2,ACCESS
	BRA	SYSSELECTEND2
;'CASE 8: READTABLE SPRITE8, CHARCODE, GLCDHICHANGE
	MOVFF	CHARCODE,SYSSTRINGA
	CALL	SPRITE8
	MOVWF	GLCDHICHANGE,ACCESS
;'END SELECT
GLOBAL	SYSSELECTEND2
SYSSELECTEND2:
;'HANDLE TOP ROW
;'GLCDROTATEBITS = GLCDY AND 7
	MOVLW	7
	ANDWF	GLCDY,W,ACCESS
	MOVWF	GLCDROTATEBITS,ACCESS
;'REPEAT GLCDROTATEBITS
	MOVFF	GLCDROTATEBITS,SYSREPEATTEMP1
	BANKSEL	SYSREPEATTEMP1
	MOVF	SYSREPEATTEMP1,F,BANKED
	BTFSC	STATUS,2,ACCESS
	BRA	SYSREPEATLOOPEND3
GLOBAL	SYSREPEATLOOP3
SYSREPEATLOOP3:
;'SET C OFF
	BCF	STATUS,0,ACCESS
;'ROTATE GLCDHICHANGE LEFT
	RLCF	GLCDHICHANGE,F,ACCESS
;'END REPEAT
	DECFSZ	SYSREPEATTEMP1,F,BANKED
	BRA	SYSREPEATLOOP3
GLOBAL	SYSREPEATLOOPEND3
SYSREPEATLOOPEND3:
;'GLCDTEMP = SSD1306_BUFFERALIAS(SSD1306_BUFFERLOCATIONCALC) XOR GLCDHICHANGE
	LFSR	0,SSD1306_BUFFERALIAS
	MOVF	SSD1306_BUFFERLOCATIONCALC,W,ACCESS
	ADDWF	FSR0,F,ACCESS
	MOVF	SSD1306_BUFFERLOCATIONCALC_H,W,ACCESS
	ADDWFC	FSR0H,F,ACCESS
	MOVF	INDF0,W,ACCESS
	XORWF	GLCDHICHANGE,W,ACCESS
	MOVWF	GLCDTEMP,ACCESS
;'SSD1306_BUFFERALIAS(SSD1306_BUFFERLOCATIONCALC) = GLCDTEMP
	LFSR	0,SSD1306_BUFFERALIAS
	MOVF	SSD1306_BUFFERLOCATIONCALC,W,ACCESS
	ADDWF	FSR0,F,ACCESS
	MOVF	SSD1306_BUFFERLOCATIONCALC_H,W,ACCESS
	ADDWFC	FSR0H,F,ACCESS
	MOVFF	GLCDTEMP,INDF0
;'WRITE_TRANSACTION_DATA_SSD1306(GLCDTEMP)
;'MACRO SOURCE: GLCD_SSD1306.H (1272)
;'HI2CSEND SSD1306SENDBYTE
	MOVFF	GLCDTEMP,I2CBYTE
	BANKSEL	0
	RCALL	SI2CSEND
;'SSD1306_BUFFERLOCATIONCALC++
	INCF	SSD1306_BUFFERLOCATIONCALC,F,ACCESS
	BTFSC	STATUS,2,ACCESS
	INCF	SSD1306_BUFFERLOCATIONCALC_H,F,ACCESS
;'NEXT
	MOVLW	8
	SUBWF	CURRCHARCOL,W,ACCESS
	BTFSS	STATUS,0,ACCESS
	BRA	SYSFORLOOP2
GLOBAL	SYSFORLOOPEND2
SYSFORLOOPEND2:
;'CLOSE_TRANSACTION_SSD1306
;'MACRO SOURCE: GLCD_SSD1306.H (1305)
;'4WIRE NOT SUPPORTED, SEE WRITE_TRANSACTION_DATA_SSD1306
;'HI2CSTOP
	RCALL	SI2CSTOP
;'HANDLE BOTTOM PIXELS OF THE SPRITE
;'INCREMENT TO THE NEXT ROW
;'SSD1306_PAGE++
	INCF	SSD1306_PAGE,F,ACCESS
;'CURSOR_POSITION_SSD1306_FAST
;'MACRO SOURCE: 210_I2C_GLCD_SPRITES_USING_SSD1306.GCB (429)
;'DIM I2CBYTE AS BYTE
;'HI2CSTART
	RCALL	SI2CSTART
;'HI2CSEND GLCD_I2C_ADDRESS
	MOVLW	120
	MOVWF	I2CBYTE,ACCESS
	RCALL	SI2CSEND
;'HI2CSEND 0X00
	CLRF	I2CBYTE,ACCESS
	RCALL	SI2CSEND
;'HI2CSEND 0XB0 + SSD1306_PAGE
	MOVLW	176
	ADDWF	SSD1306_PAGE,W,ACCESS
	MOVWF	I2CBYTE,ACCESS
	RCALL	SI2CSEND
;'HI2CSTOP
	RCALL	SI2CSTOP
;'HI2CSTART
	RCALL	SI2CSTART
;'HI2CSEND GLCD_I2C_ADDRESS
	MOVLW	120
	MOVWF	I2CBYTE,ACCESS
	RCALL	SI2CSEND
;'HI2CSEND 0X00
	CLRF	I2CBYTE,ACCESS
	RCALL	SI2CSEND
;'LOWER NIBBLE
;'I2CBYTE = ( GLCDX  & 0X0F )
	MOVLW	15
	ANDWF	GLCDX,W,ACCESS
	MOVWF	I2CBYTE,ACCESS
;'HI2CSEND I2CBYTE
	RCALL	SI2CSEND
;'HI2CSTOP
	RCALL	SI2CSTOP
;'HI2CSTART
	RCALL	SI2CSTART
;'HI2CSEND GLCD_I2C_ADDRESS
	MOVLW	120
	MOVWF	I2CBYTE,ACCESS
	RCALL	SI2CSEND
;'HI2CSEND 0X00
	CLRF	I2CBYTE,ACCESS
	RCALL	SI2CSEND
;'I2CBYTE = ( SWAP4(GLCDX) & 0X0F ) + 0X10
	MOVFF	GLCDX,SWAP4IN
	RCALL	FN_SWAP4
	MOVLW	15
	BANKSEL	SWAP4
	ANDWF	SWAP4,W,BANKED
	MOVWF	SYSTEMP1,BANKED
	MOVLW	16
	ADDWF	SYSTEMP1,W,BANKED
	MOVWF	I2CBYTE,ACCESS
;'HI2CSEND I2CBYTE
	BANKSEL	0
	RCALL	SI2CSEND
;'HI2CSTOP
	RCALL	SI2CSTOP
;'MOVE BUFFER POINTET TO THE NEXT ROW/BUFFER WHICH IS 128 BYTES, BUT, THE TOP HALF OF THE BUFFER HAS BEEN WRITE... 8 BYTES.
;'SO 128-8 = 120
;'SSD1306_BUFFERLOCATIONCALC = SSD1306_BUFFERLOCATIONCALC  + 120
	MOVLW	120
	ADDWF	SSD1306_BUFFERLOCATIONCALC,F,ACCESS
	MOVLW	0
	ADDWFC	SSD1306_BUFFERLOCATIONCALC_H,F,ACCESS
;'OPEN_TRANSACTION_SSD1306
;'MACRO SOURCE: GLCD_SSD1306.H (1241)
;'4WIRE NOT SUPPORTED, SEE WRITE_TRANSACTION_DATA_SSD1306
;'HI2CSTART
	RCALL	SI2CSTART
;'HI2CSEND GLCD_I2C_ADDRESS
	MOVLW	120
	MOVWF	I2CBYTE,ACCESS
	RCALL	SI2CSEND
;'HI2CSEND 0X40
	MOVLW	64
	MOVWF	I2CBYTE,ACCESS
	RCALL	SI2CSEND
;'FOR CURRCHARCOL = 1 TO 8
;'LEGACY METHOD
	CLRF	CURRCHARCOL,ACCESS
GLOBAL	SYSFORLOOP3
SYSFORLOOP3:
	INCF	CURRCHARCOL,F,ACCESS
;'SELECT CASE CURRCHARCOL
;'CASE 1: READTABLE SPRITE1, CHARCODE, GLCDHICHANGE
GLOBAL	SYSSELECT3CASE1
SYSSELECT3CASE1:
	DECF	CURRCHARCOL,W,ACCESS
	BTFSS	STATUS,2,ACCESS
	BRA	SYSSELECT3CASE2
;'CASE 1: READTABLE SPRITE1, CHARCODE, GLCDHICHANGE
	MOVFF	CHARCODE,SYSSTRINGA
	RCALL	SPRITE1
	MOVWF	GLCDHICHANGE,ACCESS
;'CASE 2: READTABLE SPRITE2, CHARCODE, GLCDHICHANGE
	BRA	SYSSELECTEND3
GLOBAL	SYSSELECT3CASE2
SYSSELECT3CASE2:
	MOVLW	2
	SUBWF	CURRCHARCOL,W,ACCESS
	BTFSS	STATUS,2,ACCESS
	BRA	SYSSELECT3CASE3
;'CASE 2: READTABLE SPRITE2, CHARCODE, GLCDHICHANGE
	MOVFF	CHARCODE,SYSSTRINGA
	RCALL	SPRITE2
	MOVWF	GLCDHICHANGE,ACCESS
;'CASE 3: READTABLE SPRITE3, CHARCODE, GLCDHICHANGE
	BRA	SYSSELECTEND3
GLOBAL	SYSSELECT3CASE3
SYSSELECT3CASE3:
	MOVLW	3
	SUBWF	CURRCHARCOL,W,ACCESS
	BTFSS	STATUS,2,ACCESS
	BRA	SYSSELECT3CASE4
;'CASE 3: READTABLE SPRITE3, CHARCODE, GLCDHICHANGE
	MOVFF	CHARCODE,SYSSTRINGA
	RCALL	SPRITE3
	MOVWF	GLCDHICHANGE,ACCESS
;'CASE 4: READTABLE SPRITE4, CHARCODE, GLCDHICHANGE
	BRA	SYSSELECTEND3
GLOBAL	SYSSELECT3CASE4
SYSSELECT3CASE4:
	MOVLW	4
	SUBWF	CURRCHARCOL,W,ACCESS
	BTFSS	STATUS,2,ACCESS
	BRA	SYSSELECT3CASE5
;'CASE 4: READTABLE SPRITE4, CHARCODE, GLCDHICHANGE
	MOVFF	CHARCODE,SYSSTRINGA
	RCALL	SPRITE4
	MOVWF	GLCDHICHANGE,ACCESS
;'CASE 5: READTABLE SPRITE5, CHARCODE, GLCDHICHANGE
	BRA	SYSSELECTEND3
GLOBAL	SYSSELECT3CASE5
SYSSELECT3CASE5:
	MOVLW	5
	SUBWF	CURRCHARCOL,W,ACCESS
	BTFSS	STATUS,2,ACCESS
	BRA	SYSSELECT3CASE6
;'CASE 5: READTABLE SPRITE5, CHARCODE, GLCDHICHANGE
	MOVFF	CHARCODE,SYSSTRINGA
	RCALL	SPRITE5
	MOVWF	GLCDHICHANGE,ACCESS
;'CASE 6: READTABLE SPRITE6, CHARCODE, GLCDHICHANGE
	BRA	SYSSELECTEND3
GLOBAL	SYSSELECT3CASE6
SYSSELECT3CASE6:
	MOVLW	6
	SUBWF	CURRCHARCOL,W,ACCESS
	BTFSS	STATUS,2,ACCESS
	BRA	SYSSELECT3CASE7
;'CASE 6: READTABLE SPRITE6, CHARCODE, GLCDHICHANGE
	MOVFF	CHARCODE,SYSSTRINGA
	RCALL	SPRITE6
	MOVWF	GLCDHICHANGE,ACCESS
;'CASE 7: READTABLE SPRITE7, CHARCODE, GLCDHICHANGE
	BRA	SYSSELECTEND3
GLOBAL	SYSSELECT3CASE7
SYSSELECT3CASE7:
	MOVLW	7
	SUBWF	CURRCHARCOL,W,ACCESS
	BTFSS	STATUS,2,ACCESS
	BRA	SYSSELECT3CASE8
;'CASE 7: READTABLE SPRITE7, CHARCODE, GLCDHICHANGE
	MOVFF	CHARCODE,SYSSTRINGA
	RCALL	SPRITE7
	MOVWF	GLCDHICHANGE,ACCESS
;'CASE 8: READTABLE SPRITE8, CHARCODE, GLCDHICHANGE
	BRA	SYSSELECTEND3
GLOBAL	SYSSELECT3CASE8
SYSSELECT3CASE8:
	MOVLW	8
	SUBWF	CURRCHARCOL,W,ACCESS
	BTFSS	STATUS,2,ACCESS
	BRA	SYSSELECTEND3
;'CASE 8: READTABLE SPRITE8, CHARCODE, GLCDHICHANGE
	MOVFF	CHARCODE,SYSSTRINGA
	RCALL	SPRITE8
	MOVWF	GLCDHICHANGE,ACCESS
;'END SELECT
GLOBAL	SYSSELECTEND3
SYSSELECTEND3:
;'GLCDLOCHANGE = 0
	CLRF	GLCDLOCHANGE,ACCESS
;'REPEAT GLCDROTATEBITS
	MOVFF	GLCDROTATEBITS,SYSREPEATTEMP1
	BANKSEL	SYSREPEATTEMP1
	MOVF	SYSREPEATTEMP1,F,BANKED
	BTFSC	STATUS,2,ACCESS
	BRA	SYSREPEATLOOPEND4
GLOBAL	SYSREPEATLOOP4
SYSREPEATLOOP4:
;'SET C OFF
	BCF	STATUS,0,ACCESS
;'AS BITS MOVE TO LEFT C IS SET... MOVING IN GLCDLOCHANGE IN THE NEXT COMMAND
;'ROTATE GLCDHICHANGE LEFT
	RLCF	GLCDHICHANGE,F,ACCESS
;'ROTATE GLCDLOCHANGE LEFT
	RLCF	GLCDLOCHANGE,F,ACCESS
;'END REPEAT
	DECFSZ	SYSREPEATTEMP1,F,BANKED
	BRA	SYSREPEATLOOP4
GLOBAL	SYSREPEATLOOPEND4
SYSREPEATLOOPEND4:
;'GLCDTEMP = SSD1306_BUFFERALIAS(SSD1306_BUFFERLOCATIONCALC) XOR GLCDLOCHANGE
	LFSR	0,SSD1306_BUFFERALIAS
	MOVF	SSD1306_BUFFERLOCATIONCALC,W,ACCESS
	ADDWF	FSR0,F,ACCESS
	MOVF	SSD1306_BUFFERLOCATIONCALC_H,W,ACCESS
	ADDWFC	FSR0H,F,ACCESS
	MOVF	INDF0,W,ACCESS
	XORWF	GLCDLOCHANGE,W,ACCESS
	MOVWF	GLCDTEMP,ACCESS
;'SSD1306_BUFFERALIAS(SSD1306_BUFFERLOCATIONCALC) = GLCDTEMP
	LFSR	0,SSD1306_BUFFERALIAS
	MOVF	SSD1306_BUFFERLOCATIONCALC,W,ACCESS
	ADDWF	FSR0,F,ACCESS
	MOVF	SSD1306_BUFFERLOCATIONCALC_H,W,ACCESS
	ADDWFC	FSR0H,F,ACCESS
	MOVFF	GLCDTEMP,INDF0
;'WRITE_TRANSACTION_DATA_SSD1306(GLCDTEMP)
;'MACRO SOURCE: GLCD_SSD1306.H (1272)
;'HI2CSEND SSD1306SENDBYTE
	MOVFF	GLCDTEMP,I2CBYTE
	BANKSEL	0
	RCALL	SI2CSEND
;'SSD1306_BUFFERLOCATIONCALC++
	INCF	SSD1306_BUFFERLOCATIONCALC,F,ACCESS
	BTFSC	STATUS,2,ACCESS
	INCF	SSD1306_BUFFERLOCATIONCALC_H,F,ACCESS
;'NEXT
	MOVLW	8
	SUBWF	CURRCHARCOL,W,ACCESS
	BTFSS	STATUS,0,ACCESS
	BRA	SYSFORLOOP3
GLOBAL	SYSFORLOOPEND3
SYSFORLOOPEND3:
;'CLOSE_TRANSACTION_SSD1306
;'MACRO SOURCE: GLCD_SSD1306.H (1305)
;'4WIRE NOT SUPPORTED, SEE WRITE_TRANSACTION_DATA_SSD1306
;'HI2CSTOP
	RCALL	SI2CSTOP
;'END IF
GLOBAL	ENDIF7
ENDIF7:
	RETURN

;'********************************************************************************

;'OVERLOADED SIGNATURE: WORD:WORD:STRING:, SOURCE: GLCD.H (1225)
GLOBAL	GLCDPRINT7
GLCDPRINT7:
;'GLCD.H SUB GLCDPRINT
;'DIM GLCDPRINTLOC  AS WORD
;'DIM GLCDPRINT_STRING_COUNTER, GLCDPRINTLEN AS BYTE
;'GLCDPRINTLEN = LCDPRINTDATA(0)
	MOVFF	SYSLCDPRINTDATAHANDLER,FSR0
	MOVFF	SYSLCDPRINTDATAHANDLER_H,FSR0H
	MOVFF	INDF0,GLCDPRINTLEN
;'IF GLCDPRINTLEN = 0 THEN EXIT SUB
	MOVF	GLCDPRINTLEN,F,ACCESS
	BTFSC	STATUS,2,ACCESS
;'IF GLCDPRINTLEN = 0 THEN EXIT SUB
	RETURN
;'IF GLCDPRINTLEN = 0 THEN EXIT SUB
;'GLCDPRINTLOC = PRINTLOCX
	MOVFF	PRINTLOCX,GLCDPRINTLOC
	MOVFF	PRINTLOCX_H,GLCDPRINTLOC_H
;'WRITE DATA
;'FOR GLCDPRINT_STRING_COUNTER = 1 TO GLCDPRINTLEN
	MOVLW	1
	MOVWF	GLCDPRINT_STRING_COUNTER,ACCESS
GLOBAL	SYSFORLOOP4
SYSFORLOOP4:
;'GLCDDRAWCHAR  GLCDPRINTLOC, PRINTLOCY, LCDPRINTDATA(GLCDPRINT_STRING_COUNTER)
	MOVFF	GLCDPRINTLOC,CHARLOCX
	MOVFF	GLCDPRINTLOC_H,CHARLOCX_H
	MOVFF	PRINTLOCY,CHARLOCY
	MOVFF	PRINTLOCY_H,CHARLOCY_H
	MOVF	GLCDPRINT_STRING_COUNTER,W,ACCESS
	BANKSEL	SYSLCDPRINTDATAHANDLER
	ADDWF	SYSLCDPRINTDATAHANDLER,W,BANKED
	MOVWF	FSR0,ACCESS
	MOVLW	0
	ADDWFC	SYSLCDPRINTDATAHANDLER_H,W,BANKED
	MOVWF	FSR0H,ACCESS
	MOVFF	INDF0,CHARCODE
	MOVFF	GLCDFOREGROUND,LINECOLOUR
	MOVFF	GLCDFOREGROUND_H,LINECOLOUR_H
	BANKSEL	0
	RCALL	GLCDDRAWCHAR_SSD1306
;'GLCDPRINTINCREMENTPIXELPOSITIONMACRO
;'MACRO SOURCE: GLCD.H (1462)
;'GLCDPRINTLOC = GLCDPRINTLOC + ( GLCDFONTWIDTH * GLCDFNTDEFAULTSIZE )+1
	MOVF	GLCDFONTWIDTH,W,ACCESS
	MULWF	GLCDFNTDEFAULTSIZE,ACCESS
	MOVFF	PRODL,SYSTEMP1
	BANKSEL	SYSTEMP1
	MOVF	SYSTEMP1,W,BANKED
	ADDWF	GLCDPRINTLOC,W,ACCESS
	MOVWF	SYSTEMP2,BANKED
	MOVLW	0
	ADDWFC	GLCDPRINTLOC_H,W,ACCESS
	MOVWF	SYSTEMP2_H,BANKED
	MOVLW	1
	ADDWF	SYSTEMP2,W,BANKED
	MOVWF	GLCDPRINTLOC,ACCESS
	MOVLW	0
	ADDWFC	SYSTEMP2_H,W,BANKED
	MOVWF	GLCDPRINTLOC_H,ACCESS
;'NEXT
;'POSITIVE VALUE STEP HANDLER IN FOR-NEXT STATEMENT :#4P 
	MOVF	GLCDPRINT_STRING_COUNTER,W,ACCESS
	SUBWF	GLCDPRINTLEN,W,ACCESS
	MOVWF	SYSTEMP1,BANKED
	MOVFF	SYSTEMP1,SYSBYTETEMPA
	CLRF	SYSBYTETEMPB,ACCESS
	BANKSEL	0
	RCALL	SYSCOMPEQUAL
	COMF	SYSBYTETEMPX,F,ACCESS
	BTFSS	SYSBYTETEMPX,0,ACCESS
	BRA	ENDIF12
;'SET LOOPVAR TO LOOPVAR + STEPVALUE WHERE STEPVALUE IS A POSITIVE VALUE
	INCF	GLCDPRINT_STRING_COUNTER,F,ACCESS
	BRA	SYSFORLOOP4
;'END IF
GLOBAL	ENDIF12
ENDIF12:
GLOBAL	SYSFORLOOPEND4
SYSFORLOOPEND4:
;'UPDATE THE CURRENT X POSITION FOR GLCDPRINTSTRING
;'PRINTLOCX = GLCDPRINTLOC
	MOVFF	GLCDPRINTLOC,PRINTLOCX
	MOVFF	GLCDPRINTLOC_H,PRINTLOCX_H
	RETURN

;'********************************************************************************

;'SOURCE: HWI2C.H (722)
GLOBAL	HI2CINIT
HI2CINIT:
;'ASM SHOWDEBUG  THIS METHOD SETS THE VARIABLE `HI2CCURRENTMODE`, AND, IF REQUIRED CALLS THE METHOD `SI2CINIT` TO SET UP NEW MSSP MODULES - AKA K-MODE FAMILY CHIPS
;'HI2CCURRENTMODE = 0
	CLRF	HI2CCURRENTMODE,ACCESS
;'INITIALISE THE I2C MODULE
;'SI2CINIT
	BRA	SI2CINIT

;'********************************************************************************

;'SOURCE: HWI2C.H (260)
GLOBAL	HI2CMODE
HI2CMODE:
;'ASM SHOWDEBUG  THIS METHOD SETS THE VARIABLE `HI2CCURRENTMODE`, AND, IF REQUIRED, SETS THE SSPCON1.BITS
	RETURN

;'********************************************************************************

;'SOURCE: GLCD_SSD1306.H (332)
GLOBAL	INITGLCD_SSD1306
INITGLCD_SSD1306:
;'COLOURS //SET THESE FIRST
;'GLCDBACKGROUND = 0
	CLRF	GLCDBACKGROUND,ACCESS
	CLRF	GLCDBACKGROUND_H,ACCESS
;'GLCDFOREGROUND = 1
	MOVLW	1
	MOVWF	GLCDFOREGROUND,ACCESS
	CLRF	GLCDFOREGROUND_H,ACCESS
;'GLCDFONTWIDTH = 5
	MOVLW	5
	MOVWF	GLCDFONTWIDTH,ACCESS
;'GLCDFNTDEFAULTHEIGHT = 7  'USED BY GLCDPRINTSTRING AND GLCDPRINTSTRINGLN
	MOVLW	7
	MOVWF	GLCDFNTDEFAULTHEIGHT,ACCESS
;'DIM PRINTLOCX, PRINTLOCY AS WORD
;'GLCDFNTDEFAULT = 0
	CLRF	GLCDFNTDEFAULT,ACCESS
;'GLCDFNTDEFAULTSIZE = 1
	MOVLW	1
	MOVWF	GLCDFNTDEFAULTSIZE,ACCESS
;'WAIT 255 MS             'ADDED TO ENSURE THE CHARGE PUMP AND POWER IS OPERATIONAL.
	SETF	SYSWAITTEMPMS,ACCESS
	CLRF	SYSWAITTEMPMS_H,ACCESS
	CALL	DELAY_MS
;'HI2CMODE MASTER
	MOVLW	12
	MOVWF	HI2CCURRENTMODE,ACCESS
	RCALL	HI2CMODE
;'WAIT 15 MS  'WAIT FOR POWER-UP AND RESET
	MOVLW	15
	MOVWF	SYSWAITTEMPMS,ACCESS
	CLRF	SYSWAITTEMPMS_H,ACCESS
	CALL	DELAY_MS
;'SETUP CODE FOR SSD1306 CONTROLLERS
;'INIT SEQUENCE FOR 128X64 OLED MODULE
;'WRITE_COMMAND_SSD1306(SSD1306_DISPLAYOFF)                    ' 0XAE
	MOVLW	174
	MOVWF	SSD1306SENDBYTE,ACCESS
	RCALL	WRITE_COMMAND_SSD1306
;'WRITE_COMMAND_SSD1306(SSD1306_DEACTIVATE_SCROLL)
	MOVLW	46
	MOVWF	SSD1306SENDBYTE,ACCESS
	RCALL	WRITE_COMMAND_SSD1306
;'WRITE_COMMAND_SSD1306(SSD1306_SETDISPLAYCLOCKDIV)            ' 0XD5
	MOVLW	213
	MOVWF	SSD1306SENDBYTE,ACCESS
	RCALL	WRITE_COMMAND_SSD1306
;'WRITE_COMMAND_SSD1306(0X80)                                  ' THE SUGGESTED RATIO 0X80
	MOVLW	128
	MOVWF	SSD1306SENDBYTE,ACCESS
	RCALL	WRITE_COMMAND_SSD1306
;'WRITE_COMMAND_SSD1306(SSD1306_SETMULTIPLEX)                  ' 0XA8
	MOVLW	168
	MOVWF	SSD1306SENDBYTE,ACCESS
	RCALL	WRITE_COMMAND_SSD1306
;'WRITE_COMMAND_SSD1306(0X3F)                                 '64 PIXELS
	MOVLW	63
	MOVWF	SSD1306SENDBYTE,ACCESS
	RCALL	WRITE_COMMAND_SSD1306
;'WRITE_COMMAND_SSD1306(SSD1306_SETDISPLAYOFFSET)              ' 0XD3
	MOVLW	211
	MOVWF	SSD1306SENDBYTE,ACCESS
	RCALL	WRITE_COMMAND_SSD1306
;'WRITE_COMMAND_SSD1306(0X00)                                   ' NO OFFSET
	CLRF	SSD1306SENDBYTE,ACCESS
	RCALL	WRITE_COMMAND_SSD1306
;'WRITE_COMMAND_SSD1306(SSD1306_SETSTARTLINE | 0X00)            ' LINE #0
	MOVLW	64
	MOVWF	SSD1306SENDBYTE,ACCESS
	RCALL	WRITE_COMMAND_SSD1306
;'WRITE_COMMAND_SSD1306(SSD1306_CHARGEPUMP)                    ' 0X8D
	MOVLW	141
	MOVWF	SSD1306SENDBYTE,ACCESS
	RCALL	WRITE_COMMAND_SSD1306
;'IF (SSD1306_VCCSTATE = SSD1306_EXTERNALVCC) THEN
;'WRITE_COMMAND_SSD1306(0X14)
	MOVLW	20
	MOVWF	SSD1306SENDBYTE,ACCESS
	RCALL	WRITE_COMMAND_SSD1306
;'END IF
;'WRITE_COMMAND_SSD1306(SSD1306_MEMORYMODE)                    ' 0X20
	MOVLW	32
	MOVWF	SSD1306SENDBYTE,ACCESS
	RCALL	WRITE_COMMAND_SSD1306
;'WRITE_COMMAND_SSD1306(0X00)                                  ' 0X00 ACT LIKE KS0108 - DO NOT SELECT!!
;'WRITE_COMMAND_SSD1306(0X10)                                  ' 0X01 ACT LIKE PCD8544
	MOVLW	16
	MOVWF	SSD1306SENDBYTE,ACCESS
	RCALL	WRITE_COMMAND_SSD1306
;'WRITE_COMMAND_SSD1306(SSD1306_SEGREMAP | 0X1)
	MOVLW	161
	MOVWF	SSD1306SENDBYTE,ACCESS
	RCALL	WRITE_COMMAND_SSD1306
;'WRITE_COMMAND_SSD1306(SSD1306_COMSCANDEC)
	MOVLW	200
	MOVWF	SSD1306SENDBYTE,ACCESS
	RCALL	WRITE_COMMAND_SSD1306
;'WRITE_COMMAND_SSD1306(SSD1306_SETCOMPINS)                    ' 0XDA
	MOVLW	218
	MOVWF	SSD1306SENDBYTE,ACCESS
	RCALL	WRITE_COMMAND_SSD1306
;'WRITE_COMMAND_SSD1306(0X12)                                 '64 PIXELS
	MOVLW	18
	MOVWF	SSD1306SENDBYTE,ACCESS
	RCALL	WRITE_COMMAND_SSD1306
;'WRITE_COMMAND_SSD1306(SSD1306_SETCONTRAST)                   ' 0X81
	MOVLW	129
	MOVWF	SSD1306SENDBYTE,ACCESS
	RCALL	WRITE_COMMAND_SSD1306
;'IF SSD1306_VCCSTATE = SSD1306_EXTERNALVCC THEN
;'WRITE_COMMAND_SSD1306(0XCF)
	MOVLW	207
	MOVWF	SSD1306SENDBYTE,ACCESS
	RCALL	WRITE_COMMAND_SSD1306
;'END IF
;'WRITE_COMMAND_SSD1306(SSD1306_SETPRECHARGE)                  ' 0XD9
	MOVLW	217
	MOVWF	SSD1306SENDBYTE,ACCESS
	RCALL	WRITE_COMMAND_SSD1306
;'IF SSD1306_VCCSTATE = SSD1306_EXTERNALVCC THEN
;'WRITE_COMMAND_SSD1306(0XF1)
	MOVLW	241
	MOVWF	SSD1306SENDBYTE,ACCESS
	RCALL	WRITE_COMMAND_SSD1306
;'END IF
;'WRITE_COMMAND_SSD1306(SSD1306_SETVCOMDETECT)                 ' 0XDB
	MOVLW	219
	MOVWF	SSD1306SENDBYTE,ACCESS
	RCALL	WRITE_COMMAND_SSD1306
;'WRITE_COMMAND_SSD1306(0X40)
	MOVLW	64
	MOVWF	SSD1306SENDBYTE,ACCESS
	RCALL	WRITE_COMMAND_SSD1306
;'WRITE_COMMAND_SSD1306(SSD1306_DISPLAYALLON_RESUME)           ' 0XA4
	MOVLW	164
	MOVWF	SSD1306SENDBYTE,ACCESS
	RCALL	WRITE_COMMAND_SSD1306
;'WRITE_COMMAND_SSD1306(SSD1306_NORMALDISPLAY)                 ' 0XA6
	MOVLW	166
	MOVWF	SSD1306SENDBYTE,ACCESS
	RCALL	WRITE_COMMAND_SSD1306
;'CLEAR SCREEN HERE
;'GLCDCLS_SSD1306
	CALL	GLCDCLS_SSD1306
;'WRITE_COMMAND_SSD1306(SSD1306_DISPLAYON)                     '--TURN ON OLED PANEL
	MOVLW	175
	MOVWF	SSD1306SENDBYTE,ACCESS
	BRA	WRITE_COMMAND_SSD1306

;'********************************************************************************

;'SOURCE: 210_I2C_GLCD_SPRITES_USING_SSD1306.GCB (30)
GLOBAL	INITPPS
INITPPS:
;'MODULE: I2C1
;'RB6PPS = 0X001C    // SCL1 > RB6
	MOVLW	28
	BANKSEL	RB6PPS
	MOVWF	RB6PPS,BANKED
;'I2C1SCLPPS = 0X000E    // RB6 > SCL1 (BI-DIRECTIONAL)
	MOVLW	14
	MOVWF	I2C1SCLPPS,BANKED
;'RB5PPS = 0X001D    // SDA1 > RB5
	MOVLW	29
	MOVWF	RB5PPS,BANKED
;'I2C1SDAPPS = 0X000D    // RB5 > SDA1 (BI-DIRECTIONAL)
	MOVLW	13
	MOVWF	I2C1SDAPPS,BANKED
;'MODULE: UART PIN DIRECTIONS
;'DIR PORTB.7 OUT    // MAKE TX1 PIN AN OUTPUT
	BCF	TRISB,7,ACCESS
;'MODULE: UART1
;'RB7PPS = 0X0013    // TX1 > RB7
	MOVLW	19
	MOVWF	RB7PPS,BANKED
	BANKSEL	0
	RETURN

;'********************************************************************************

;'SOURCE: RANDOM.H (35)
GLOBAL	INITRANDOM
INITRANDOM:
;'DIM RANDOMSEED AS WORD
;'RANDOMSEED = RANDSTART
	MOVLW	61
	MOVWF	RANDOMSEED,ACCESS
	MOVLW	138
	MOVWF	RANDOMSEED_H,ACCESS
	RETURN

;'********************************************************************************

;'SOURCE: SYSTEM.H (177)
GLOBAL	INITSYS
INITSYS:
;'CLEAR BSR
;'MOVLB 0
	MOVLB	0
;'ASM SHOWDEBUG DEFAULT SETTINGS FOR MICROCONTROLLERS WITH _OSCCON1_
	;DEFAULT	OSCCON1,NOSC HFINTOSC; NDIV 1 - COMMON AS THIS SIMPLY SETS THE HFINTOSC
;'OSCCON1 = 0X60
	MOVLW	96
	MOVWF	OSCCON1,BANKED
;'DEFAULT VALUE TYPICALLY, CSWHOLD MAY PROCEED; SOSCPWR LOW POWER
;'OSCCON3 = 0X00
	CLRF	OSCCON3,BANKED
;'DEFAULT VALUE TYPICALLY, MFOEN DISABLED; LFOEN DISABLED; ADOEN DISABLED; SOSCEN DISABLED; EXTOEN DISABLED; HFOEN DISABLED
;'OSCEN = 0X00
	CLRF	OSCEN,BANKED
;'DEFAULT VALUE
;'OSCTUNE = 0X00
	CLRF	OSCTUNE,BANKED
;'ASM SHOWDEBUG THE MCU IS A CHIP FAMILY 16
;'SECTION SUPPORTS MANY MCUS, 18FXXK40, 18FXXK42 ETC THAT HAVE NDIV3 BIT
;'ASM SHOWDEBUG OSCCON TYPE IS 101
;'OSCCON1 = 0X60          // SETTING OSCCON1 IMPLIES CLEARING CLEAR NDIV3:0
	MOVLW	96
	MOVWF	OSCCON1,BANKED
;'OSCFRQ = 0B00001000  '64MHZ
	MOVLW	8
	MOVWF	OSCFRQ,BANKED
;'ASM SHOWDEBUG _COMPLETE_THE_CHIP_SETUP_OF_BSR_ADCS_ANSEL_AND_OTHER_KEY_SETUP_REGISTERS_OR_REGISTER_BITS
;'CLEAR TBLPTRU
;'TBLPTRU = 0
	CLRF	TBLPTRU,ACCESS
;'ENSURE ALL PORTS ARE SET FOR DIGITAL I/O AND, TURN OFF A/D
;'SET ADFM OFF
	BANKSEL	ADCON0
	BCF	ADCON0,2,BANKED
;'SWITCH OFF A/D VAR(ADCON0)
;'SET ADCON0.ADON OFF
	BCF	ADCON0,7,BANKED
;'ANSELA = 0
	BANKSEL	ANSELA
	CLRF	ANSELA,BANKED
;'ANSELB = 0
	CLRF	ANSELB,BANKED
;'ANSELC = 0
	CLRF	ANSELC,BANKED
;'TURN OFF ALL PORTS
;'PORTA = 0
	CLRF	PORTA,ACCESS
;'PORTB = 0
	CLRF	PORTB,ACCESS
;'PORTC = 0
	CLRF	PORTC,ACCESS
	BANKSEL	0
	RETURN

;'********************************************************************************

;'SOURCE: GLCD_SSD1306.H (898)
GLOBAL	PSET_SSD1306
PSET_SSD1306:
;'SET PIXEL AT X, Y ON LCD TO STATE
;'X IS 0 TO 127
;'Y IS 0 TO 63
;'ORIGIN IN TOP LEFT
;'ANYTHING OFF SCREEN WITH BE REJECTED
;'IF GLCDX => GLCD_WIDTH OR GLCDY => GLCD_HEIGHT THEN
	MOVFF	GLCDX,SYSBYTETEMPA
	MOVLW	128
	MOVWF	SYSBYTETEMPB,ACCESS
	RCALL	SYSCOMPLESSTHAN
	COMF	SYSBYTETEMPX,F,ACCESS
	MOVFF	SYSBYTETEMPX,SYSTEMP3
	MOVFF	GLCDY,SYSBYTETEMPA
	MOVLW	64
	MOVWF	SYSBYTETEMPB,ACCESS
	RCALL	SYSCOMPLESSTHAN
	COMF	SYSBYTETEMPX,F,ACCESS
	BANKSEL	SYSTEMP3
	MOVF	SYSTEMP3,W,BANKED
	IORWF	SYSBYTETEMPX,W,ACCESS
	MOVWF	SYSTEMP1,BANKED
	BTFSS	SYSTEMP1,0,BANKED
	BRA	ENDIF46
;'EXIT SUB
	BANKSEL	0
	RETURN
;'END IF
GLOBAL	ENDIF46
ENDIF46:
;'1.14 ADDRESSES CORRECT DEVICE HORIZONAL PAGE
;'DON'T NEED TO DO THESE CALCULATIONS FOR IN LOWMEMORY_GLCD_MODE
;'SSD1306_BUFFERLOCATIONCALC = ( GLCDY / 8 )* GLCD_WIDTH
;'FASTER THAN /8
;'SSD1306_BUFFERLOCATIONCALC = GLCDY
	MOVFF	GLCDY,SSD1306_BUFFERLOCATIONCALC
	CLRF	SSD1306_BUFFERLOCATIONCALC_H,ACCESS
;'REPEAT 3
	MOVLW	3
	MOVWF	SYSREPEATTEMP6,BANKED
GLOBAL	SYSREPEATLOOP6
SYSREPEATLOOP6:
;'SET C OFF
	BCF	STATUS,0,ACCESS
;'ROTATE SSD1306_BUFFERLOCATIONCALC RIGHT
	RRCF	SSD1306_BUFFERLOCATIONCALC_H,F,ACCESS
	RRCF	SSD1306_BUFFERLOCATIONCALC,F,ACCESS
;'END REPEAT
	DECFSZ	SYSREPEATTEMP6,F,BANKED
	BRA	SYSREPEATLOOP6
GLOBAL	SYSREPEATLOOPEND6
SYSREPEATLOOPEND6:
;'FASTER THAN * 128
;'SET C OFF
	BCF	STATUS,0,ACCESS
;'REPEAT 7
	MOVLW	7
	MOVWF	SYSREPEATTEMP6,BANKED
GLOBAL	SYSREPEATLOOP7
SYSREPEATLOOP7:
;'ROTATE SSD1306_BUFFERLOCATIONCALC LEFT
	RLCF	SSD1306_BUFFERLOCATIONCALC,F,ACCESS
	RLCF	SSD1306_BUFFERLOCATIONCALC_H,F,ACCESS
;'END REPEAT
	DECFSZ	SYSREPEATTEMP6,F,BANKED
	BRA	SYSREPEATLOOP7
GLOBAL	SYSREPEATLOOPEND7
SYSREPEATLOOPEND7:
;'SSD1306_BUFFERLOCATIONCALC = GLCDX + SSD1306_BUFFERLOCATIONCALC + 1
	MOVF	SSD1306_BUFFERLOCATIONCALC,W,ACCESS
	ADDWF	GLCDX,W,ACCESS
	MOVWF	SYSTEMP1,BANKED
	CLRF	SYSTEMP3,BANKED
	MOVF	SSD1306_BUFFERLOCATIONCALC_H,W,ACCESS
	ADDWFC	SYSTEMP3,W,BANKED
	MOVWF	SYSTEMP1_H,BANKED
	MOVLW	1
	ADDWF	SYSTEMP1,W,BANKED
	MOVWF	SSD1306_BUFFERLOCATIONCALC,ACCESS
	MOVLW	0
	ADDWFC	SYSTEMP1_H,W,BANKED
	MOVWF	SSD1306_BUFFERLOCATIONCALC_H,ACCESS
;'ANYTHING BEYOND BUFFER BOUNDARY?
;'WHY? X = 127 AND Y = 64 (Y IS OVER 63!) WILL HAVE PASSED FIRST CHECK....
;'IF SSD1306_BUFFERLOCATIONCALC > GLCD_HEIGHT * GLCD_WIDTH THEN
	MOVFF	SSD1306_BUFFERLOCATIONCALC,SYSWORDTEMPB
	MOVFF	SSD1306_BUFFERLOCATIONCALC_H,SYSWORDTEMPB_H
	CLRF	SYSWORDTEMPA,ACCESS
	MOVLW	32
	MOVWF	SYSWORDTEMPA_H,ACCESS
	BANKSEL	0
	RCALL	SYSCOMPLESSTHAN16
	BTFSC	SYSBYTETEMPX,0,ACCESS
;'EXIT SUB
	RETURN
;'END IF
;'GLCDDATATEMP = SSD1306_BUFFERALIAS(SSD1306_BUFFERLOCATIONCALC)
	LFSR	0,SSD1306_BUFFERALIAS
	MOVF	SSD1306_BUFFERLOCATIONCALC,W,ACCESS
	ADDWF	FSR0,F,ACCESS
	MOVF	SSD1306_BUFFERLOCATIONCALC_H,W,ACCESS
	ADDWFC	FSR0H,F,ACCESS
	MOVFF	INDF0,GLCDDATATEMP
;'CHANGE DATA TO SET/CLEAR PIXEL
;'GLCDBITNO = GLCDY AND 7
	MOVLW	7
	ANDWF	GLCDY,W,ACCESS
	MOVWF	GLCDBITNO,ACCESS
;'IF GLCDCOLOUR.0 = 0 THEN
	BTFSC	GLCDCOLOUR,0,ACCESS
	BRA	ELSE48_1
;'GLCDCHANGE = 254
	MOVLW	254
	MOVWF	GLCDCHANGE,ACCESS
;'SET C ON
	BSF	STATUS,0,ACCESS
;'ELSE
	BRA	ENDIF48
GLOBAL	ELSE48_1
ELSE48_1:
;'GLCDCHANGE = 1
	MOVLW	1
	MOVWF	GLCDCHANGE,ACCESS
;'SET C OFF
	BCF	STATUS,0,ACCESS
;'END IF
GLOBAL	ENDIF48
ENDIF48:
;'REPEAT GLCDBITNO
	MOVFF	GLCDBITNO,SYSREPEATTEMP6
	BANKSEL	SYSREPEATTEMP6
	MOVF	SYSREPEATTEMP6,F,BANKED
	BTFSC	STATUS,2,ACCESS
	BRA	SYSREPEATLOOPEND8
GLOBAL	SYSREPEATLOOP8
SYSREPEATLOOP8:
;'ROTATE GLCDCHANGE LEFT
	RLCF	GLCDCHANGE,F,ACCESS
;'END REPEAT
	DECFSZ	SYSREPEATTEMP6,F,BANKED
	BRA	SYSREPEATLOOP8
GLOBAL	SYSREPEATLOOPEND8
SYSREPEATLOOPEND8:
;'IF GLCDCOLOUR.0 = 0 THEN
	BTFSC	GLCDCOLOUR,0,ACCESS
	BRA	ELSE49_1
;'GLCDDATATEMP = GLCDDATATEMP AND GLCDCHANGE
	MOVF	GLCDDATATEMP,W,ACCESS
	ANDWF	GLCDCHANGE,W,ACCESS
	MOVWF	GLCDDATATEMP,ACCESS
;'ELSE
	BRA	ENDIF49
GLOBAL	ELSE49_1
ELSE49_1:
;'GLCDDATATEMP = GLCDDATATEMP OR GLCDCHANGE
	MOVF	GLCDDATATEMP,W,ACCESS
	IORWF	GLCDCHANGE,W,ACCESS
	MOVWF	GLCDDATATEMP,ACCESS
;'END IF
GLOBAL	ENDIF49
ENDIF49:
;'ADDED 1.14 TO ISOLATE FROM FULL GLCD MODE
;'REVISED 1.14 TO ISOLATE FROM LOW MEMORY MODE
;'IF SSD1306_BUFFERALIAS(SSD1306_BUFFERLOCATIONCALC) <> GLCDDATATEMP THEN
	LFSR	0,SSD1306_BUFFERALIAS
	MOVF	SSD1306_BUFFERLOCATIONCALC,W,ACCESS
	ADDWF	FSR0,F,ACCESS
	MOVF	SSD1306_BUFFERLOCATIONCALC_H,W,ACCESS
	ADDWFC	FSR0H,F,ACCESS
	MOVF	GLCDDATATEMP,W,ACCESS
	SUBWF	INDF0,W,ACCESS
	BTFSC	STATUS,2,ACCESS
	BRA	ENDIF50
;'SSD1306_BUFFERALIAS(SSD1306_BUFFERLOCATIONCALC) = GLCDDATATEMP
	LFSR	0,SSD1306_BUFFERALIAS
	MOVF	SSD1306_BUFFERLOCATIONCALC,W,ACCESS
	ADDWF	FSR0,F,ACCESS
	MOVF	SSD1306_BUFFERLOCATIONCALC_H,W,ACCESS
	ADDWFC	FSR0H,F,ACCESS
	MOVFF	GLCDDATATEMP,INDF0
;'CURSOR_POSITION_SSD1306 ( GLCDX, GLCDY )
	MOVFF	GLCDX,LOCX
	MOVFF	GLCDY,LOCY
	BANKSEL	0
	CALL	CURSOR_POSITION_SSD1306
;'WRITE_DATA_SSD1306 ( GLCDDATATEMP )
	MOVFF	GLCDDATATEMP,SSD1306SENDBYTE
	RCALL	WRITE_DATA_SSD1306
;'END IF
GLOBAL	ENDIF50
ENDIF50:
	BANKSEL	0
	RETURN

;'********************************************************************************

;'SOURCE: RANDOM.H (41)
GLOBAL	FN_RANDOM
FN_RANDOM:
;'REPEAT 7
	MOVLW	7
	BANKSEL	SYSREPEATTEMP5
	MOVWF	SYSREPEATTEMP5,BANKED
GLOBAL	SYSREPEATLOOP5
SYSREPEATLOOP5:
;'DIM RANDOMTEMP AS WORD
;'DIM RANDOMSEED AS WORD
;'RANDOMTEMP = RANDOMSEED
	MOVFF	RANDOMSEED,RANDOMTEMP
	MOVFF	RANDOMSEED_H,RANDOMTEMP_H
;'ROTATE RANDOMTEMP LEFT SIMPLE
	RLCF	RANDOMTEMP_H,W,ACCESS
	RLCF	RANDOMTEMP,F,ACCESS
	RLCF	RANDOMTEMP_H,F,ACCESS
;'TAPS AT 16, 15, 13, 11, AND WITH B'1101 0100 0000 0000' = D800
;'EXPANDED BELOW CALCULATION TO REDUCE COMPLEXITY OF CALC
;'RANDOMSEED = RANDOMTEMP XOR (NOT (RANDOMSEED AND 1) + 1 AND 0XB400)
	MOVLW	1
	ANDWF	RANDOMSEED,W,ACCESS
	MOVWF	SYSTEMP2,BANKED
	CLRF	SYSTEMP2_H,BANKED
	COMF	SYSTEMP2,W,BANKED
	MOVWF	SYSTEMP1,BANKED
	COMF	SYSTEMP2_H,W,BANKED
	MOVWF	SYSTEMP1_H,BANKED
	MOVLW	1
	ADDWF	SYSTEMP1,W,BANKED
	MOVWF	SYSTEMP2,BANKED
	MOVLW	0
	ADDWFC	SYSTEMP1_H,W,BANKED
	MOVWF	SYSTEMP2_H,BANKED
	CLRF	SYSTEMP1,BANKED
	MOVLW	180
	ANDWF	SYSTEMP2_H,W,BANKED
	MOVWF	SYSTEMP1_H,BANKED
	MOVF	RANDOMTEMP,W,ACCESS
	XORWF	SYSTEMP1,W,BANKED
	MOVWF	RANDOMSEED,ACCESS
	MOVF	RANDOMTEMP_H,W,ACCESS
	XORWF	SYSTEMP1_H,W,BANKED
	MOVWF	RANDOMSEED_H,ACCESS
;'EXPANDED BELOW CALCULATION TO REDUCE COMPLEXITY OF CALC
;'RANDOMSEED = NOT (RANDOMSEED AND 1) + 1
;'RANDOMSEED = RANDOMSEED AND 0XB400
;'RANDOMSEED = RANDOMTEMP XOR RANDOMSEED
;'RANDOM = RANDOM XOR RANDOMSEED_H
	MOVF	RANDOM,W,ACCESS
	XORWF	RANDOMSEED_H,W,ACCESS
	MOVWF	RANDOM,ACCESS
;'END REPEAT
	DECFSZ	SYSREPEATTEMP5,F,BANKED
	BRA	SYSREPEATLOOP5
GLOBAL	SYSREPEATLOOPEND5
SYSREPEATLOOPEND5:
	BANKSEL	0
	RETURN

;'********************************************************************************

;'SOURCE: HWI2C.H (802)
GLOBAL	SI2CINIT
SI2CINIT:
;'ASM SHOWDEBUG  THIS METHOD SETS THE MSSP MODULES FOR K-MODE FAMILY CHIPS
;'DIR HI2C_DATA OUT
	BCF	TRISB,5,ACCESS
;'DIR HI2C_CLOCK OUT
	BCF	TRISB,6,ACCESS
;'I2C1CON1 = I2C1I2C1CON1DEFAULT
	MOVLW	128
	BANKSEL	I2C1CON1
	MOVWF	I2C1CON1,BANKED
;'I2C1CON2 = I2C1I2C1CON2DEFAULT
	MOVLW	33
	MOVWF	I2C1CON2,BANKED
;'I2C1CLK =  I2C1CLOCKSOURCE
	MOVLW	3
	MOVWF	I2C1CLK,BANKED
;'I2C1CON0 = I2C1I2C1CON0DEFAULT
	MOVLW	132
	MOVWF	I2C1CON0,BANKED
;'I2C1PIR = 0    ;CLEAR ALL THE ERROR FLAGS
	CLRF	I2C1PIR,BANKED
;'I2C1ERR = 0
	CLRF	I2C1ERR,BANKED
;'I2C1CON0.EN=1
	BSF	I2C1CON0,7,BANKED
;'COMMENCE I2C PROTOCOL
;'I2C1CON2.ACNT = 0
	BCF	I2C1CON2,7,BANKED
;'I2C1CON2.ABD=0
	BCF	I2C1CON2,4,BANKED
;'I2C1CON0.MDR=1
	BSF	I2C1CON0,3,BANKED
;'INITIALISE CORRECT STATE OF I2C MODULE. NOT SURE WHY THIS IS NEEDED BUT IT IS. MICROCHIP FAILED TO EXPLAIN WHY THIS IS REQUIRED. BUT, IT IS.
;'SI2CSTART
	BANKSEL	0
	RCALL	SI2CSTART
;'SI2CSEND ( 0XFF )
	SETF	I2CBYTE,ACCESS
	RCALL	SI2CSEND
;'SI2CSTOP
	RCALL	SI2CSTOP
;'HI2CCURRENTMODE = 0
	CLRF	HI2CCURRENTMODE,ACCESS
	RETURN

;'********************************************************************************

;'SOURCE: HWI2C.H (879)
GLOBAL	SI2CSEND
SI2CSEND:
;'ASM SHOWDEBUG  REDIRECTED FOR K-MODE FAMILY PROBALBY CALLED HI2CSEND
;'ASM SHOWDEBUG  THIS METHOD SETS THE REGISTERS AND REGISTER BITS TO SEND I2C DATA
;'THIS IS NOW A STATE MACHINE TO CATER FOR THE NEW APPROACH WITH THE I2C MODULE
;'SELECT CASE HI2C1STATEMACHINE
;'CASE 2  'SEND DATA
GLOBAL	SYSSELECT4CASE1
SYSSELECT4CASE1:
	MOVLW	2
	SUBWF	HI2C1STATEMACHINE,W,ACCESS
	BTFSS	STATUS,2,ACCESS
	BRA	SYSSELECT4CASE2
;'HI2CWAITMSSPTIMEOUT = 0
	CLRF	HI2CWAITMSSPTIMEOUT,ACCESS
;'WAITS UP TO 254US THEN CREATES ERROR MESSAGE
;'DO WHILE HI2CWAITMSSPTIMEOUT < 255
GLOBAL	SYSDOLOOP_S3
SYSDOLOOP_S3:
	MOVLW	255
	SUBWF	HI2CWAITMSSPTIMEOUT,W,ACCESS
	BTFSC	STATUS,0,ACCESS
	BRA	SYSDOLOOP_E3
;'HI2CWAITMSSPTIMEOUT++
	INCF	HI2CWAITMSSPTIMEOUT,F,ACCESS
;'WAIT FOR THIS EVENT
;'IF I2C1STAT1.TXBE = 1 THEN
	BANKSEL	I2C1STAT1
	BTFSS	I2C1STAT1,5,BANKED
	BRA	ELSE19_1
;'SET THE BYTE COUNT TO 1, PLACE OUTBYTE IN REGISTER, AND WAIT FOR HARDWARE STATE MACHINE
;'I2C1CNT = 1
	MOVLW	1
	MOVWF	I2C1CNT,BANKED
;'I2C1TXB = I2CBYTE
	MOVFF	I2CBYTE,I2C1TXB
;'SI2CWAIT4ACK
	BANKSEL	0
	RCALL	SI2CWAIT4ACK
;'SI2CWAIT4MDR
	RCALL	SI2CWAIT4MDR
;'EXIT SUB
	RETURN
;'ELSE
	BRA	ENDIF19
GLOBAL	ELSE19_1
ELSE19_1:
;'WAIT 1 US
	MOVLW	5
	MOVWF	DELAYTEMP,ACCESS
GLOBAL	DELAYUS4
DELAYUS4:
	DECFSZ	DELAYTEMP,F,ACCESS
	BRA	DELAYUS4
;'END IF
GLOBAL	ENDIF19
ENDIF19:
;'LOOP
	BRA	SYSDOLOOP_S3
GLOBAL	SYSDOLOOP_E3
SYSDOLOOP_E3:
;'IF HI2CWAITMSSPTIMEOUT = 255 THEN HI2C1LASTERROR = HI2C1LASTERROR OR I2C1_TXBE_TIMEOUT
	INCF	HI2CWAITMSSPTIMEOUT,W,ACCESS
	BTFSS	STATUS,2,ACCESS
	BRA	ENDIF20
;'IF HI2CWAITMSSPTIMEOUT = 255 THEN HI2C1LASTERROR = HI2C1LASTERROR OR I2C1_TXBE_TIMEOUT
	MOVLW	2
	IORWF	HI2C1LASTERROR,F,ACCESS
;'IF HI2CWAITMSSPTIMEOUT = 255 THEN HI2C1LASTERROR = HI2C1LASTERROR OR I2C1_TXBE_TIMEOUT
GLOBAL	ENDIF20
ENDIF20:
;'CASE 1  'A START
	BRA	SYSSELECTEND4
GLOBAL	SYSSELECT4CASE2
SYSSELECT4CASE2:
	DECF	HI2C1STATEMACHINE,W,ACCESS
	BTFSS	STATUS,2,ACCESS
	BRA	SYSSELECT4CASE3
;'CLEAR THE OUTPUT BUFFERS, SET BYTE COUNT TO ZERO, CLEAR EVENT AND PLACE SLAVE ADDRESS IN REGISTER
;'I2C1STAT1.CLRBF = 1
	BANKSEL	I2C1STAT1
	BSF	I2C1STAT1,2,BANKED
;'I2C1CNT = 0
	CLRF	I2C1CNT,BANKED
;'I2C1PIR.SCIF = 0
	BCF	I2C1PIR,0,BANKED
;'I2C1ADB1 = I2CBYTE
	MOVFF	I2CBYTE,I2C1ADB1
;'SET TO START
;'I2C1CON0.S = 1
	BSF	I2C1CON0,5,BANKED
;'HI2CWAITMSSPTIMEOUT = 0
	CLRF	HI2CWAITMSSPTIMEOUT,ACCESS
;'WAITS UP TO 254US THEN CREATES ERROR MESSAGE
;'DO WHILE HI2CWAITMSSPTIMEOUT < 255
GLOBAL	SYSDOLOOP_S4
SYSDOLOOP_S4:
	MOVLW	255
	SUBWF	HI2CWAITMSSPTIMEOUT,W,ACCESS
	BTFSC	STATUS,0,ACCESS
	BRA	SYSDOLOOP_E4
;'HI2CWAITMSSPTIMEOUT++
	INCF	HI2CWAITMSSPTIMEOUT,F,ACCESS
;'WAIT FOR THIS EVENT
;'IF I2C1PIR.SCIF = 1 THEN
	BTFSS	I2C1PIR,0,BANKED
	BRA	ELSE21_1
;'WAIT HI2CITSCLWAITPERIOD US
	MOVLW	2
	MOVWF	DELAYTEMP2,ACCESS
GLOBAL	DELAYUSO5
DELAYUSO5:
	CLRF	DELAYTEMP,ACCESS
GLOBAL	DELAYUS5
DELAYUS5:
	DECFSZ	DELAYTEMP,F,ACCESS
	BRA	DELAYUS5
	DECFSZ	DELAYTEMP2,F,ACCESS
	BRA	DELAYUSO5
	MOVLW	19
	MOVWF	DELAYTEMP,ACCESS
GLOBAL	DELAYUS6
DELAYUS6:
	DECFSZ	DELAYTEMP,F,ACCESS
	BRA	DELAYUS6
;'HI2C1STATEMACHINE = 2  'SET STATE MACHINE TO SEND DATA
	MOVLW	2
	MOVWF	HI2C1STATEMACHINE,ACCESS
;'HI2CACKPOLLSTATE = I2C1CON1.5
	CLRF	HI2CACKPOLLSTATE,ACCESS
	BTFSC	I2C1CON1,5,BANKED
	INCF	HI2CACKPOLLSTATE,F,ACCESS
;'EXIT SUB
	BANKSEL	0
	RETURN
;'ELSE
	BRA	ENDIF21
GLOBAL	ELSE21_1
ELSE21_1:
;'WAIT 1 US
	MOVLW	5
	MOVWF	DELAYTEMP,ACCESS
GLOBAL	DELAYUS7
DELAYUS7:
	DECFSZ	DELAYTEMP,F,ACCESS
	BRA	DELAYUS7
;'END IF
GLOBAL	ENDIF21
ENDIF21:
;'LOOP
	BRA	SYSDOLOOP_S4
GLOBAL	SYSDOLOOP_E4
SYSDOLOOP_E4:
;'IF HI2CWAITMSSPTIMEOUT = 255 THEN HI2C1LASTERROR = HI2C1LASTERROR OR I2C1_START_TIMEOUT
	INCF	HI2CWAITMSSPTIMEOUT,W,ACCESS
	BTFSS	STATUS,2,ACCESS
	BRA	ENDIF22
;'IF HI2CWAITMSSPTIMEOUT = 255 THEN HI2C1LASTERROR = HI2C1LASTERROR OR I2C1_START_TIMEOUT
	MOVLW	4
	IORWF	HI2C1LASTERROR,F,ACCESS
;'IF HI2CWAITMSSPTIMEOUT = 255 THEN HI2C1LASTERROR = HI2C1LASTERROR OR I2C1_START_TIMEOUT
GLOBAL	ENDIF22
ENDIF22:
;'CASE 3  'A RESTART
	BRA	SYSSELECTEND4
GLOBAL	SYSSELECT4CASE3
SYSSELECT4CASE3:
	MOVLW	3
	SUBWF	HI2C1STATEMACHINE,W,ACCESS
	BTFSS	STATUS,2,ACCESS
	BRA	SYSSELECTEND4
;'WAIT FOR HARDWARE MACHINE TO SETTLE
;'WAIT WHILE I2C1STAT0.MMA = 1
GLOBAL	SYSWAITLOOP1
SYSWAITLOOP1:
	BANKSEL	I2C1STAT0
	BTFSC	I2C1STAT0,5,BANKED
	BRA	SYSWAITLOOP1
;'SET COUNT TO ZERO, PLACE SLAVE ADDRESS IN REGISTER AND CLEAR EVENT
;'I2C1CNT = 0
	CLRF	I2C1CNT,BANKED
;'I2C1ADB1 = I2CBYTE
	MOVFF	I2CBYTE,I2C1ADB1
;'I2C1PIR.SCIF = 0
	BCF	I2C1PIR,0,BANKED
;'HI2CWAITMSSPTIMEOUT = 0
	CLRF	HI2CWAITMSSPTIMEOUT,ACCESS
;'WAITS UP TO 254US THEN CREATES ERROR MESSAGE
;'DO WHILE HI2CWAITMSSPTIMEOUT < 255
GLOBAL	SYSDOLOOP_S5
SYSDOLOOP_S5:
	MOVLW	255
	SUBWF	HI2CWAITMSSPTIMEOUT,W,ACCESS
	BTFSC	STATUS,0,ACCESS
	BRA	SYSDOLOOP_E5
;'HI2CWAITMSSPTIMEOUT++
	INCF	HI2CWAITMSSPTIMEOUT,F,ACCESS
;'WAIT FOR THIS EVENT
;'IF I2C1PIR.SCIF = 1 THEN
	BTFSS	I2C1PIR,0,BANKED
	BRA	ELSE23_1
;'HI2C1STATEMACHINE = 2  'SET STATE MACHINE TO SEND DATA
	MOVLW	2
	MOVWF	HI2C1STATEMACHINE,ACCESS
;'HI2CACKPOLLSTATE = I2C1CON1.5
	CLRF	HI2CACKPOLLSTATE,ACCESS
	BTFSC	I2C1CON1,5,BANKED
	INCF	HI2CACKPOLLSTATE,F,ACCESS
;'EXIT SUB
	BANKSEL	0
	RETURN
;'ELSE
	BRA	ENDIF23
GLOBAL	ELSE23_1
ELSE23_1:
;'SET AS START AND CLEAR RESTART
;'I2C1CON0.S = 1
	BSF	I2C1CON0,5,BANKED
;'I2C1CON0.RSEN=0
	BCF	I2C1CON0,6,BANKED
;'WAIT 1 US
	MOVLW	5
	MOVWF	DELAYTEMP,ACCESS
GLOBAL	DELAYUS8
DELAYUS8:
	DECFSZ	DELAYTEMP,F,ACCESS
	BRA	DELAYUS8
;'END IF
GLOBAL	ENDIF23
ENDIF23:
;'LOOP
	BRA	SYSDOLOOP_S5
GLOBAL	SYSDOLOOP_E5
SYSDOLOOP_E5:
;'IF HI2CWAITMSSPTIMEOUT = 255 THEN HI2C1LASTERROR = HI2C1LASTERROR OR I2C1_RESTART_TIMEOUT
	INCF	HI2CWAITMSSPTIMEOUT,W,ACCESS
	BTFSS	STATUS,2,ACCESS
	BRA	ENDIF24
;'IF HI2CWAITMSSPTIMEOUT = 255 THEN HI2C1LASTERROR = HI2C1LASTERROR OR I2C1_RESTART_TIMEOUT
	MOVLW	8
	IORWF	HI2C1LASTERROR,F,ACCESS
;'IF HI2CWAITMSSPTIMEOUT = 255 THEN HI2C1LASTERROR = HI2C1LASTERROR OR I2C1_RESTART_TIMEOUT
GLOBAL	ENDIF24
ENDIF24:
;'END SELECT
GLOBAL	SYSSELECTEND4
SYSSELECTEND4:
	BANKSEL	0
	RETURN

;'********************************************************************************

;'SOURCE: HWI2C.H (831)
GLOBAL	SI2CSTART
SI2CSTART:
;'ASM SHOWDEBUG  REDIRECTED FOR K-MODE FAMILY PROBALBY CALLED HI2CSTART
;'ASM SHOWDEBUG  THIS METHOD SETS THE REGISTERS AND REGISTER BITS TO GENERATE THE I2C  START SIGNAL. MASTER_MODE ONLY.
;'HI2C1STATEMACHINE = 1
	MOVLW	1
	MOVWF	HI2C1STATEMACHINE,ACCESS
;'HI2CWAITMSSPTIMEOUT = FALSE
	CLRF	HI2CWAITMSSPTIMEOUT,ACCESS
;'CLEAR THE ERROR STATE VARIABLE
;'HI2C1LASTERROR = I2C1_GOOD
	CLRF	HI2C1LASTERROR,ACCESS
	RETURN

;'********************************************************************************

;'SOURCE: HWI2C.H (850)
GLOBAL	SI2CSTOP
SI2CSTOP:
;'ASM SHOWDEBUG  REDIRECTED FOR K-MODE FAMILY PROBALBY CALLED HI2CSTOP
;'ASM SHOWDEBUG  THIS METHOD SETS THE REGISTERS AND REGISTER BITS TO GENERATE THE I2C  STOP SIGNAL
;'WAITS UP TO 254US THEN SET THE ERROR STATE
;'HI2C1STATEMACHINE = 0
	CLRF	HI2C1STATEMACHINE,ACCESS
;'HI2CWAITMSSPTIMEOUT = 0
	CLRF	HI2CWAITMSSPTIMEOUT,ACCESS
;'DO WHILE HI2CWAITMSSPTIMEOUT < 255
GLOBAL	SYSDOLOOP_S2
SYSDOLOOP_S2:
	MOVLW	255
	SUBWF	HI2CWAITMSSPTIMEOUT,W,ACCESS
	BTFSC	STATUS,0,ACCESS
	BRA	SYSDOLOOP_E2
;'HI2CWAITMSSPTIMEOUT++
	INCF	HI2CWAITMSSPTIMEOUT,F,ACCESS
;'WAIT TILL THIS EVENT
;'IF I2C1PIR.PCIF = 1 THEN
	BANKSEL	I2C1PIR
	BTFSS	I2C1PIR,2,BANKED
	BRA	ELSE17_1
;'SI2CWAIT4STOP
	BANKSEL	0
	RCALL	SI2CWAIT4STOP
;'TSCL WAIT, PART OF THE SPECIFICIATION OF THE I2C MODULE
;'WAIT HI2CITSCLWAITPERIOD US
	MOVLW	2
	MOVWF	DELAYTEMP2,ACCESS
GLOBAL	DELAYUSO1
DELAYUSO1:
	CLRF	DELAYTEMP,ACCESS
GLOBAL	DELAYUS1
DELAYUS1:
	DECFSZ	DELAYTEMP,F,ACCESS
	BRA	DELAYUS1
	DECFSZ	DELAYTEMP2,F,ACCESS
	BRA	DELAYUSO1
	MOVLW	19
	MOVWF	DELAYTEMP,ACCESS
GLOBAL	DELAYUS2
DELAYUS2:
	DECFSZ	DELAYTEMP,F,ACCESS
	BRA	DELAYUS2
;'EXIT SUB
	RETURN
;'ELSE
	BRA	ENDIF17
GLOBAL	ELSE17_1
ELSE17_1:
;'WAIT 1 US
	MOVLW	5
	MOVWF	DELAYTEMP,ACCESS
GLOBAL	DELAYUS3
DELAYUS3:
	DECFSZ	DELAYTEMP,F,ACCESS
	BRA	DELAYUS3
;'END IF
GLOBAL	ENDIF17
ENDIF17:
;'LOOP
	BRA	SYSDOLOOP_S2
GLOBAL	SYSDOLOOP_E2
SYSDOLOOP_E2:
;'IF HI2CWAITMSSPTIMEOUT = 255 THEN HI2C1LASTERROR = HI2C1LASTERROR OR I2C1_STOP_TIMEOUT
	INCF	HI2CWAITMSSPTIMEOUT,W,ACCESS
	BTFSS	STATUS,2,ACCESS
	BRA	ENDIF18
;'IF HI2CWAITMSSPTIMEOUT = 255 THEN HI2C1LASTERROR = HI2C1LASTERROR OR I2C1_STOP_TIMEOUT
	MOVLW	128
	IORWF	HI2C1LASTERROR,F,ACCESS
;'IF HI2CWAITMSSPTIMEOUT = 255 THEN HI2C1LASTERROR = HI2C1LASTERROR OR I2C1_STOP_TIMEOUT
GLOBAL	ENDIF18
ENDIF18:
	BANKSEL	0
	RETURN

;'********************************************************************************

;'SOURCE: HWI2C.H (1012)
GLOBAL	SI2CWAIT4ACK
SI2CWAIT4ACK:
;'HI2CWAITMSSPTIMEOUT = 0
	CLRF	HI2CWAITMSSPTIMEOUT,ACCESS
;'WAITS UP TO 254US THEN CREATES ERROR MESSAGE
;'DO WHILE HI2CWAITMSSPTIMEOUT < 255
GLOBAL	SYSDOLOOP_S6
SYSDOLOOP_S6:
	MOVLW	255
	SUBWF	HI2CWAITMSSPTIMEOUT,W,ACCESS
	BTFSC	STATUS,0,ACCESS
	BRA	SYSDOLOOP_E6
;'HI2CWAITMSSPTIMEOUT++
	INCF	HI2CWAITMSSPTIMEOUT,F,ACCESS
;'WAIT FOR THIS EVENT
;'IF I2C1CON1.ACKSTAT = 0 THEN
	BANKSEL	I2C1CON1
	BTFSC	I2C1CON1,5,BANKED
	BRA	ELSE27_1
;'SET STATUS
;'HI2CACKPOLLSTATE = !I2C1CON1.ACKSTAT
	BANKSEL	SYSTEMP1
	CLRF	SYSTEMP1,BANKED
	BANKSEL	I2C1CON1
	BTFSS	I2C1CON1,5,BANKED
	BRA	ENDIF29
	BANKSEL	SYSTEMP1
	INCF	SYSTEMP1,F,BANKED
GLOBAL	ENDIF29
ENDIF29:
	BANKSEL	SYSTEMP1
	COMF	SYSTEMP1,W,BANKED
	MOVWF	HI2CACKPOLLSTATE,ACCESS
;'EXIT SUB
	BANKSEL	0
	RETURN
;'ELSE
	BRA	ENDIF27
GLOBAL	ELSE27_1
ELSE27_1:
;'WAIT 1 US
	MOVLW	5
	MOVWF	DELAYTEMP,ACCESS
GLOBAL	DELAYUS9
DELAYUS9:
	DECFSZ	DELAYTEMP,F,ACCESS
	BRA	DELAYUS9
;'END IF
GLOBAL	ENDIF27
ENDIF27:
;'LOOP
	BRA	SYSDOLOOP_S6
GLOBAL	SYSDOLOOP_E6
SYSDOLOOP_E6:
;'IF HI2CWAITMSSPTIMEOUT = 255 THEN HI2C1LASTERROR = HI2C1LASTERROR OR I2C1_ACK_TIMEOUT
	INCF	HI2CWAITMSSPTIMEOUT,W,ACCESS
	BTFSS	STATUS,2,ACCESS
	BRA	ENDIF28
;'IF HI2CWAITMSSPTIMEOUT = 255 THEN HI2C1LASTERROR = HI2C1LASTERROR OR I2C1_ACK_TIMEOUT
	MOVLW	32
	IORWF	HI2C1LASTERROR,F,ACCESS
;'IF HI2CWAITMSSPTIMEOUT = 255 THEN HI2C1LASTERROR = HI2C1LASTERROR OR I2C1_ACK_TIMEOUT
GLOBAL	ENDIF28
ENDIF28:
;'HI2CWAITMSSPTIMEOUT IS NOW TRUE = 255
	BANKSEL	0
	RETURN

;'********************************************************************************

;'SOURCE: HWI2C.H (1041)
GLOBAL	SI2CWAIT4MDR
SI2CWAIT4MDR:
;'HI2CWAITMSSPTIMEOUT = 0
	CLRF	HI2CWAITMSSPTIMEOUT,ACCESS
;'WAITS UP TO 254US THEN CREATES ERROR MESSAGE
;'DO WHILE HI2CWAITMSSPTIMEOUT < 255
GLOBAL	SYSDOLOOP_S7
SYSDOLOOP_S7:
	MOVLW	255
	SUBWF	HI2CWAITMSSPTIMEOUT,W,ACCESS
	BTFSC	STATUS,0,ACCESS
	BRA	SYSDOLOOP_E7
;'HI2CWAITMSSPTIMEOUT++
	INCF	HI2CWAITMSSPTIMEOUT,F,ACCESS
;'WAIT FOR THIS EVENT
;'IF I2C1CON0.MDR = 0 THEN
	BANKSEL	I2C1CON0
	BTFSC	I2C1CON0,3,BANKED
	BRA	ELSE30_1
;'EXIT SUB
	BANKSEL	0
	RETURN
;'ELSE
	BRA	ENDIF30
GLOBAL	ELSE30_1
ELSE30_1:
;'WAIT 1 US
	MOVLW	5
	MOVWF	DELAYTEMP,ACCESS
GLOBAL	DELAYUS10
DELAYUS10:
	DECFSZ	DELAYTEMP,F,ACCESS
	BRA	DELAYUS10
;'END IF
GLOBAL	ENDIF30
ENDIF30:
;'LOOP
	BRA	SYSDOLOOP_S7
GLOBAL	SYSDOLOOP_E7
SYSDOLOOP_E7:
;'IF HI2CWAITMSSPTIMEOUT = 255 THEN HI2C1LASTERROR = HI2C1LASTERROR OR I2C1_MDR_TIMEOUT
	INCF	HI2CWAITMSSPTIMEOUT,W,ACCESS
	BTFSS	STATUS,2,ACCESS
	BRA	ENDIF31
;'IF HI2CWAITMSSPTIMEOUT = 255 THEN HI2C1LASTERROR = HI2C1LASTERROR OR I2C1_MDR_TIMEOUT
	MOVLW	64
	IORWF	HI2C1LASTERROR,F,ACCESS
;'IF HI2CWAITMSSPTIMEOUT = 255 THEN HI2C1LASTERROR = HI2C1LASTERROR OR I2C1_MDR_TIMEOUT
GLOBAL	ENDIF31
ENDIF31:
;'HI2CWAITMSSPTIMEOUT IS NOW TRUE = 255
	BANKSEL	0
	RETURN

;'********************************************************************************

;'SOURCE: HWI2C.H (1064)
GLOBAL	SI2CWAIT4STOP
SI2CWAIT4STOP:
;'HI2CWAITMSSPTIMEOUT = 0
	CLRF	HI2CWAITMSSPTIMEOUT,ACCESS
;'WAITS UP TO 254US THEN CREATES ERROR MESSAGE
;'DO WHILE HI2CWAITMSSPTIMEOUT < 255
GLOBAL	SYSDOLOOP_S8
SYSDOLOOP_S8:
	MOVLW	255
	SUBWF	HI2CWAITMSSPTIMEOUT,W,ACCESS
	BTFSC	STATUS,0,ACCESS
	BRA	SYSDOLOOP_E8
;'HI2CWAITMSSPTIMEOUT++
	INCF	HI2CWAITMSSPTIMEOUT,F,ACCESS
;'WAIT FOR THIS EVENT
;'IF I2C1PIR.PCIF = 1 THEN
	BANKSEL	I2C1PIR
	BTFSS	I2C1PIR,2,BANKED
	BRA	ELSE32_1
;'EXIT SUB
	BANKSEL	0
	RETURN
;'ELSE
	BRA	ENDIF32
GLOBAL	ELSE32_1
ELSE32_1:
;'WAIT 1 US
	MOVLW	5
	MOVWF	DELAYTEMP,ACCESS
GLOBAL	DELAYUS11
DELAYUS11:
	DECFSZ	DELAYTEMP,F,ACCESS
	BRA	DELAYUS11
;'END IF
GLOBAL	ENDIF32
ENDIF32:
;'LOOP
	BRA	SYSDOLOOP_S8
GLOBAL	SYSDOLOOP_E8
SYSDOLOOP_E8:
;'IF HI2CWAITMSSPTIMEOUT = 255 THEN HI2C1LASTERROR = HI2C1LASTERROR OR I2C1_STOP_TIMEOUT
	INCF	HI2CWAITMSSPTIMEOUT,W,ACCESS
	BTFSS	STATUS,2,ACCESS
	BRA	ENDIF33
;'IF HI2CWAITMSSPTIMEOUT = 255 THEN HI2C1LASTERROR = HI2C1LASTERROR OR I2C1_STOP_TIMEOUT
	MOVLW	128
	IORWF	HI2C1LASTERROR,F,ACCESS
;'IF HI2CWAITMSSPTIMEOUT = 255 THEN HI2C1LASTERROR = HI2C1LASTERROR OR I2C1_STOP_TIMEOUT
GLOBAL	ENDIF33
ENDIF33:
;'HI2CWAITMSSPTIMEOUT IS NOW TRUE = 255
	BANKSEL	0
	RETURN

;'********************************************************************************

GLOBAL	SPRITE1
SPRITE1:
	MOVLW	9
	CPFSLT	SYSSTRINGA,ACCESS
	RETLW	0
	MOVF	SYSSTRINGA, W,ACCESS
	ADDLW	LOW TABLESPRITE1
	MOVWF	TBLPTR,ACCESS
	MOVLW	HIGH TABLESPRITE1
	BTFSC	STATUS,0,ACCESS
	ADDLW	1
	MOVWF	TBLPTRH,ACCESS
	MOVLW	UPPER TABLESPRITE1
	BTFSC	STATUS,0,ACCESS
	ADDLW	1
	MOVWF	TBLPTRU,ACCESS
	TBLRD*
	MOVF	TABLAT, W,ACCESS
	RETURN
GLOBAL	TABLESPRITE1
TABLESPRITE1:
	DB	8,0,0,128,255,56,0,0,255
	ALIGN	2;X4

;'********************************************************************************

GLOBAL	SPRITE2
SPRITE2:
	MOVLW	9
	CPFSLT	SYSSTRINGA,ACCESS
	RETLW	0
	MOVF	SYSSTRINGA, W,ACCESS
	ADDLW	LOW TABLESPRITE2
	MOVWF	TBLPTR,ACCESS
	MOVLW	HIGH TABLESPRITE2
	BTFSC	STATUS,0,ACCESS
	ADDLW	1
	MOVWF	TBLPTRH,ACCESS
	MOVLW	UPPER TABLESPRITE2
	BTFSC	STATUS,0,ACCESS
	ADDLW	1
	MOVWF	TBLPTRU,ACCESS
	TBLRD*
	MOVF	TABLAT, W,ACCESS
	RETURN
GLOBAL	TABLESPRITE2
TABLESPRITE2:
	DB	8,0,60,64,255,68,0,60,195
	ALIGN	2;X4

;'********************************************************************************

GLOBAL	SPRITE3
SPRITE3:
	MOVLW	9
	CPFSLT	SYSSTRINGA,ACCESS
	RETLW	0
	MOVF	SYSSTRINGA, W,ACCESS
	ADDLW	LOW TABLESPRITE3
	MOVWF	TBLPTR,ACCESS
	MOVLW	HIGH TABLESPRITE3
	BTFSC	STATUS,0,ACCESS
	ADDLW	1
	MOVWF	TBLPTRH,ACCESS
	MOVLW	UPPER TABLESPRITE3
	BTFSC	STATUS,0,ACCESS
	ADDLW	1
	MOVWF	TBLPTRU,ACCESS
	TBLRD*
	MOVF	TABLAT, W,ACCESS
	RETURN
GLOBAL	TABLESPRITE3
TABLESPRITE3:
	DB	8,0,90,32,255,130,60,102,165
	ALIGN	2;X4

;'********************************************************************************

GLOBAL	SPRITE4
SPRITE4:
	MOVLW	9
	CPFSLT	SYSSTRINGA,ACCESS
	RETLW	0
	MOVF	SYSSTRINGA, W,ACCESS
	ADDLW	LOW TABLESPRITE4
	MOVWF	TBLPTR,ACCESS
	MOVLW	HIGH TABLESPRITE4
	BTFSC	STATUS,0,ACCESS
	ADDLW	1
	MOVWF	TBLPTRH,ACCESS
	MOVLW	UPPER TABLESPRITE4
	BTFSC	STATUS,0,ACCESS
	ADDLW	1
	MOVWF	TBLPTRU,ACCESS
	TBLRD*
	MOVF	TABLAT, W,ACCESS
	RETURN
GLOBAL	TABLESPRITE4
TABLESPRITE4:
	DB	8,0,90,16,255,24,60,90,165
	ALIGN	2;X4

;'********************************************************************************

GLOBAL	SPRITE5
SPRITE5:
	MOVLW	9
	CPFSLT	SYSSTRINGA,ACCESS
	RETLW	0
	MOVF	SYSSTRINGA, W,ACCESS
	ADDLW	LOW TABLESPRITE5
	MOVWF	TBLPTR,ACCESS
	MOVLW	HIGH TABLESPRITE5
	BTFSC	STATUS,0,ACCESS
	ADDLW	1
	MOVWF	TBLPTRH,ACCESS
	MOVLW	UPPER TABLESPRITE5
	BTFSC	STATUS,0,ACCESS
	ADDLW	1
	MOVWF	TBLPTRU,ACCESS
	TBLRD*
	MOVF	TABLAT, W,ACCESS
	RETURN
GLOBAL	TABLESPRITE5
TABLESPRITE5:
	DB	8,0,90,8,255,130,60,90,165
	ALIGN	2;X4

;'********************************************************************************

GLOBAL	SPRITE6
SPRITE6:
	MOVLW	9
	CPFSLT	SYSSTRINGA,ACCESS
	RETLW	0
	MOVF	SYSSTRINGA, W,ACCESS
	ADDLW	LOW TABLESPRITE6
	MOVWF	TBLPTR,ACCESS
	MOVLW	HIGH TABLESPRITE6
	BTFSC	STATUS,0,ACCESS
	ADDLW	1
	MOVWF	TBLPTRH,ACCESS
	MOVLW	UPPER TABLESPRITE6
	BTFSC	STATUS,0,ACCESS
	ADDLW	1
	MOVWF	TBLPTRU,ACCESS
	TBLRD*
	MOVF	TABLAT, W,ACCESS
	RETURN
GLOBAL	TABLESPRITE6
TABLESPRITE6:
	DB	8,0,90,4,255,68,60,102,165
	ALIGN	2;X4

;'********************************************************************************

GLOBAL	SPRITE7
SPRITE7:
	MOVLW	9
	CPFSLT	SYSSTRINGA,ACCESS
	RETLW	0
	MOVF	SYSSTRINGA, W,ACCESS
	ADDLW	LOW TABLESPRITE7
	MOVWF	TBLPTR,ACCESS
	MOVLW	HIGH TABLESPRITE7
	BTFSC	STATUS,0,ACCESS
	ADDLW	1
	MOVWF	TBLPTRH,ACCESS
	MOVLW	UPPER TABLESPRITE7
	BTFSC	STATUS,0,ACCESS
	ADDLW	1
	MOVWF	TBLPTRU,ACCESS
	TBLRD*
	MOVF	TABLAT, W,ACCESS
	RETURN
GLOBAL	TABLESPRITE7
TABLESPRITE7:
	DB	8,0,60,2,255,56,0,60,195
	ALIGN	2;X4

;'********************************************************************************

GLOBAL	SPRITE8
SPRITE8:
	MOVLW	9
	CPFSLT	SYSSTRINGA,ACCESS
	RETLW	0
	MOVF	SYSSTRINGA, W,ACCESS
	ADDLW	LOW TABLESPRITE8
	MOVWF	TBLPTR,ACCESS
	MOVLW	HIGH TABLESPRITE8
	BTFSC	STATUS,0,ACCESS
	ADDLW	1
	MOVWF	TBLPTRH,ACCESS
	MOVLW	UPPER TABLESPRITE8
	BTFSC	STATUS,0,ACCESS
	ADDLW	1
	MOVWF	TBLPTRU,ACCESS
	TBLRD*
	MOVF	TABLAT, W,ACCESS
	RETURN
GLOBAL	TABLESPRITE8
TABLESPRITE8:
	DB	8,0,0,1,255,0,0,0,255
	ALIGN	2;X4

;'********************************************************************************

;'SOURCE: STDBASIC.H (301)
GLOBAL	FN_SWAP4
FN_SWAP4:
;'SWAPF SWAP4IN, W
	BANKSEL	SWAP4IN
	SWAPF	SWAP4IN, W,BANKED
;'MOVWF SWAP4
	MOVWF	SWAP4,BANKED
	BANKSEL	0
	RETURN

;'********************************************************************************

;'SOURCE: SYSTEM.H (3153)
GLOBAL	SYSCOMPEQUAL
SYSCOMPEQUAL:
;'DIM SYSBYTETEMPA, SYSBYTETEMPB, SYSBYTETEMPX AS BYTE
;'SETF SYSBYTETEMPX
	SETF	SYSBYTETEMPX,ACCESS
;'MOVF SYSBYTETEMPB, W
	MOVF	SYSBYTETEMPB, W,ACCESS
;'CPFSEQ SYSBYTETEMPA
	CPFSEQ	SYSBYTETEMPA,ACCESS
;'CLRF SYSBYTETEMPX
	CLRF	SYSBYTETEMPX,ACCESS
	RETURN

;'********************************************************************************

;'SOURCE: SYSTEM.H (3179)
GLOBAL	SYSCOMPEQUAL16
SYSCOMPEQUAL16:
;'DIM SYSWORDTEMPA AS WORD
;'DIM SYSWORDTEMPB AS WORD
;'DIM SYSBYTETEMPX AS BYTE
;'CLRF SYSBYTETEMPX
	CLRF	SYSBYTETEMPX,ACCESS
;'TEST LOW, EXIT IF FALSE
;'MOVF SYSWORDTEMPB, W
	MOVF	SYSWORDTEMPB, W,ACCESS
;'CPFSEQ SYSWORDTEMPA
	CPFSEQ	SYSWORDTEMPA,ACCESS
;'RETURN
	RETURN
;'TEST HIGH, EXIT IF FALSE
;'MOVF SYSWORDTEMPB_H, W
	MOVF	SYSWORDTEMPB_H, W,ACCESS
;'CPFSEQ SYSWORDTEMPA_H
	CPFSEQ	SYSWORDTEMPA_H,ACCESS
;'RETURN
	RETURN
;'SETF SYSBYTETEMPX
	SETF	SYSBYTETEMPX,ACCESS
	RETURN

;'********************************************************************************

;'SOURCE: SYSTEM.H (3458)
GLOBAL	SYSCOMPLESSTHAN
SYSCOMPLESSTHAN:
;'DIM SYSBYTETEMPA, SYSBYTETEMPB, SYSBYTETEMPX AS BYTE
;'SETF SYSBYTETEMPX
	SETF	SYSBYTETEMPX,ACCESS
;'MOVF SYSBYTETEMPB, W
	MOVF	SYSBYTETEMPB, W,ACCESS
;'CPFSLT SYSBYTETEMPA
	CPFSLT	SYSBYTETEMPA,ACCESS
;'CLRF SYSBYTETEMPX
	CLRF	SYSBYTETEMPX,ACCESS
	RETURN

;'********************************************************************************

;'SOURCE: SYSTEM.H (3488)
GLOBAL	SYSCOMPLESSTHAN16
SYSCOMPLESSTHAN16:
;'DIM SYSWORDTEMPA AS WORD
;'DIM SYSWORDTEMPB AS WORD
;'DIM SYSBYTETEMPX AS BYTE
;'CLRF SYSBYTETEMPX
	CLRF	SYSBYTETEMPX,ACCESS
;'TEST HIGH, EXIT IF MORE
;'MOVF SYSWORDTEMPA_H,W
	MOVF	SYSWORDTEMPA_H,W,ACCESS
;'SUBWF SYSWORDTEMPB_H,W
	SUBWF	SYSWORDTEMPB_H,W,ACCESS
	;BTFSS	STATUS,0
	BTFSS	STATUS,0,ACCESS
;'RETURN
	RETURN
;'TEST HIGH, EXIT TRUE IF LESS
;'MOVF SYSWORDTEMPB_H,W
	MOVF	SYSWORDTEMPB_H,W,ACCESS
;'SUBWF SYSWORDTEMPA_H,W
	SUBWF	SYSWORDTEMPA_H,W,ACCESS
;'BNC SCLT16TRUE
	BNC	SCLT16TRUE
;'TEST LOW, EXIT IF MORE OR EQUAL
;'MOVF SYSWORDTEMPB,W
	MOVF	SYSWORDTEMPB,W,ACCESS
;'SUBWF SYSWORDTEMPA,W
	SUBWF	SYSWORDTEMPA,W,ACCESS
	;BTFSC	STATUS,0
	BTFSC	STATUS,0,ACCESS
;'RETURN
	RETURN
GLOBAL	SCLT16TRUE
SCLT16TRUE:
;'COMF SYSBYTETEMPX,F
	COMF	SYSBYTETEMPX,F,ACCESS
	RETURN

;'********************************************************************************

;'SOURCE: SYSTEM.H (2868)
GLOBAL	SYSDIVSUB
SYSDIVSUB:
;'DIM SYSBYTETEMPA AS BYTE
;'DIM SYSBYTETEMPB AS BYTE
;'DIM SYSBYTETEMPX AS BYTE
;'CHECK FOR DIV/0
;'MOVF SYSBYTETEMPB, F
	MOVF	SYSBYTETEMPB, F,ACCESS
	;BTFSC	STATUS,2
	BTFSC	STATUS,2,ACCESS
;'RETURN
	RETURN
;'MAIN CALC ROUTINE
;'SYSBYTETEMPX = 0
	CLRF	SYSBYTETEMPX,ACCESS
;'SYSDIVLOOP = 8
	MOVLW	8
	MOVWF	SYSDIVLOOP,ACCESS
GLOBAL	SYSDIV8START
SYSDIV8START:
	;BCF	STATUS,0
	BCF	STATUS,0,ACCESS
;'RLF SYSBYTETEMPA, F
	RLCF	SYSBYTETEMPA, F,ACCESS
;'RLF SYSBYTETEMPX, F
	RLCF	SYSBYTETEMPX, F,ACCESS
;'MOVF SYSBYTETEMPB, W
	MOVF	SYSBYTETEMPB, W,ACCESS
;'SUBWF SYSBYTETEMPX, F
	SUBWF	SYSBYTETEMPX, F,ACCESS
;'BSF SYSBYTETEMPA, 0
	BSF	SYSBYTETEMPA, 0,ACCESS
	;BTFSC	STATUS,0
	BTFSC	STATUS,0,ACCESS
;'GOTO DIV8NOTNEG
	BRA	DIV8NOTNEG
;'BCF SYSBYTETEMPA, 0
	BCF	SYSBYTETEMPA, 0,ACCESS
;'MOVF SYSBYTETEMPB, W
	MOVF	SYSBYTETEMPB, W,ACCESS
;'ADDWF SYSBYTETEMPX, F
	ADDWF	SYSBYTETEMPX, F,ACCESS
GLOBAL	DIV8NOTNEG
DIV8NOTNEG:
;'DECFSZ SYSDIVLOOP, F
	DECFSZ	SYSDIVLOOP, F,ACCESS
;'GOTO SYSDIV8START
	BRA	SYSDIV8START
	RETURN

;'********************************************************************************

;'SOURCE: SYSTEM.H (1646)
GLOBAL	SYSREADSTRING
SYSREADSTRING:
;'DIM SYSCALCTEMPA AS BYTE
;'DIM SYSSTRINGLENGTH AS BYTE
;'CHIPFAMILY 16 SUPPORT
;'GET LENGTH
;'TBLRD*+
	TBLRD*+
	;MOVFF	TABLAT,SYSCALCTEMPA
	MOVFF	TABLAT,SYSCALCTEMPA
	;MOVFF	TABLAT,INDF1
	MOVFF	TABLAT,INDF1
;'GOTO SYSSTRINGREADCHECK
	BRA	SYSSTRINGREADCHECK
GLOBAL	SYSREADSTRINGPART
SYSREADSTRINGPART:
;'TBLRD*+
	TBLRD*+
	;MOVF	TABLAT,W
	MOVF	TABLAT, W,ACCESS
;'MOVWF SYSCALCTEMPA
	MOVWF	SYSCALCTEMPA,ACCESS
;'ADDWF SYSSTRINGLENGTH,F
	ADDWF	SYSSTRINGLENGTH,F,ACCESS
;'CHECK LENGTH
GLOBAL	SYSSTRINGREADCHECK
SYSSTRINGREADCHECK:
;'IF LENGTH IS 0, EXIT
;'MOVF SYSCALCTEMPA,F
	MOVF	SYSCALCTEMPA,F,ACCESS
	;BTFSC	STATUS,2
	BTFSC	STATUS,2,ACCESS
;'RETURN
	RETURN
;'COPY
GLOBAL	SYSSTRINGREAD
SYSSTRINGREAD:
;'COPY CHAR
;'TBLRD*+
	TBLRD*+
	;MOVFF	TABLAT,PREINC1
	MOVFF	TABLAT,PREINC1
;'DECFSZ SYSCALCTEMPA, F
	DECFSZ	SYSCALCTEMPA, F,ACCESS
;'GOTO SYSSTRINGREAD
	BRA	SYSSTRINGREAD
	RETURN

;'********************************************************************************

GLOBAL	SYSSTRINGTABLES
SYSSTRINGTABLES:

GLOBAL	STRINGTABLE1
STRINGTABLE1:
	DB	7,71,67,66,65,83,73,67

	ALIGN	2;X3

GLOBAL	STRINGTABLE2
STRINGTABLE2:
	DB	17,71,76,67,68,32,76,105,98,114,97,114,121,32,50,48,50,52

	ALIGN	2;X3

GLOBAL	STRINGTABLE3
STRINGTABLE3:
	DB	14,83,112,114,105,116,101,32,83,117,112,112,111,114,116

	ALIGN	2;X3

;'********************************************************************************

;'SOURCE: GLCD_SSD1306.H (239)
GLOBAL	WRITE_COMMAND_SSD1306
WRITE_COMMAND_SSD1306:
;'HI2CSTART
	RCALL	SI2CSTART
;'HI2CSEND GLCD_I2C_ADDRESS
	MOVLW	120
	MOVWF	I2CBYTE,ACCESS
	RCALL	SI2CSEND
;'HI2CSEND 0X00
	CLRF	I2CBYTE,ACCESS
	RCALL	SI2CSEND
;'HI2CSEND SSD1306SENDBYTE
	MOVFF	SSD1306SENDBYTE,I2CBYTE
	RCALL	SI2CSEND
;'HI2CSTOP
	BRA	SI2CSTOP

;'********************************************************************************

;'SOURCE: GLCD_SSD1306.H (285)
GLOBAL	WRITE_DATA_SSD1306
WRITE_DATA_SSD1306:
;'HI2CSTART
	RCALL	SI2CSTART
;'HI2CSEND GLCD_I2C_ADDRESS
	MOVLW	120
	MOVWF	I2CBYTE,ACCESS
	RCALL	SI2CSEND
;'HI2CSEND 0X40
	MOVLW	64
	MOVWF	I2CBYTE,ACCESS
	RCALL	SI2CSEND
;'HI2CSEND SSD1306SENDBYTE
	MOVFF	SSD1306SENDBYTE,I2CBYTE
	RCALL	SI2CSEND
;'HI2CSTOP
	BRA	SI2CSTOP

;'********************************************************************************

	ALIGN	2;X2
;'
;' Declare Power-On-Reset entry point
;'
 END     RESETVEC
