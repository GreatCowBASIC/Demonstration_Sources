;'Program compiled by GCBASIC (2024.2.16 (Windows 64 bit) : Build 1337) for Microchip PIC-AS using FreeBASIC 1.07.1/2024-02-15 CRC247
;'  See the GCBASIC forums at http://sourceforge.net/projects/gcbasic/forums,
;'  Check the documentation and Help at http://gcbasic.sourceforge.net/help/,
;'or, email:
;'   evanvennn at users dot sourceforge dot net

;'********************************************************************************


;'Set up the assembler options (Chip type, clock source, other bits and pieces)
;'PROCESSOR   18F16Q20
 PAGEWIDTH   180
 RADIX       DEC
 TITLE       "D:\GreatCowBASICGits\Demonstration_Sources.git\Vendor_Boards\Great_Cow_Basic_Demo_Board\18Fx6q20_ChipRange_Demonstrations\170_show_i2c_devices_to_serial_terminal.s"
 SUBTITLE    "02-17-2024"

;' Reverse lookup file(s)
;' C:\Program Files\Microchip\xc8\v2.46\pic\include\proc\pic18f16q20.inc
;' C:\Program Files\Microchip\xc8\v2.46\pic\dat\cfgmap\18f16q20.cfgmap
;' Alternative CONFIG file is to be found at C:\Program Files\Microchip\xc8\vX.YY\pic\dat\cfgdata as per Microchip support ticket #00730936 

;'********************************************************************************
;'Explicit PIC-AS constants to resolve the crazyness of the PIC-AS syntax
;'These are therefore the same as MPASM
#define BANKED b
#define ACCESS a
#define UPPER low highword

;'********************************************************************************
;'Explicit CONFIG
 CONFIG CPD=OFF                                  ;C1 Reverselookup  CPD = OFF
 CONFIG CP=OFF                                   ;C1 Reverselookup  CP = OFF
 CONFIG WRTSAF=OFF                               ;C1 Reverselookup  WRTSAF = OFF
 CONFIG WRTD=OFF                                 ;C1 Reverselookup  WRTD = OFF
 CONFIG WRTB=OFF                                 ;C1 Reverselookup  WRTB = OFF
 CONFIG VDDIO3MD=STANDARD_RANGE                  ;C1 Reverselookup  VDDIO3MD = STANDARD_RANGE
 CONFIG VDDIO2MD=STANDARD_RANGE                  ;C1 Reverselookup  VDDIO2MD = STANDARD_RANGE
 CONFIG WDTE=OFF                                 ;C1 Reverselookup  WDTE = OFF
 CONFIG XINST=OFF                                ;C1 Reverselookup  XINST = OFF
 CONFIG LVP=OFF                                  ;C1 Reverselookup  LVP = OFF
 CONFIG MVECEN=OFF                               ;C1 Reverselookup  MVECEN = OFF
 CONFIG MCLRE=INTMCLR                            ;C1 Reverselookup  MCLRE = INTMCLR
 CONFIG FCMEN=ON                                 ;C1 Reverselookup  FCMEN = ON
 CONFIG CLKOUTEN=OFF                             ;C1 Reverselookup  CLKOUTEN = OFF
 CONFIG RSTOSC=HFINTOSC_1MHZ                     ;C1 Reverselookup  RSTOSC = HFINTOSC_1MHZ
 CONFIG FEXTOSC=OFF                              ;C1 Reverselookup  FEXTOSC = OFF
;'Inferred CONFIG
 CONFIG BBEN=OFF                                 ;C1 Reverselookup BBEN=OFF
 CONFIG BBSIZE=BBSIZE_128                        ;C1 Reverselookup BBSIZE=BBSIZE_128
 CONFIG BOREN=OFF                                ;C1 Reverselookup BOREN=OFF
 CONFIG BORV=VBOR_2P85                           ;C1 Reverselookup BORV=VBOR_2P85
 CONFIG CSWEN=ON                                 ;C1 Reverselookup CSWEN=ON
 CONFIG DEBUG=OFF                                ;C1 Reverselookup DEBUG=OFF
 CONFIG FCMENP=OFF                               ;C1 Reverselookup FCMENP=OFF
 CONFIG FCMENS=OFF                               ;C1 Reverselookup FCMENS=OFF
 CONFIG IVT1WAY=OFF                              ;C1 Reverselookup IVT1WAY=OFF
 CONFIG LPBOREN=OFF                              ;C1 Reverselookup LPBOREN=OFF
 CONFIG PPS1WAY=OFF                              ;C1 Reverselookup PPS1WAY=OFF
 CONFIG PR1WAY=OFF                               ;C1 Reverselookup PR1WAY=OFF
 CONFIG PWRTS=PWRT_OFF                           ;C1 Reverselookup PWRTS=PWRT_OFF
 CONFIG STVREN=OFF                               ;C1 Reverselookup STVREN=OFF
 CONFIG WDTCCS=LFINTOSC                          ;C1 Reverselookup WDTCCS=LFINTOSC
 CONFIG WDTCPS=WDTCPS_0                          ;C1 Reverselookup WDTCPS=WDTCPS_0
 CONFIG WDTCWS=WDTCWS_0                          ;C1 Reverselookup WDTCWS=WDTCWS_0
 CONFIG WRTAPP=OFF                               ;C1 Reverselookup WRTAPP=OFF
 CONFIG WRTC=OFF                                 ;C1 Reverselookup WRTC=OFF


;'********************************************************************************
;' The XC8 xc.inc include file.  This MUST be placed after the CONFIG statements.

 #include <xc.inc>

;'********************************************************************************

;'Set aside RAM memory locations for variables. All variables are global.
GLOBAL	COMPORT
 COMPORT                          EQU 1282          ; 0X502
GLOBAL	DELAYTEMP
 DELAYTEMP                        EQU 1280          ; 0X500
GLOBAL	DELAYTEMP2
 DELAYTEMP2                       EQU 1281          ; 0X501
GLOBAL	DEVICEID
 DEVICEID                         EQU 1283          ; 0X503
GLOBAL	DISPLAYNEWLINE
 DISPLAYNEWLINE                   EQU 1290          ; 0X50A
GLOBAL	DUMPI2CREAD
 DUMPI2CREAD                      EQU 1291          ; 0X50B
GLOBAL	HI2C1LASTERROR
 HI2C1LASTERROR                   EQU 1292          ; 0X50C
GLOBAL	HI2C1STATEMACHINE
 HI2C1STATEMACHINE                EQU 1293          ; 0X50D
GLOBAL	HI2CACKPOLLSTATE
 HI2CACKPOLLSTATE                 EQU 1294          ; 0X50E
GLOBAL	HI2CCURRENTMODE
 HI2CCURRENTMODE                  EQU 1295          ; 0X50F
GLOBAL	HI2CWAITMSSPTIMEOUT
 HI2CWAITMSSPTIMEOUT              EQU 1296          ; 0X510
GLOBAL	HSERPRINTCRLFCOUNT
 HSERPRINTCRLFCOUNT               EQU 1297          ; 0X511
GLOBAL	I2CBYTE
 I2CBYTE                          EQU 1298          ; 0X512
GLOBAL	PRINTLEN
 PRINTLEN                         EQU 1299          ; 0X513
GLOBAL	SERDATA
 SERDATA                          EQU 1300          ; 0X514
GLOBAL	STRINGPOINTER
 STRINGPOINTER                    EQU 1301          ; 0X515
GLOBAL	SYSBYTETEMPA
 SYSBYTETEMPA                     EQU 1285          ; 0X505
GLOBAL	SYSBYTETEMPB
 SYSBYTETEMPB                     EQU 1289          ; 0X509
GLOBAL	SYSBYTETEMPX
 SYSBYTETEMPX                     EQU 1280          ; 0X500
GLOBAL	SYSCALCTEMPA
 SYSCALCTEMPA                     EQU 1285          ; 0X505
GLOBAL	SYSDIVLOOP
 SYSDIVLOOP                       EQU 1284          ; 0X504
GLOBAL	SYSPRINTDATAHANDLER
 SYSPRINTDATAHANDLER              EQU 1302          ; 0X516
GLOBAL	SYSPRINTDATAHANDLER_H
 SYSPRINTDATAHANDLER_H            EQU 1303          ; 0X517
GLOBAL	SYSPRINTTEMP
 SYSPRINTTEMP                     EQU 1304          ; 0X518
GLOBAL	SYSREPEATTEMP1
 SYSREPEATTEMP1                   EQU 1305          ; 0X519
GLOBAL	SYSSTRINGA
 SYSSTRINGA                       EQU 1287          ; 0X507
GLOBAL	SYSSTRINGA_H
 SYSSTRINGA_H                     EQU 1288          ; 0X508
GLOBAL	SYSSTRINGLENGTH
 SYSSTRINGLENGTH                  EQU 1286          ; 0X506
GLOBAL	SYSSTRINGPARAM1
 SYSSTRINGPARAM1                  EQU 5362          ; 0X14F2
GLOBAL	SYSSTRINGTEMP
 SYSSTRINGTEMP                    EQU 1306          ; 0X51A
GLOBAL	SYSTEMP1
 SYSTEMP1                         EQU 1307          ; 0X51B
GLOBAL	SYSTEMP2
 SYSTEMP2                         EQU 1308          ; 0X51C
GLOBAL	SYSVALTEMP
 SYSVALTEMP                       EQU 1309          ; 0X51D
GLOBAL	SYSWAITTEMPUS
 SYSWAITTEMPUS                    EQU 1285          ; 0X505
GLOBAL	SYSWAITTEMPUS_H
 SYSWAITTEMPUS_H                  EQU 1286          ; 0X506
GLOBAL	_HEXPICAS
 _HEXPICAS                        EQU 5358          ; 0X14EE

;'********************************************************************************

;'ALIAS VARIABLES
GLOBAL	AFSR0
 AFSR0                            EQU 1257
GLOBAL	AFSR0_H
 AFSR0_H                          EQU 1258
GLOBAL	SYS_HEXPICAS_0
 SYS_HEXPICAS_0                   EQU 5358
GLOBAL	SYS_HEXPICAS_1
 SYS_HEXPICAS_1                   EQU 5359
GLOBAL	SYS_HEXPICAS_2
 SYS_HEXPICAS_2                   EQU 5360

;'********************************************************************************

 PSECT   RESETVEC,delta=1, abs
 RESETVEC:
;'VECTORS
	ORG	0
	GOTO	BASPROGRAMSTART
	ORG	8
	RETFIE

;'********************************************************************************

;'PROGRAM_MEMORY_PAGE: 0
	ORG	12
GLOBAL	BASPROGRAMSTART
BASPROGRAMSTART:
;'CALL INITIALISATION ROUTINES
	RCALL	INITSYS
	RCALL	INITPPS
	RCALL	INITUSART
	RCALL	HI2CINIT

;'START_OF_THE_MAIN_PROGRAM
;'
;'THIS DEMONSTRATION SHOWS THE I2C DEVICES ATTACHED THE MICROCONTROLLER, THIS PROGRAM SUPPORT THE MICROCHIP I2C MODULE.
;'
;'I2C DEVICE REQUIRED A DATA BUS AND A CLOCK BUS, DEVICES ALSO REQUIRED AN INPUT VOLTAGE AND 0V.
;'I2C DATA BUS IS CONNECTED TO PORTA.4
;'I2C CLOCK BUS IS CONNECTED TO PORTA.1
;'SERIAL OUTPUT IS CONNECTED, AS PREVIOUSLY, TO PORTC.4
;'
;'CONNECT YOUR IC2 DEVICES AND SEE THE RESULTS ON THE SERIAL TERMINAL.
;'
;'************************************************************************
;'AUTHOR  EVANV
;'LICENCE GPL
;'VERSION 1.02
;'DATE    04-02-2024
;'
;'----- CONFIGURATION
;'CHIP SETTINGS.
;'PIC PPS TOOL VERSION: 0.0.6.5
;'ADD THIS CODE SEGMENT TO YOUR GCBASIC SOURCE PROGRAM
;'
;'HARDWARE
;'-------------------PORTA----------------
;'BIT#:  -7---6---5---4---3---2---1---0---
;'IO:    -----------------SW---------ADC--
;'-----------------------------------------
;'
;'
;'-------------------PORTB----------------
;'BIT#:  -7---6---5---4---3---2---1---0---
;'IO:    TX--SCL-SDA----------------------
;'----------------------------------------
;'
;'------------------PORTC-----------------
;'BIT#:  -7---6---5---4---3---2---1---0---
;'IO:    LED-LED-LED-LED------------------
;'----------------------------------------
;'
;'DEFINE CONSTANTS TO MAKE THINGS EASIER. WE CAN REUSE THESE AT ANY TIME.
;'SET THE PORTS AS AN OUTPUT
;'DIR LEDD7 OUT
	BCF	TRISC,7,ACCESS
;'DIR LEDD6 OUT
	BCF	TRISC,6,ACCESS
;'DIR LEDD5 OUT
	BCF	TRISC,5,ACCESS
;'DIR LEDD4 OUT
	BCF	TRISC,4,ACCESS
;'THIS IS THE PORTA.0 PORT
;'DIR POTENTIOMETER IN
	BSF	TRISA,0,ACCESS
;'DIR     SWITCHIN      IN
	BSF	TRISA,3,ACCESS
;'DEFINE I2C SETTINGS
;'HI2CMODE (MASTER)
	MOVLW	12
	MOVWF	HI2CCURRENTMODE,ACCESS
	RCALL	HI2CMODE
;'*****************************************************************************************************
;'MAIN PROGRAM COMMENCES HERE.. EVERYTHING BEFORE THIS IS SETUP FOR THE BOARD.
;'DIM DEVICEID AS BYTE
;'DIM DISPLAYNEWLINE AS BYTE
;'DIM HI2CWAITMSSPTIMEOUT AS BYTE
;'DIM DUMPI2CREAD AS BYTE
;'DO
GLOBAL	SYSDOLOOP_S1
SYSDOLOOP_S1:
;'HSERPRINTCRLF
	MOVLW	1
	MOVWF	HSERPRINTCRLFCOUNT,ACCESS
	MOVLW	1
	MOVWF	COMPORT,ACCESS
	RCALL	HSERPRINTCRLF
;'HSERPRINT "HARDWARE I2C"
	LFSR	1,SYSSTRINGPARAM1
	MOVLW	LOW STRINGTABLE1
	MOVWF	TBLPTR,ACCESS
	MOVLW	HIGH STRINGTABLE1
	MOVWF	TBLPTRH,ACCESS
	MOVLW	UPPER STRINGTABLE1
	MOVWF	TBLPTRU,ACCESS
	RCALL	SYSREADSTRING
	MOVLW	LOW SYSSTRINGPARAM1
	MOVWF	SYSPRINTDATAHANDLER,ACCESS
	MOVLW	HIGH SYSSTRINGPARAM1
	MOVWF	SYSPRINTDATAHANDLER_H,ACCESS
	MOVLW	1
	MOVWF	COMPORT,ACCESS
;'USING SYSSTRINGPARAM1*12
	RCALL	HSERPRINT314
;'HSERPRINTCRLF 2
	MOVLW	2
	MOVWF	HSERPRINTCRLFCOUNT,ACCESS
	MOVLW	1
	MOVWF	COMPORT,ACCESS
	RCALL	HSERPRINTCRLF
;'NOW ASSUMES SERIAL TERMINAL IS OPERATIONAL
;'HSERPRINTCRLF
	MOVLW	1
	MOVWF	HSERPRINTCRLFCOUNT,ACCESS
	MOVLW	1
	MOVWF	COMPORT,ACCESS
	RCALL	HSERPRINTCRLF
;'HSERPRINT "   "
	LFSR	1,SYSSTRINGPARAM1
	MOVLW	LOW STRINGTABLE2
	MOVWF	TBLPTR,ACCESS
	MOVLW	HIGH STRINGTABLE2
	MOVWF	TBLPTRH,ACCESS
	MOVLW	UPPER STRINGTABLE2
	MOVWF	TBLPTRU,ACCESS
	RCALL	SYSREADSTRING
	MOVLW	LOW SYSSTRINGPARAM1
	MOVWF	SYSPRINTDATAHANDLER,ACCESS
	MOVLW	HIGH SYSSTRINGPARAM1
	MOVWF	SYSPRINTDATAHANDLER_H,ACCESS
	MOVLW	1
	MOVWF	COMPORT,ACCESS
;'USING SYSSTRINGPARAM1*3
	RCALL	HSERPRINT314
;'CREATE A HORIZONTAL ROW OF NUMBERS
;'FOR DEVICEID = 0 TO 15
;'LEGACY METHOD
	SETF	DEVICEID,ACCESS
GLOBAL	SYSFORLOOP1
SYSFORLOOP1:
	INCF	DEVICEID,F,ACCESS
;'HSERPRINT HEX(DEVICEID)
	MOVFF	DEVICEID,SYSVALTEMP
	RCALL	FN__HEXPICAS
	MOVLW	LOW _HEXPICAS
	MOVWF	SYSPRINTDATAHANDLER,ACCESS
	MOVLW	HIGH _HEXPICAS
	MOVWF	SYSPRINTDATAHANDLER_H,ACCESS
	MOVLW	1
	MOVWF	COMPORT,ACCESS
	RCALL	HSERPRINT314
;'HSERPRINT " "
	LFSR	1,SYSSTRINGPARAM1
	MOVLW	LOW STRINGTABLE3
	MOVWF	TBLPTR,ACCESS
	MOVLW	HIGH STRINGTABLE3
	MOVWF	TBLPTRH,ACCESS
	MOVLW	UPPER STRINGTABLE3
	MOVWF	TBLPTRU,ACCESS
	RCALL	SYSREADSTRING
	MOVLW	LOW SYSSTRINGPARAM1
	MOVWF	SYSPRINTDATAHANDLER,ACCESS
	MOVLW	HIGH SYSSTRINGPARAM1
	MOVWF	SYSPRINTDATAHANDLER_H,ACCESS
	MOVLW	1
	MOVWF	COMPORT,ACCESS
;'USING SYSSTRINGPARAM1*1
	RCALL	HSERPRINT314
;'NEXT
	MOVLW	15
	SUBWF	DEVICEID,W,ACCESS
	BTFSS	STATUS,0,ACCESS
	BRA	SYSFORLOOP1
GLOBAL	SYSFORLOOPEND1
SYSFORLOOPEND1:
;'CREATE A VERTICAL COLUMN OF NUMBERS
;'FOR DEVICEID = 0 TO 255
;'LEGACY METHOD
	SETF	DEVICEID,ACCESS
GLOBAL	SYSFORLOOP2
SYSFORLOOP2:
	INCF	DEVICEID,F,ACCESS
;'DISPLAYNEWLINE = DEVICEID % 16
	MOVFF	DEVICEID,SYSBYTETEMPA
	MOVLW	16
	MOVWF	SYSBYTETEMPB,ACCESS
	RCALL	SYSDIVSUB
	MOVFF	SYSBYTETEMPX,DISPLAYNEWLINE
;'IF DISPLAYNEWLINE = 0 THEN
	MOVF	DISPLAYNEWLINE,F,ACCESS
	BTFSS	STATUS,2,ACCESS
	BRA	ENDIF2
;'HSERPRINTCRLF
	MOVLW	1
	MOVWF	HSERPRINTCRLFCOUNT,ACCESS
	MOVLW	1
	MOVWF	COMPORT,ACCESS
	RCALL	HSERPRINTCRLF
;'HSERPRINT HEX(DEVICEID)
	MOVFF	DEVICEID,SYSVALTEMP
	RCALL	FN__HEXPICAS
	MOVLW	LOW _HEXPICAS
	MOVWF	SYSPRINTDATAHANDLER,ACCESS
	MOVLW	HIGH _HEXPICAS
	MOVWF	SYSPRINTDATAHANDLER_H,ACCESS
	MOVLW	1
	MOVWF	COMPORT,ACCESS
	RCALL	HSERPRINT314
;'IF DISPLAYNEWLINE > 0 THEN
	MOVF	DISPLAYNEWLINE,W,ACCESS
	SUBLW	0
	BTFSC	STATUS,0,ACCESS
	BRA	ENDIF5
;'HSERPRINT " "
	LFSR	1,SYSSTRINGPARAM1
	MOVLW	LOW STRINGTABLE3
	MOVWF	TBLPTR,ACCESS
	MOVLW	HIGH STRINGTABLE3
	MOVWF	TBLPTRH,ACCESS
	MOVLW	UPPER STRINGTABLE3
	MOVWF	TBLPTRU,ACCESS
	RCALL	SYSREADSTRING
	MOVLW	LOW SYSSTRINGPARAM1
	MOVWF	SYSPRINTDATAHANDLER,ACCESS
	MOVLW	HIGH SYSSTRINGPARAM1
	MOVWF	SYSPRINTDATAHANDLER_H,ACCESS
	MOVLW	1
	MOVWF	COMPORT,ACCESS
;'USING SYSSTRINGPARAM1*1
	RCALL	HSERPRINT314
;'END IF
GLOBAL	ENDIF5
ENDIF5:
;'END IF
GLOBAL	ENDIF2
ENDIF2:
;'HSERPRINT " "
	LFSR	1,SYSSTRINGPARAM1
	MOVLW	LOW STRINGTABLE3
	MOVWF	TBLPTR,ACCESS
	MOVLW	HIGH STRINGTABLE3
	MOVWF	TBLPTRH,ACCESS
	MOVLW	UPPER STRINGTABLE3
	MOVWF	TBLPTRU,ACCESS
	RCALL	SYSREADSTRING
	MOVLW	LOW SYSSTRINGPARAM1
	MOVWF	SYSPRINTDATAHANDLER,ACCESS
	MOVLW	HIGH SYSSTRINGPARAM1
	MOVWF	SYSPRINTDATAHANDLER_H,ACCESS
	MOVLW	1
	MOVWF	COMPORT,ACCESS
;'USING SYSSTRINGPARAM1*1
	RCALL	HSERPRINT314
;'DO AN INITIAL START
;'HI2CSTART
	RCALL	SI2CSTART
;'SEND ADDRESS
;'HI2CSEND ( DEVICEID )
	MOVFF	DEVICEID,I2CBYTE
	RCALL	SI2CSEND
;'IF HI2CWAITMSSPTIMEOUT <> 255 THEN
	INCF	HI2CWAITMSSPTIMEOUT,W,ACCESS
	BTFSC	STATUS,2,ACCESS
	BRA	ELSE3_1
;'DID DEVICE FAIL TO RESPOND?
;'IF HI2CACKPOLLSTATE = FALSE THEN
	MOVF	HI2CACKPOLLSTATE,F,ACCESS
	BTFSS	STATUS,2,ACCESS
	BRA	ELSE6_1
;'HSERPRINT   HEX(DEVICEID)
	MOVFF	DEVICEID,SYSVALTEMP
	RCALL	FN__HEXPICAS
	MOVLW	LOW _HEXPICAS
	MOVWF	SYSPRINTDATAHANDLER,ACCESS
	MOVLW	HIGH _HEXPICAS
	MOVWF	SYSPRINTDATAHANDLER_H,ACCESS
	MOVLW	1
	MOVWF	COMPORT,ACCESS
	RCALL	HSERPRINT314
;'ELSE
	BRA	ENDIF6
GLOBAL	ELSE6_1
ELSE6_1:
;'HSERPRINT   "--"
	LFSR	1,SYSSTRINGPARAM1
	MOVLW	LOW STRINGTABLE4
	MOVWF	TBLPTR,ACCESS
	MOVLW	HIGH STRINGTABLE4
	MOVWF	TBLPTRH,ACCESS
	MOVLW	UPPER STRINGTABLE4
	MOVWF	TBLPTRU,ACCESS
	RCALL	SYSREADSTRING
	MOVLW	LOW SYSSTRINGPARAM1
	MOVWF	SYSPRINTDATAHANDLER,ACCESS
	MOVLW	HIGH SYSSTRINGPARAM1
	MOVWF	SYSPRINTDATAHANDLER_H,ACCESS
	MOVLW	1
	MOVWF	COMPORT,ACCESS
;'USING SYSSTRINGPARAM1*2
	RCALL	HSERPRINT314
;'END IF
GLOBAL	ENDIF6
ENDIF6:
;'GET THE READ DATATO PREVENT ANY POTENTIAL SLAVE LOCKUP
;'IF DEVICEID.0 = 1 THEN HI2CSEND ( DUMPI2CREAD )
	BTFSS	DEVICEID,0,ACCESS
	BRA	ENDIF7
;'IF DEVICEID.0 = 1 THEN HI2CSEND ( DUMPI2CREAD )
	MOVFF	DUMPI2CREAD,I2CBYTE
	RCALL	SI2CSEND
;'IF DEVICEID.0 = 1 THEN HI2CSEND ( DUMPI2CREAD )
GLOBAL	ENDIF7
ENDIF7:
;'ELSE
	BRA	ENDIF3
GLOBAL	ELSE3_1
ELSE3_1:
;'HSERPRINT "! "
	LFSR	1,SYSSTRINGPARAM1
	MOVLW	LOW STRINGTABLE5
	MOVWF	TBLPTR,ACCESS
	MOVLW	HIGH STRINGTABLE5
	MOVWF	TBLPTRH,ACCESS
	MOVLW	UPPER STRINGTABLE5
	MOVWF	TBLPTRU,ACCESS
	RCALL	SYSREADSTRING
	MOVLW	LOW SYSSTRINGPARAM1
	MOVWF	SYSPRINTDATAHANDLER,ACCESS
	MOVLW	HIGH SYSSTRINGPARAM1
	MOVWF	SYSPRINTDATAHANDLER_H,ACCESS
	MOVLW	1
	MOVWF	COMPORT,ACCESS
;'USING SYSSTRINGPARAM1*2
	RCALL	HSERPRINT314
;'END IF
GLOBAL	ENDIF3
ENDIF3:
;'I2C STOP
;'HI2CSTOP
	RCALL	SI2CSTOP
;'NEXT
	MOVLW	255
	SUBWF	DEVICEID,W,ACCESS
	BTFSS	STATUS,0,ACCESS
	BRA	SYSFORLOOP2
GLOBAL	SYSFORLOOPEND2
SYSFORLOOPEND2:
;'HSERPRINTCRLF 2
	MOVLW	2
	MOVWF	HSERPRINTCRLFCOUNT,ACCESS
	MOVLW	1
	MOVWF	COMPORT,ACCESS
	RCALL	HSERPRINTCRLF
;'HSERPRINT   "END OF SEARCH"
	LFSR	1,SYSSTRINGPARAM1
	MOVLW	LOW STRINGTABLE6
	MOVWF	TBLPTR,ACCESS
	MOVLW	HIGH STRINGTABLE6
	MOVWF	TBLPTRH,ACCESS
	MOVLW	UPPER STRINGTABLE6
	MOVWF	TBLPTRU,ACCESS
	RCALL	SYSREADSTRING
	MOVLW	LOW SYSSTRINGPARAM1
	MOVWF	SYSPRINTDATAHANDLER,ACCESS
	MOVLW	HIGH SYSSTRINGPARAM1
	MOVWF	SYSPRINTDATAHANDLER_H,ACCESS
	MOVLW	1
	MOVWF	COMPORT,ACCESS
;'USING SYSSTRINGPARAM1*13
	RCALL	HSERPRINT314
;'HSERPRINTCRLF 2
	MOVLW	2
	MOVWF	HSERPRINTCRLFCOUNT,ACCESS
	MOVLW	1
	MOVWF	COMPORT,ACCESS
	RCALL	HSERPRINTCRLF
;'WAIT WHILE SWITCHIN <> DOWN
GLOBAL	SYSWAITLOOP1
SYSWAITLOOP1:
	BTFSC	PORTA,3,ACCESS
	BRA	SYSWAITLOOP1
;'LOOP
	BRA	SYSDOLOOP_S1
GLOBAL	SYSDOLOOP_E1
SYSDOLOOP_E1:
GLOBAL	BASPROGRAMEND
BASPROGRAMEND:
	SLEEP
	BRA	BASPROGRAMEND

;'********************************************************************************

;'SOURCE: HWI2C.H (722)
GLOBAL	HI2CINIT
HI2CINIT:
;'ASM SHOWDEBUG  THIS METHOD SETS THE VARIABLE `HI2CCURRENTMODE`, AND, IF REQUIRED CALLS THE METHOD `SI2CINIT` TO SET UP NEW MSSP MODULES - AKA K-MODE FAMILY CHIPS
;'HI2CCURRENTMODE = 0
	CLRF	HI2CCURRENTMODE,ACCESS
;'INITIALISE THE I2C MODULE
;'SI2CINIT
	BRA	SI2CINIT

;'********************************************************************************

;'SOURCE: HWI2C.H (260)
GLOBAL	HI2CMODE
HI2CMODE:
;'ASM SHOWDEBUG  THIS METHOD SETS THE VARIABLE `HI2CCURRENTMODE`, AND, IF REQUIRED, SETS THE SSPCON1.BITS
	RETURN

;'********************************************************************************

;'OVERLOADED SIGNATURE: STRING:BYTE:, SOURCE: USART.H (2458)
GLOBAL	HSERPRINT314
HSERPRINT314:
;'PRINTLEN = PRINTDATA(0)
	MOVFF	SYSPRINTDATAHANDLER,FSR0
	MOVFF	SYSPRINTDATAHANDLER_H,FSR0H
	MOVFF	INDF0,PRINTLEN
;'IF PRINTLEN <> 0 THEN
	MOVF	PRINTLEN,F,ACCESS
	BTFSC	STATUS,2,ACCESS
	BRA	ENDIF11
;'WRITE DATA
;'FOR SYSPRINTTEMP = 1 TO PRINTLEN
	MOVLW	1
	MOVWF	SYSPRINTTEMP,ACCESS
GLOBAL	SYSFORLOOP4
SYSFORLOOP4:
;'HSERSEND(PRINTDATA(SYSPRINTTEMP),COMPORT )
	MOVF	SYSPRINTTEMP,W,ACCESS
	ADDWF	SYSPRINTDATAHANDLER,W,ACCESS
	MOVWF	FSR0,ACCESS
	MOVLW	0
	ADDWFC	SYSPRINTDATAHANDLER_H,W,ACCESS
	MOVWF	FSR0H,ACCESS
	MOVFF	INDF0,SERDATA
	RCALL	HSERSEND304
;'NEXT
;'POSITIVE VALUE STEP HANDLER IN FOR-NEXT STATEMENT :#4P 
	MOVF	SYSPRINTTEMP,W,ACCESS
	SUBWF	PRINTLEN,W,ACCESS
	MOVWF	SYSTEMP1,ACCESS
	MOVFF	SYSTEMP1,SYSBYTETEMPA
	CLRF	SYSBYTETEMPB,ACCESS
	RCALL	SYSCOMPEQUAL
	COMF	SYSBYTETEMPX,F,ACCESS
	BTFSS	SYSBYTETEMPX,0,ACCESS
	BRA	ENDIF12
;'SET LOOPVAR TO LOOPVAR + STEPVALUE WHERE STEPVALUE IS A POSITIVE VALUE
	INCF	SYSPRINTTEMP,F,ACCESS
	BRA	SYSFORLOOP4
;'END IF
GLOBAL	ENDIF12
ENDIF12:
GLOBAL	SYSFORLOOPEND4
SYSFORLOOPEND4:
;'END IF
GLOBAL	ENDIF11
ENDIF11:
;'CR
;'ALL USARTS
;'--------------------------
;'SPECIFIC USARTS
;'------------------
	RETURN

;'********************************************************************************

;'SOURCE: USART.H (2666)
GLOBAL	HSERPRINTCRLF
HSERPRINTCRLF:
;'REPEAT HSERPRINTCRLFCOUNT
	MOVFF	HSERPRINTCRLFCOUNT,SYSREPEATTEMP1
	MOVF	SYSREPEATTEMP1,F,ACCESS
	BTFSC	STATUS,2,ACCESS
	BRA	SYSREPEATLOOPEND1
GLOBAL	SYSREPEATLOOP1
SYSREPEATLOOP1:
;'HSERSEND(13,COMPORT)
	MOVLW	13
	MOVWF	SERDATA,ACCESS
	RCALL	HSERSEND304
;'HSERSEND(10,COMPORT)
	MOVLW	10
	MOVWF	SERDATA,ACCESS
	RCALL	HSERSEND304
;'END REPEAT
	DECFSZ	SYSREPEATTEMP1,F,ACCESS
	BRA	SYSREPEATLOOP1
GLOBAL	SYSREPEATLOOPEND1
SYSREPEATLOOPEND1:
	RETURN

;'********************************************************************************

;'OVERLOADED SIGNATURE: BYTE:BYTE:, SOURCE: USART.H (1570)
GLOBAL	HSERSEND304
HSERSEND304:
GLOBAL	HSERSENDUSART1HANDLER
HSERSENDUSART1HANDLER:
;'USART_TX_BLOCKING
;'WAIT WHILE TXIF = OFF
GLOBAL	SYSWAITLOOP3
SYSWAITLOOP3:
	BTFSS	PIR6,1,ACCESS
	BRA	SYSWAITLOOP3
;'TXREG = SERDATA
	MOVFF	SERDATA,U1TXB
	RETURN

;'********************************************************************************

;'SOURCE: 170_SHOW_I2C_DEVICES_TO_SERIAL_TERMINAL.GCB (31)
GLOBAL	INITPPS
INITPPS:
;'MODULE: I2C1
;'RB6PPS = 0X001C    // SCL1 > RB6
	MOVLW	28
	BANKSEL	RB6PPS
	MOVWF	RB6PPS,BANKED
;'I2C1SCLPPS = 0X000E    // RB6 > SCL1 (BI-DIRECTIONAL)
	MOVLW	14
	MOVWF	I2C1SCLPPS,BANKED
;'RB5PPS = 0X001D    // SDA1 > RB5
	MOVLW	29
	MOVWF	RB5PPS,BANKED
;'I2C1SDAPPS = 0X000D    // RB5 > SDA1 (BI-DIRECTIONAL)
	MOVLW	13
	MOVWF	I2C1SDAPPS,BANKED
;'MODULE: UART PIN DIRECTIONS
;'DIR PORTB.7 OUT    // MAKE TX1 PIN AN OUTPUT
	BCF	TRISB,7,ACCESS
;'MODULE: UART1
;'RB7PPS = 0X0013    // TX1 > RB7
	MOVLW	19
	MOVWF	RB7PPS,BANKED
	BANKSEL	0
	RETURN

;'********************************************************************************

;'SOURCE: SYSTEM.H (177)
GLOBAL	INITSYS
INITSYS:
;'CLEAR BSR
;'MOVLB 0
	MOVLB	0
;'ASM SHOWDEBUG DEFAULT SETTINGS FOR MICROCONTROLLERS WITH _OSCCON1_
	;DEFAULT	OSCCON1,NOSC HFINTOSC; NDIV 1 - COMMON AS THIS SIMPLY SETS THE HFINTOSC
;'OSCCON1 = 0X60
	MOVLW	96
	MOVWF	OSCCON1,BANKED
;'DEFAULT VALUE TYPICALLY, CSWHOLD MAY PROCEED; SOSCPWR LOW POWER
;'OSCCON3 = 0X00
	CLRF	OSCCON3,BANKED
;'DEFAULT VALUE TYPICALLY, MFOEN DISABLED; LFOEN DISABLED; ADOEN DISABLED; SOSCEN DISABLED; EXTOEN DISABLED; HFOEN DISABLED
;'OSCEN = 0X00
	CLRF	OSCEN,BANKED
;'DEFAULT VALUE
;'OSCTUNE = 0X00
	CLRF	OSCTUNE,BANKED
;'ASM SHOWDEBUG THE MCU IS A CHIP FAMILY 16
;'SECTION SUPPORTS MANY MCUS, 18FXXK40, 18FXXK42 ETC THAT HAVE NDIV3 BIT
;'ASM SHOWDEBUG OSCCON TYPE IS 101
;'OSCCON1 = 0X60          // SETTING OSCCON1 IMPLIES CLEARING CLEAR NDIV3:0
	MOVLW	96
	MOVWF	OSCCON1,BANKED
;'OSCFRQ = 0B00001000  '64MHZ
	MOVLW	8
	MOVWF	OSCFRQ,BANKED
;'ASM SHOWDEBUG _COMPLETE_THE_CHIP_SETUP_OF_BSR_ADCS_ANSEL_AND_OTHER_KEY_SETUP_REGISTERS_OR_REGISTER_BITS
;'CLEAR TBLPTRU
;'TBLPTRU = 0
	CLRF	TBLPTRU,ACCESS
;'ENSURE ALL PORTS ARE SET FOR DIGITAL I/O AND, TURN OFF A/D
;'SET ADFM OFF
	BANKSEL	ADCON0
	BCF	ADCON0,2,BANKED
;'SWITCH OFF A/D VAR(ADCON0)
;'SET ADCON0.ADON OFF
	BCF	ADCON0,7,BANKED
;'ANSELA = 0
	BANKSEL	ANSELA
	CLRF	ANSELA,BANKED
;'ANSELB = 0
	CLRF	ANSELB,BANKED
;'ANSELC = 0
	CLRF	ANSELC,BANKED
;'TURN OFF ALL PORTS
;'PORTA = 0
	CLRF	PORTA,ACCESS
;'PORTB = 0
	CLRF	PORTB,ACCESS
;'PORTC = 0
	CLRF	PORTC,ACCESS
	BANKSEL	0
	RETURN

;'********************************************************************************

;'SOURCE: USART.H (1014)
GLOBAL	INITUSART
INITUSART:
;'SET THE DEFAULT VALUE FOR USART HANDLER - REQUIRED WHEN MORE THAN ONE USART
;'COMPORT = 1
	MOVLW	1
	MOVWF	COMPORT,ACCESS
;'PIC USART 1 INIT
;'U1BRGH=SPBRGH_TEMP
	MOVLW	6
	BANKSEL	U1BRGH
	MOVWF	U1BRGH,BANKED
;'U1BRGL=SPBRGL_TEMP
	MOVLW	129
	MOVWF	U1BRG,BANKED
;'U1BRGS = BRGS1_SCRIPT
	BSF	U1CON0,7,BANKED
;'U1TXEN=1   'ENABLE TX1
	BSF	U1CON0,5,BANKED
;'U1RXEN=1   'ENABLE RX1
	BSF	U1CON0,4,BANKED
;'ON_U1CON1=1 'ENABLE USART1
	BSF	U1CON1,7,BANKED
	BANKSEL	0
	RETURN

;'********************************************************************************

;'SOURCE: HWI2C.H (802)
GLOBAL	SI2CINIT
SI2CINIT:
;'ASM SHOWDEBUG  THIS METHOD SETS THE MSSP MODULES FOR K-MODE FAMILY CHIPS
;'DIR HI2C_DATA OUT
	BCF	TRISB,5,ACCESS
;'DIR HI2C_CLOCK OUT
	BCF	TRISB,6,ACCESS
;'I2C1CON1 = I2C1I2C1CON1DEFAULT
	MOVLW	128
	BANKSEL	I2C1CON1
	MOVWF	I2C1CON1,BANKED
;'I2C1CON2 = I2C1I2C1CON2DEFAULT
	MOVLW	33
	MOVWF	I2C1CON2,BANKED
;'I2C1CLK =  I2C1CLOCKSOURCE
	MOVLW	3
	MOVWF	I2C1CLK,BANKED
;'I2C1CON0 = I2C1I2C1CON0DEFAULT
	MOVLW	132
	MOVWF	I2C1CON0,BANKED
;'I2C1PIR = 0    ;CLEAR ALL THE ERROR FLAGS
	CLRF	I2C1PIR,BANKED
;'I2C1ERR = 0
	CLRF	I2C1ERR,BANKED
;'I2C1CON0.EN=1
	BSF	I2C1CON0,7,BANKED
;'COMMENCE I2C PROTOCOL
;'I2C1CON2.ACNT = 0
	BCF	I2C1CON2,7,BANKED
;'I2C1CON2.ABD=0
	BCF	I2C1CON2,4,BANKED
;'I2C1CON0.MDR=1
	BSF	I2C1CON0,3,BANKED
;'INITIALISE CORRECT STATE OF I2C MODULE. NOT SURE WHY THIS IS NEEDED BUT IT IS. MICROCHIP FAILED TO EXPLAIN WHY THIS IS REQUIRED. BUT, IT IS.
;'SI2CSTART
	BANKSEL	0
	RCALL	SI2CSTART
;'SI2CSEND ( 0XFF )
	SETF	I2CBYTE,ACCESS
	RCALL	SI2CSEND
;'SI2CSTOP
	RCALL	SI2CSTOP
;'HI2CCURRENTMODE = 0
	CLRF	HI2CCURRENTMODE,ACCESS
	RETURN

;'********************************************************************************

;'SOURCE: HWI2C.H (879)
GLOBAL	SI2CSEND
SI2CSEND:
;'ASM SHOWDEBUG  REDIRECTED FOR K-MODE FAMILY PROBALBY CALLED HI2CSEND
;'ASM SHOWDEBUG  THIS METHOD SETS THE REGISTERS AND REGISTER BITS TO SEND I2C DATA
;'THIS IS NOW A STATE MACHINE TO CATER FOR THE NEW APPROACH WITH THE I2C MODULE
;'SELECT CASE HI2C1STATEMACHINE
;'CASE 2  'SEND DATA
GLOBAL	SYSSELECT1CASE1
SYSSELECT1CASE1:
	MOVLW	2
	SUBWF	HI2C1STATEMACHINE,W,ACCESS
	BTFSS	STATUS,2,ACCESS
	BRA	SYSSELECT1CASE2
;'HI2CWAITMSSPTIMEOUT = 0
	CLRF	HI2CWAITMSSPTIMEOUT,ACCESS
;'WAITS UP TO 254US THEN CREATES ERROR MESSAGE
;'DO WHILE HI2CWAITMSSPTIMEOUT < 255
GLOBAL	SYSDOLOOP_S3
SYSDOLOOP_S3:
	MOVLW	255
	SUBWF	HI2CWAITMSSPTIMEOUT,W,ACCESS
	BTFSC	STATUS,0,ACCESS
	BRA	SYSDOLOOP_E3
;'HI2CWAITMSSPTIMEOUT++
	INCF	HI2CWAITMSSPTIMEOUT,F,ACCESS
;'WAIT FOR THIS EVENT
;'IF I2C1STAT1.TXBE = 1 THEN
	BANKSEL	I2C1STAT1
	BTFSS	I2C1STAT1,5,BANKED
	BRA	ELSE15_1
;'SET THE BYTE COUNT TO 1, PLACE OUTBYTE IN REGISTER, AND WAIT FOR HARDWARE STATE MACHINE
;'I2C1CNT = 1
	MOVLW	1
	MOVWF	I2C1CNT,BANKED
;'I2C1TXB = I2CBYTE
	MOVFF	I2CBYTE,I2C1TXB
;'SI2CWAIT4ACK
	BANKSEL	0
	RCALL	SI2CWAIT4ACK
;'SI2CWAIT4MDR
	RCALL	SI2CWAIT4MDR
;'EXIT SUB
	RETURN
;'ELSE
	BRA	ENDIF15
GLOBAL	ELSE15_1
ELSE15_1:
;'WAIT 1 US
	MOVLW	5
	MOVWF	DELAYTEMP,ACCESS
GLOBAL	DELAYUS4
DELAYUS4:
	DECFSZ	DELAYTEMP,F,ACCESS
	BRA	DELAYUS4
;'END IF
GLOBAL	ENDIF15
ENDIF15:
;'LOOP
	BRA	SYSDOLOOP_S3
GLOBAL	SYSDOLOOP_E3
SYSDOLOOP_E3:
;'IF HI2CWAITMSSPTIMEOUT = 255 THEN HI2C1LASTERROR = HI2C1LASTERROR OR I2C1_TXBE_TIMEOUT
	INCF	HI2CWAITMSSPTIMEOUT,W,ACCESS
	BTFSS	STATUS,2,ACCESS
	BRA	ENDIF16
;'IF HI2CWAITMSSPTIMEOUT = 255 THEN HI2C1LASTERROR = HI2C1LASTERROR OR I2C1_TXBE_TIMEOUT
	MOVLW	2
	IORWF	HI2C1LASTERROR,F,ACCESS
;'IF HI2CWAITMSSPTIMEOUT = 255 THEN HI2C1LASTERROR = HI2C1LASTERROR OR I2C1_TXBE_TIMEOUT
GLOBAL	ENDIF16
ENDIF16:
;'CASE 1  'A START
	BRA	SYSSELECTEND1
GLOBAL	SYSSELECT1CASE2
SYSSELECT1CASE2:
	DECF	HI2C1STATEMACHINE,W,ACCESS
	BTFSS	STATUS,2,ACCESS
	BRA	SYSSELECT1CASE3
;'CLEAR THE OUTPUT BUFFERS, SET BYTE COUNT TO ZERO, CLEAR EVENT AND PLACE SLAVE ADDRESS IN REGISTER
;'I2C1STAT1.CLRBF = 1
	BANKSEL	I2C1STAT1
	BSF	I2C1STAT1,2,BANKED
;'I2C1CNT = 0
	CLRF	I2C1CNT,BANKED
;'I2C1PIR.SCIF = 0
	BCF	I2C1PIR,0,BANKED
;'I2C1ADB1 = I2CBYTE
	MOVFF	I2CBYTE,I2C1ADB1
;'WAIT HI2CITSCLWAITPERIOD US
	MOVLW	2
	MOVWF	DELAYTEMP2,ACCESS
GLOBAL	DELAYUSO5
DELAYUSO5:
	CLRF	DELAYTEMP,ACCESS
GLOBAL	DELAYUS5
DELAYUS5:
	DECFSZ	DELAYTEMP,F,ACCESS
	BRA	DELAYUS5
	DECFSZ	DELAYTEMP2,F,ACCESS
	BRA	DELAYUSO5
	MOVLW	19
	MOVWF	DELAYTEMP,ACCESS
GLOBAL	DELAYUS6
DELAYUS6:
	DECFSZ	DELAYTEMP,F,ACCESS
	BRA	DELAYUS6
;'SET TO START
;'I2C1CON0.S = 1
	BSF	I2C1CON0,5,BANKED
;'HI2CWAITMSSPTIMEOUT = 0
	CLRF	HI2CWAITMSSPTIMEOUT,ACCESS
;'WAITS UP TO 254US THEN CREATES ERROR MESSAGE
;'DO WHILE HI2CWAITMSSPTIMEOUT < 255
GLOBAL	SYSDOLOOP_S4
SYSDOLOOP_S4:
	MOVLW	255
	SUBWF	HI2CWAITMSSPTIMEOUT,W,ACCESS
	BTFSC	STATUS,0,ACCESS
	BRA	SYSDOLOOP_E4
;'HI2CWAITMSSPTIMEOUT++
	INCF	HI2CWAITMSSPTIMEOUT,F,ACCESS
;'WAIT FOR THIS EVENT
;'IF I2C1PIR.SCIF = 1 THEN
	BTFSS	I2C1PIR,0,BANKED
	BRA	ELSE17_1
;'WAIT HI2CITSCLWAITPERIOD US
	MOVLW	2
	MOVWF	DELAYTEMP2,ACCESS
GLOBAL	DELAYUSO7
DELAYUSO7:
	CLRF	DELAYTEMP,ACCESS
GLOBAL	DELAYUS7
DELAYUS7:
	DECFSZ	DELAYTEMP,F,ACCESS
	BRA	DELAYUS7
	DECFSZ	DELAYTEMP2,F,ACCESS
	BRA	DELAYUSO7
	MOVLW	19
	MOVWF	DELAYTEMP,ACCESS
GLOBAL	DELAYUS8
DELAYUS8:
	DECFSZ	DELAYTEMP,F,ACCESS
	BRA	DELAYUS8
;'HI2C1STATEMACHINE = 2  'SET STATE MACHINE TO SEND DATA
	MOVLW	2
	MOVWF	HI2C1STATEMACHINE,ACCESS
;'HI2CACKPOLLSTATE = I2C1CON1.5
	CLRF	HI2CACKPOLLSTATE,ACCESS
	BTFSC	I2C1CON1,5,BANKED
	INCF	HI2CACKPOLLSTATE,F,ACCESS
;'EXIT SUB
	BANKSEL	0
	RETURN
;'ELSE
	BRA	ENDIF17
GLOBAL	ELSE17_1
ELSE17_1:
;'WAIT HI2CITSCLWAITPERIOD US
	MOVLW	2
	MOVWF	DELAYTEMP2,ACCESS
GLOBAL	DELAYUSO9
DELAYUSO9:
	CLRF	DELAYTEMP,ACCESS
GLOBAL	DELAYUS9
DELAYUS9:
	DECFSZ	DELAYTEMP,F,ACCESS
	BRA	DELAYUS9
	DECFSZ	DELAYTEMP2,F,ACCESS
	BRA	DELAYUSO9
	MOVLW	19
	MOVWF	DELAYTEMP,ACCESS
GLOBAL	DELAYUS10
DELAYUS10:
	DECFSZ	DELAYTEMP,F,ACCESS
	BRA	DELAYUS10
;'END IF
GLOBAL	ENDIF17
ENDIF17:
;'LOOP
	BRA	SYSDOLOOP_S4
GLOBAL	SYSDOLOOP_E4
SYSDOLOOP_E4:
;'IF HI2CWAITMSSPTIMEOUT = 255 THEN HI2C1LASTERROR = HI2C1LASTERROR OR I2C1_START_TIMEOUT
	INCF	HI2CWAITMSSPTIMEOUT,W,ACCESS
	BTFSS	STATUS,2,ACCESS
	BRA	ENDIF18
;'IF HI2CWAITMSSPTIMEOUT = 255 THEN HI2C1LASTERROR = HI2C1LASTERROR OR I2C1_START_TIMEOUT
	MOVLW	4
	IORWF	HI2C1LASTERROR,F,ACCESS
;'IF HI2CWAITMSSPTIMEOUT = 255 THEN HI2C1LASTERROR = HI2C1LASTERROR OR I2C1_START_TIMEOUT
GLOBAL	ENDIF18
ENDIF18:
;'CASE 3  'A RESTART
	BRA	SYSSELECTEND1
GLOBAL	SYSSELECT1CASE3
SYSSELECT1CASE3:
	MOVLW	3
	SUBWF	HI2C1STATEMACHINE,W,ACCESS
	BTFSS	STATUS,2,ACCESS
	BRA	SYSSELECTEND1
;'WAIT FOR HARDWARE MACHINE TO SETTLE
;'WAIT WHILE I2C1STAT0.MMA = 1
GLOBAL	SYSWAITLOOP2
SYSWAITLOOP2:
	BANKSEL	I2C1STAT0
	BTFSC	I2C1STAT0,5,BANKED
	BRA	SYSWAITLOOP2
;'SET COUNT TO ZERO, PLACE SLAVE ADDRESS IN REGISTER AND CLEAR EVENT
;'I2C1CNT = 0
	CLRF	I2C1CNT,BANKED
;'I2C1ADB1 = I2CBYTE
	MOVFF	I2CBYTE,I2C1ADB1
;'I2C1PIR.SCIF = 0
	BCF	I2C1PIR,0,BANKED
;'HI2CWAITMSSPTIMEOUT = 0
	CLRF	HI2CWAITMSSPTIMEOUT,ACCESS
;'WAITS UP TO 254US THEN CREATES ERROR MESSAGE
;'DO WHILE HI2CWAITMSSPTIMEOUT < 255
GLOBAL	SYSDOLOOP_S5
SYSDOLOOP_S5:
	MOVLW	255
	SUBWF	HI2CWAITMSSPTIMEOUT,W,ACCESS
	BTFSC	STATUS,0,ACCESS
	BRA	SYSDOLOOP_E5
;'HI2CWAITMSSPTIMEOUT++
	INCF	HI2CWAITMSSPTIMEOUT,F,ACCESS
;'WAIT FOR THIS EVENT
;'IF I2C1PIR.SCIF = 1 THEN
	BTFSS	I2C1PIR,0,BANKED
	BRA	ELSE19_1
;'HI2C1STATEMACHINE = 2  'SET STATE MACHINE TO SEND DATA
	MOVLW	2
	MOVWF	HI2C1STATEMACHINE,ACCESS
;'HI2CACKPOLLSTATE = I2C1CON1.5
	CLRF	HI2CACKPOLLSTATE,ACCESS
	BTFSC	I2C1CON1,5,BANKED
	INCF	HI2CACKPOLLSTATE,F,ACCESS
;'EXIT SUB
	BANKSEL	0
	RETURN
;'ELSE
	BRA	ENDIF19
GLOBAL	ELSE19_1
ELSE19_1:
;'SET AS START AND CLEAR RESTART
;'I2C1CON0.S = 1
	BSF	I2C1CON0,5,BANKED
;'I2C1CON0.RSEN=0
	BCF	I2C1CON0,6,BANKED
;'WAIT 1 US
	MOVLW	5
	MOVWF	DELAYTEMP,ACCESS
GLOBAL	DELAYUS11
DELAYUS11:
	DECFSZ	DELAYTEMP,F,ACCESS
	BRA	DELAYUS11
;'END IF
GLOBAL	ENDIF19
ENDIF19:
;'LOOP
	BRA	SYSDOLOOP_S5
GLOBAL	SYSDOLOOP_E5
SYSDOLOOP_E5:
;'IF HI2CWAITMSSPTIMEOUT = 255 THEN HI2C1LASTERROR = HI2C1LASTERROR OR I2C1_RESTART_TIMEOUT
	INCF	HI2CWAITMSSPTIMEOUT,W,ACCESS
	BTFSS	STATUS,2,ACCESS
	BRA	ENDIF20
;'IF HI2CWAITMSSPTIMEOUT = 255 THEN HI2C1LASTERROR = HI2C1LASTERROR OR I2C1_RESTART_TIMEOUT
	MOVLW	8
	IORWF	HI2C1LASTERROR,F,ACCESS
;'IF HI2CWAITMSSPTIMEOUT = 255 THEN HI2C1LASTERROR = HI2C1LASTERROR OR I2C1_RESTART_TIMEOUT
GLOBAL	ENDIF20
ENDIF20:
;'END SELECT
GLOBAL	SYSSELECTEND1
SYSSELECTEND1:
	BANKSEL	0
	RETURN

;'********************************************************************************

;'SOURCE: HWI2C.H (831)
GLOBAL	SI2CSTART
SI2CSTART:
;'ASM SHOWDEBUG  REDIRECTED FOR K-MODE FAMILY PROBALBY CALLED HI2CSTART
;'ASM SHOWDEBUG  THIS METHOD SETS THE REGISTERS AND REGISTER BITS TO GENERATE THE I2C  START SIGNAL. MASTER_MODE ONLY.
;'HI2C1STATEMACHINE = 1
	MOVLW	1
	MOVWF	HI2C1STATEMACHINE,ACCESS
;'HI2CWAITMSSPTIMEOUT = FALSE
	CLRF	HI2CWAITMSSPTIMEOUT,ACCESS
;'CLEAR THE ERROR STATE VARIABLE
;'HI2C1LASTERROR = I2C1_GOOD
	CLRF	HI2C1LASTERROR,ACCESS
	RETURN

;'********************************************************************************

;'SOURCE: HWI2C.H (850)
GLOBAL	SI2CSTOP
SI2CSTOP:
;'ASM SHOWDEBUG  REDIRECTED FOR K-MODE FAMILY PROBALBY CALLED HI2CSTOP
;'ASM SHOWDEBUG  THIS METHOD SETS THE REGISTERS AND REGISTER BITS TO GENERATE THE I2C  STOP SIGNAL
;'WAITS UP TO 254US THEN SET THE ERROR STATE
;'HI2C1STATEMACHINE = 0
	CLRF	HI2C1STATEMACHINE,ACCESS
;'HI2CWAITMSSPTIMEOUT = 0
	CLRF	HI2CWAITMSSPTIMEOUT,ACCESS
;'DO WHILE HI2CWAITMSSPTIMEOUT < 255
GLOBAL	SYSDOLOOP_S2
SYSDOLOOP_S2:
	MOVLW	255
	SUBWF	HI2CWAITMSSPTIMEOUT,W,ACCESS
	BTFSC	STATUS,0,ACCESS
	BRA	SYSDOLOOP_E2
;'HI2CWAITMSSPTIMEOUT++
	INCF	HI2CWAITMSSPTIMEOUT,F,ACCESS
;'WAIT TILL THIS EVENT
;'IF I2C1PIR.PCIF = 1 THEN
	BANKSEL	I2C1PIR
	BTFSS	I2C1PIR,2,BANKED
	BRA	ELSE13_1
;'SI2CWAIT4STOP
	BANKSEL	0
	RCALL	SI2CWAIT4STOP
;'TSCL WAIT, PART OF THE SPECIFICIATION OF THE I2C MODULE
;'WAIT HI2CITSCLWAITPERIOD US
	MOVLW	2
	MOVWF	DELAYTEMP2,ACCESS
GLOBAL	DELAYUSO1
DELAYUSO1:
	CLRF	DELAYTEMP,ACCESS
GLOBAL	DELAYUS1
DELAYUS1:
	DECFSZ	DELAYTEMP,F,ACCESS
	BRA	DELAYUS1
	DECFSZ	DELAYTEMP2,F,ACCESS
	BRA	DELAYUSO1
	MOVLW	19
	MOVWF	DELAYTEMP,ACCESS
GLOBAL	DELAYUS2
DELAYUS2:
	DECFSZ	DELAYTEMP,F,ACCESS
	BRA	DELAYUS2
;'EXIT SUB
	RETURN
;'ELSE
	BRA	ENDIF13
GLOBAL	ELSE13_1
ELSE13_1:
;'WAIT 1 US
	MOVLW	5
	MOVWF	DELAYTEMP,ACCESS
GLOBAL	DELAYUS3
DELAYUS3:
	DECFSZ	DELAYTEMP,F,ACCESS
	BRA	DELAYUS3
;'END IF
GLOBAL	ENDIF13
ENDIF13:
;'LOOP
	BRA	SYSDOLOOP_S2
GLOBAL	SYSDOLOOP_E2
SYSDOLOOP_E2:
;'IF HI2CWAITMSSPTIMEOUT = 255 THEN HI2C1LASTERROR = HI2C1LASTERROR OR I2C1_STOP_TIMEOUT
	INCF	HI2CWAITMSSPTIMEOUT,W,ACCESS
	BTFSS	STATUS,2,ACCESS
	BRA	ENDIF14
;'IF HI2CWAITMSSPTIMEOUT = 255 THEN HI2C1LASTERROR = HI2C1LASTERROR OR I2C1_STOP_TIMEOUT
	MOVLW	128
	IORWF	HI2C1LASTERROR,F,ACCESS
;'IF HI2CWAITMSSPTIMEOUT = 255 THEN HI2C1LASTERROR = HI2C1LASTERROR OR I2C1_STOP_TIMEOUT
GLOBAL	ENDIF14
ENDIF14:
	BANKSEL	0
	RETURN

;'********************************************************************************

;'SOURCE: HWI2C.H (1013)
GLOBAL	SI2CWAIT4ACK
SI2CWAIT4ACK:
;'HI2CWAITMSSPTIMEOUT = 0
	CLRF	HI2CWAITMSSPTIMEOUT,ACCESS
;'WAITS UP TO 254US THEN CREATES ERROR MESSAGE
;'DO WHILE HI2CWAITMSSPTIMEOUT < 255
GLOBAL	SYSDOLOOP_S6
SYSDOLOOP_S6:
	MOVLW	255
	SUBWF	HI2CWAITMSSPTIMEOUT,W,ACCESS
	BTFSC	STATUS,0,ACCESS
	BRA	SYSDOLOOP_E6
;'HI2CWAITMSSPTIMEOUT++
	INCF	HI2CWAITMSSPTIMEOUT,F,ACCESS
;'WAIT FOR THIS EVENT
;'IF I2C1CON1.ACKSTAT = 0 THEN
	BANKSEL	I2C1CON1
	BTFSC	I2C1CON1,5,BANKED
	BRA	ELSE23_1
;'SET STATUS
;'HI2CACKPOLLSTATE = !I2C1CON1.ACKSTAT
	CLRF	SYSTEMP1,ACCESS
	BTFSC	I2C1CON1,5,BANKED
	INCF	SYSTEMP1,F,ACCESS
	COMF	SYSTEMP1,W,ACCESS
	MOVWF	HI2CACKPOLLSTATE,ACCESS
;'EXIT SUB
	BANKSEL	0
	RETURN
;'ELSE
	BRA	ENDIF23
GLOBAL	ELSE23_1
ELSE23_1:
;'WAIT 1 US
	MOVLW	5
	MOVWF	DELAYTEMP,ACCESS
GLOBAL	DELAYUS12
DELAYUS12:
	DECFSZ	DELAYTEMP,F,ACCESS
	BRA	DELAYUS12
;'END IF
GLOBAL	ENDIF23
ENDIF23:
;'LOOP
	BRA	SYSDOLOOP_S6
GLOBAL	SYSDOLOOP_E6
SYSDOLOOP_E6:
;'IF HI2CWAITMSSPTIMEOUT = 255 THEN HI2C1LASTERROR = HI2C1LASTERROR OR I2C1_ACK_TIMEOUT
	INCF	HI2CWAITMSSPTIMEOUT,W,ACCESS
	BTFSS	STATUS,2,ACCESS
	BRA	ENDIF24
;'IF HI2CWAITMSSPTIMEOUT = 255 THEN HI2C1LASTERROR = HI2C1LASTERROR OR I2C1_ACK_TIMEOUT
	MOVLW	32
	IORWF	HI2C1LASTERROR,F,ACCESS
;'IF HI2CWAITMSSPTIMEOUT = 255 THEN HI2C1LASTERROR = HI2C1LASTERROR OR I2C1_ACK_TIMEOUT
GLOBAL	ENDIF24
ENDIF24:
;'HI2CWAITMSSPTIMEOUT IS NOW TRUE = 255
	BANKSEL	0
	RETURN

;'********************************************************************************

;'SOURCE: HWI2C.H (1042)
GLOBAL	SI2CWAIT4MDR
SI2CWAIT4MDR:
;'HI2CWAITMSSPTIMEOUT = 0
	CLRF	HI2CWAITMSSPTIMEOUT,ACCESS
;'WAITS UP TO 254US THEN CREATES ERROR MESSAGE
;'DO WHILE HI2CWAITMSSPTIMEOUT < 255
GLOBAL	SYSDOLOOP_S7
SYSDOLOOP_S7:
	MOVLW	255
	SUBWF	HI2CWAITMSSPTIMEOUT,W,ACCESS
	BTFSC	STATUS,0,ACCESS
	BRA	SYSDOLOOP_E7
;'HI2CWAITMSSPTIMEOUT++
	INCF	HI2CWAITMSSPTIMEOUT,F,ACCESS
;'WAIT FOR THIS EVENT
;'IF I2C1CON0.MDR = 0 THEN
	BANKSEL	I2C1CON0
	BTFSC	I2C1CON0,3,BANKED
	BRA	ELSE26_1
;'EXIT SUB
	BANKSEL	0
	RETURN
;'ELSE
	BRA	ENDIF26
GLOBAL	ELSE26_1
ELSE26_1:
;'WAIT 1 US
	MOVLW	5
	MOVWF	DELAYTEMP,ACCESS
GLOBAL	DELAYUS13
DELAYUS13:
	DECFSZ	DELAYTEMP,F,ACCESS
	BRA	DELAYUS13
;'END IF
GLOBAL	ENDIF26
ENDIF26:
;'LOOP
	BRA	SYSDOLOOP_S7
GLOBAL	SYSDOLOOP_E7
SYSDOLOOP_E7:
;'IF HI2CWAITMSSPTIMEOUT = 255 THEN HI2C1LASTERROR = HI2C1LASTERROR OR I2C1_MDR_TIMEOUT
	INCF	HI2CWAITMSSPTIMEOUT,W,ACCESS
	BTFSS	STATUS,2,ACCESS
	BRA	ENDIF27
;'IF HI2CWAITMSSPTIMEOUT = 255 THEN HI2C1LASTERROR = HI2C1LASTERROR OR I2C1_MDR_TIMEOUT
	MOVLW	64
	IORWF	HI2C1LASTERROR,F,ACCESS
;'IF HI2CWAITMSSPTIMEOUT = 255 THEN HI2C1LASTERROR = HI2C1LASTERROR OR I2C1_MDR_TIMEOUT
GLOBAL	ENDIF27
ENDIF27:
;'HI2CWAITMSSPTIMEOUT IS NOW TRUE = 255
	BANKSEL	0
	RETURN

;'********************************************************************************

;'SOURCE: HWI2C.H (1065)
GLOBAL	SI2CWAIT4STOP
SI2CWAIT4STOP:
;'HI2CWAITMSSPTIMEOUT = 0
	CLRF	HI2CWAITMSSPTIMEOUT,ACCESS
;'WAITS UP TO 254US THEN CREATES ERROR MESSAGE
;'DO WHILE HI2CWAITMSSPTIMEOUT < 255
GLOBAL	SYSDOLOOP_S8
SYSDOLOOP_S8:
	MOVLW	255
	SUBWF	HI2CWAITMSSPTIMEOUT,W,ACCESS
	BTFSC	STATUS,0,ACCESS
	BRA	SYSDOLOOP_E8
;'HI2CWAITMSSPTIMEOUT++
	INCF	HI2CWAITMSSPTIMEOUT,F,ACCESS
;'WAIT FOR THIS EVENT
;'IF I2C1PIR.PCIF = 1 THEN
	BANKSEL	I2C1PIR
	BTFSS	I2C1PIR,2,BANKED
	BRA	ELSE28_1
;'EXIT SUB
	BANKSEL	0
	RETURN
;'ELSE
	BRA	ENDIF28
GLOBAL	ELSE28_1
ELSE28_1:
;'WAIT 1 US
	MOVLW	5
	MOVWF	DELAYTEMP,ACCESS
GLOBAL	DELAYUS14
DELAYUS14:
	DECFSZ	DELAYTEMP,F,ACCESS
	BRA	DELAYUS14
;'END IF
GLOBAL	ENDIF28
ENDIF28:
;'LOOP
	BRA	SYSDOLOOP_S8
GLOBAL	SYSDOLOOP_E8
SYSDOLOOP_E8:
;'IF HI2CWAITMSSPTIMEOUT = 255 THEN HI2C1LASTERROR = HI2C1LASTERROR OR I2C1_STOP_TIMEOUT
	INCF	HI2CWAITMSSPTIMEOUT,W,ACCESS
	BTFSS	STATUS,2,ACCESS
	BRA	ENDIF29
;'IF HI2CWAITMSSPTIMEOUT = 255 THEN HI2C1LASTERROR = HI2C1LASTERROR OR I2C1_STOP_TIMEOUT
	MOVLW	128
	IORWF	HI2C1LASTERROR,F,ACCESS
;'IF HI2CWAITMSSPTIMEOUT = 255 THEN HI2C1LASTERROR = HI2C1LASTERROR OR I2C1_STOP_TIMEOUT
GLOBAL	ENDIF29
ENDIF29:
;'HI2CWAITMSSPTIMEOUT IS NOW TRUE = 255
	BANKSEL	0
	RETURN

;'********************************************************************************

;'SOURCE: SYSTEM.H (3153)
GLOBAL	SYSCOMPEQUAL
SYSCOMPEQUAL:
;'DIM SYSBYTETEMPA, SYSBYTETEMPB, SYSBYTETEMPX AS BYTE
;'SETF SYSBYTETEMPX
	SETF	SYSBYTETEMPX,ACCESS
;'MOVF SYSBYTETEMPB, W
	MOVF	SYSBYTETEMPB, W,ACCESS
;'CPFSEQ SYSBYTETEMPA
	CPFSEQ	SYSBYTETEMPA,ACCESS
;'CLRF SYSBYTETEMPX
	CLRF	SYSBYTETEMPX,ACCESS
	RETURN

;'********************************************************************************

;'SOURCE: SYSTEM.H (2868)
GLOBAL	SYSDIVSUB
SYSDIVSUB:
;'DIM SYSBYTETEMPA AS BYTE
;'DIM SYSBYTETEMPB AS BYTE
;'DIM SYSBYTETEMPX AS BYTE
;'CHECK FOR DIV/0
;'MOVF SYSBYTETEMPB, F
	MOVF	SYSBYTETEMPB, F,ACCESS
	;BTFSC	STATUS,2
	BTFSC	STATUS,2,ACCESS
;'RETURN
	RETURN
;'MAIN CALC ROUTINE
;'SYSBYTETEMPX = 0
	CLRF	SYSBYTETEMPX,ACCESS
;'SYSDIVLOOP = 8
	MOVLW	8
	MOVWF	SYSDIVLOOP,ACCESS
GLOBAL	SYSDIV8START
SYSDIV8START:
	;BCF	STATUS,0
	BCF	STATUS,0,ACCESS
;'RLF SYSBYTETEMPA, F
	RLCF	SYSBYTETEMPA, F,ACCESS
;'RLF SYSBYTETEMPX, F
	RLCF	SYSBYTETEMPX, F,ACCESS
;'MOVF SYSBYTETEMPB, W
	MOVF	SYSBYTETEMPB, W,ACCESS
;'SUBWF SYSBYTETEMPX, F
	SUBWF	SYSBYTETEMPX, F,ACCESS
;'BSF SYSBYTETEMPA, 0
	BSF	SYSBYTETEMPA, 0,ACCESS
	;BTFSC	STATUS,0
	BTFSC	STATUS,0,ACCESS
;'GOTO DIV8NOTNEG
	BRA	DIV8NOTNEG
;'BCF SYSBYTETEMPA, 0
	BCF	SYSBYTETEMPA, 0,ACCESS
;'MOVF SYSBYTETEMPB, W
	MOVF	SYSBYTETEMPB, W,ACCESS
;'ADDWF SYSBYTETEMPX, F
	ADDWF	SYSBYTETEMPX, F,ACCESS
GLOBAL	DIV8NOTNEG
DIV8NOTNEG:
;'DECFSZ SYSDIVLOOP, F
	DECFSZ	SYSDIVLOOP, F,ACCESS
;'GOTO SYSDIV8START
	BRA	SYSDIV8START
	RETURN

;'********************************************************************************

;'SOURCE: SYSTEM.H (1646)
GLOBAL	SYSREADSTRING
SYSREADSTRING:
;'DIM SYSCALCTEMPA AS BYTE
;'DIM SYSSTRINGLENGTH AS BYTE
;'CHIPFAMILY 16 SUPPORT
;'GET LENGTH
;'TBLRD*+
	TBLRD*+
	;MOVFF	TABLAT,SYSCALCTEMPA
	MOVFF	TABLAT,SYSCALCTEMPA
	;MOVFF	TABLAT,INDF1
	MOVFF	TABLAT,INDF1
;'GOTO SYSSTRINGREADCHECK
	BRA	SYSSTRINGREADCHECK
GLOBAL	SYSREADSTRINGPART
SYSREADSTRINGPART:
;'TBLRD*+
	TBLRD*+
	;MOVF	TABLAT,W
	MOVF	TABLAT, W,ACCESS
;'MOVWF SYSCALCTEMPA
	MOVWF	SYSCALCTEMPA,ACCESS
;'ADDWF SYSSTRINGLENGTH,F
	ADDWF	SYSSTRINGLENGTH,F,ACCESS
;'CHECK LENGTH
GLOBAL	SYSSTRINGREADCHECK
SYSSTRINGREADCHECK:
;'IF LENGTH IS 0, EXIT
;'MOVF SYSCALCTEMPA,F
	MOVF	SYSCALCTEMPA,F,ACCESS
	;BTFSC	STATUS,2
	BTFSC	STATUS,2,ACCESS
;'RETURN
	RETURN
;'COPY
GLOBAL	SYSSTRINGREAD
SYSSTRINGREAD:
;'COPY CHAR
;'TBLRD*+
	TBLRD*+
	;MOVFF	TABLAT,PREINC1
	MOVFF	TABLAT,PREINC1
;'DECFSZ SYSCALCTEMPA, F
	DECFSZ	SYSCALCTEMPA, F,ACCESS
;'GOTO SYSSTRINGREAD
	BRA	SYSSTRINGREAD
	RETURN

;'********************************************************************************

GLOBAL	SYSSTRINGTABLES
SYSSTRINGTABLES:

GLOBAL	STRINGTABLE1
STRINGTABLE1:
	DB	12,72,97,114,100,119,97,114,101,32,73,50,67

	ALIGN	2;X3

GLOBAL	STRINGTABLE2
STRINGTABLE2:
	DB	3,32,32,32

	ALIGN	2;X3

GLOBAL	STRINGTABLE3
STRINGTABLE3:
	DB	1,32

	ALIGN	2;X3

GLOBAL	STRINGTABLE4
STRINGTABLE4:
	DB	2,45,45

	ALIGN	2;X3

GLOBAL	STRINGTABLE5
STRINGTABLE5:
	DB	2,33,32

	ALIGN	2;X3

GLOBAL	STRINGTABLE6
STRINGTABLE6:
	DB	13,69,110,100,32,111,102,32,83,101,97,114,99,104

	ALIGN	2;X3

;'********************************************************************************

;'SOURCE: PICAS.H (7)
GLOBAL	FN__HEXPICAS
FN__HEXPICAS:
;'_HEXPICAS(0) = 2
	MOVLW	2
	BANKSEL	SYS_HEXPICAS_0
	MOVWF	SYS_HEXPICAS_0,BANKED
;'DIM SYSSTRINGTEMP AS BYTE
;'LOW NIBBLE
;'SYSSTRINGTEMP = SYSVALTEMP AND 0X0F
	MOVLW	15
	ANDWF	SYSVALTEMP,W,ACCESS
	BANKSEL	SYSSTRINGTEMP
	MOVWF	SYSSTRINGTEMP,BANKED
;'IF SYSSTRINGTEMP > 9 THEN SYSSTRINGTEMP = SYSSTRINGTEMP + 7
	SUBLW	9
	BTFSC	STATUS,0,ACCESS
	BRA	ENDIF8
;'IF SYSSTRINGTEMP > 9 THEN SYSSTRINGTEMP = SYSSTRINGTEMP + 7
	MOVLW	7
	ADDWF	SYSSTRINGTEMP,F,BANKED
;'IF SYSSTRINGTEMP > 9 THEN SYSSTRINGTEMP = SYSSTRINGTEMP + 7
GLOBAL	ENDIF8
ENDIF8:
;'_HEXPICAS(2) = SYSSTRINGTEMP + 48
	MOVLW	48
	ADDWF	SYSSTRINGTEMP,W,BANKED
	BANKSEL	SYS_HEXPICAS_2
	MOVWF	SYS_HEXPICAS_2,BANKED
;'GET HIGH NIBBLE
;'FOR SYSSTRINGTEMP = 1 TO 4
;'LEGACY METHOD
	BANKSEL	SYSSTRINGTEMP
	CLRF	SYSSTRINGTEMP,BANKED
GLOBAL	SYSFORLOOP3
SYSFORLOOP3:
	INCF	SYSSTRINGTEMP,F,BANKED
;'ROTATE SYSVALTEMP RIGHT
	RRCF	SYSVALTEMP,F,ACCESS
;'NEXT
	MOVLW	4
	SUBWF	SYSSTRINGTEMP,W,BANKED
	BTFSS	STATUS,0,ACCESS
	BRA	SYSFORLOOP3
GLOBAL	SYSFORLOOPEND3
SYSFORLOOPEND3:
;'SYSSTRINGTEMP = SYSVALTEMP AND 0X0F
	MOVLW	15
	ANDWF	SYSVALTEMP,W,ACCESS
	MOVWF	SYSSTRINGTEMP,BANKED
;'IF SYSSTRINGTEMP > 9 THEN SYSSTRINGTEMP = SYSSTRINGTEMP + 7
	SUBLW	9
	BTFSC	STATUS,0,ACCESS
	BRA	ENDIF10
;'IF SYSSTRINGTEMP > 9 THEN SYSSTRINGTEMP = SYSSTRINGTEMP + 7
	MOVLW	7
	ADDWF	SYSSTRINGTEMP,F,BANKED
;'IF SYSSTRINGTEMP > 9 THEN SYSSTRINGTEMP = SYSSTRINGTEMP + 7
GLOBAL	ENDIF10
ENDIF10:
;'_HEXPICAS(1) = SYSSTRINGTEMP + 48
	MOVLW	48
	ADDWF	SYSSTRINGTEMP,W,BANKED
	BANKSEL	SYS_HEXPICAS_1
	MOVWF	SYS_HEXPICAS_1,BANKED
	BANKSEL	0
	RETURN

;'********************************************************************************

	ALIGN	2;X2
;'
;' Declare Power-On-Reset entry point
;'
 END     RESETVEC
