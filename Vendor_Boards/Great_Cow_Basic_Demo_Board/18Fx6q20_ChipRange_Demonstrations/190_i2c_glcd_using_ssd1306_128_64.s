;'Program compiled by GCBASIC (2024.2.16 (Windows 64 bit) : Build 1337) for Microchip PIC-AS using FreeBASIC 1.07.1/2024-02-15 CRC247
;'  See the GCBASIC forums at http://sourceforge.net/projects/gcbasic/forums,
;'  Check the documentation and Help at http://gcbasic.sourceforge.net/help/,
;'or, email:
;'   evanvennn at users dot sourceforge dot net

;'********************************************************************************


;'Set up the assembler options (Chip type, clock source, other bits and pieces)
;'PROCESSOR   18F16Q20
 PAGEWIDTH   180
 RADIX       DEC
 TITLE       "D:\GreatCowBASICGits\Demonstration_Sources.git\Vendor_Boards\Great_Cow_Basic_Demo_Board\18Fx6q20_ChipRange_Demonstrations\190_i2c_glcd_using_ssd1306_128_64.s"
 SUBTITLE    "02-17-2024"

;' Reverse lookup file(s)
;' C:\Program Files\Microchip\xc8\v2.46\pic\include\proc\pic18f16q20.inc
;' C:\Program Files\Microchip\xc8\v2.46\pic\dat\cfgmap\18f16q20.cfgmap
;' Alternative CONFIG file is to be found at C:\Program Files\Microchip\xc8\vX.YY\pic\dat\cfgdata as per Microchip support ticket #00730936 

;'********************************************************************************
;'Explicit PIC-AS constants to resolve the crazyness of the PIC-AS syntax
;'These are therefore the same as MPASM
#define BANKED b
#define ACCESS a
#define UPPER low highword

;'********************************************************************************
;'Explicit CONFIG
 CONFIG CPD=OFF                                  ;C1 Reverselookup  CPD = OFF
 CONFIG CP=OFF                                   ;C1 Reverselookup  CP = OFF
 CONFIG WRTSAF=OFF                               ;C1 Reverselookup  WRTSAF = OFF
 CONFIG WRTD=OFF                                 ;C1 Reverselookup  WRTD = OFF
 CONFIG WRTB=OFF                                 ;C1 Reverselookup  WRTB = OFF
 CONFIG VDDIO3MD=STANDARD_RANGE                  ;C1 Reverselookup  VDDIO3MD = STANDARD_RANGE
 CONFIG VDDIO2MD=STANDARD_RANGE                  ;C1 Reverselookup  VDDIO2MD = STANDARD_RANGE
 CONFIG WDTE=OFF                                 ;C1 Reverselookup  WDTE = OFF
 CONFIG XINST=OFF                                ;C1 Reverselookup  XINST = OFF
 CONFIG LVP=OFF                                  ;C1 Reverselookup  LVP = OFF
 CONFIG MVECEN=OFF                               ;C1 Reverselookup  MVECEN = OFF
 CONFIG MCLRE=INTMCLR                            ;C1 Reverselookup  MCLRE = INTMCLR
 CONFIG FCMEN=ON                                 ;C1 Reverselookup  FCMEN = ON
 CONFIG CLKOUTEN=OFF                             ;C1 Reverselookup  CLKOUTEN = OFF
 CONFIG RSTOSC=HFINTOSC_1MHZ                     ;C1 Reverselookup  RSTOSC = HFINTOSC_1MHZ
 CONFIG FEXTOSC=OFF                              ;C1 Reverselookup  FEXTOSC = OFF
;'Inferred CONFIG
 CONFIG BBEN=OFF                                 ;C1 Reverselookup BBEN=OFF
 CONFIG BBSIZE=BBSIZE_128                        ;C1 Reverselookup BBSIZE=BBSIZE_128
 CONFIG BOREN=OFF                                ;C1 Reverselookup BOREN=OFF
 CONFIG BORV=VBOR_2P85                           ;C1 Reverselookup BORV=VBOR_2P85
 CONFIG CSWEN=ON                                 ;C1 Reverselookup CSWEN=ON
 CONFIG DEBUG=OFF                                ;C1 Reverselookup DEBUG=OFF
 CONFIG FCMENP=OFF                               ;C1 Reverselookup FCMENP=OFF
 CONFIG FCMENS=OFF                               ;C1 Reverselookup FCMENS=OFF
 CONFIG IVT1WAY=OFF                              ;C1 Reverselookup IVT1WAY=OFF
 CONFIG LPBOREN=OFF                              ;C1 Reverselookup LPBOREN=OFF
 CONFIG PPS1WAY=OFF                              ;C1 Reverselookup PPS1WAY=OFF
 CONFIG PR1WAY=OFF                               ;C1 Reverselookup PR1WAY=OFF
 CONFIG PWRTS=PWRT_OFF                           ;C1 Reverselookup PWRTS=PWRT_OFF
 CONFIG STVREN=OFF                               ;C1 Reverselookup STVREN=OFF
 CONFIG WDTCCS=LFINTOSC                          ;C1 Reverselookup WDTCCS=LFINTOSC
 CONFIG WDTCPS=WDTCPS_0                          ;C1 Reverselookup WDTCPS=WDTCPS_0
 CONFIG WDTCWS=WDTCWS_0                          ;C1 Reverselookup WDTCWS=WDTCWS_0
 CONFIG WRTAPP=OFF                               ;C1 Reverselookup WRTAPP=OFF
 CONFIG WRTC=OFF                                 ;C1 Reverselookup WRTC=OFF


;'********************************************************************************
;' The XC8 xc.inc include file.  This MUST be placed after the CONFIG statements.

 #include <xc.inc>

;'********************************************************************************

;'Set aside RAM memory locations for variables. All variables are global.
GLOBAL	BYTENUMBER
 BYTENUMBER                       EQU 1294          ; 0X50E
GLOBAL	CCOUNT
 CCOUNT                           EQU 1295          ; 0X50F
GLOBAL	CHARCODE
 CHARCODE                         EQU 1296          ; 0X510
GLOBAL	CHARCOL
 CHARCOL                          EQU 1297          ; 0X511
GLOBAL	CHARCOLS
 CHARCOLS                         EQU 1299          ; 0X513
GLOBAL	CHARCOL_H
 CHARCOL_H                        EQU 1298          ; 0X512
GLOBAL	CHARLOCX
 CHARLOCX                         EQU 1300          ; 0X514
GLOBAL	CHARLOCX_H
 CHARLOCX_H                       EQU 1301          ; 0X515
GLOBAL	CHARLOCY
 CHARLOCY                         EQU 1302          ; 0X516
GLOBAL	CHARLOCY_H
 CHARLOCY_H                       EQU 1303          ; 0X517
GLOBAL	CHARROW
 CHARROW                          EQU 1304          ; 0X518
GLOBAL	CHARROWS
 CHARROWS                         EQU 1306          ; 0X51A
GLOBAL	CHARROW_H
 CHARROW_H                        EQU 1305          ; 0X519
GLOBAL	COL
 COL                              EQU 1307          ; 0X51B
GLOBAL	CURRCHARCOL
 CURRCHARCOL                      EQU 1308          ; 0X51C
GLOBAL	CURRCHARROW
 CURRCHARROW                      EQU 1309          ; 0X51D
GLOBAL	CURRCHARVAL
 CURRCHARVAL                      EQU 1310          ; 0X51E
GLOBAL	DDF_X
 DDF_X                            EQU 1311          ; 0X51F
GLOBAL	DDF_X_H
 DDF_X_H                          EQU 1312          ; 0X520
GLOBAL	DDF_Y
 DDF_Y                            EQU 1313          ; 0X521
GLOBAL	DDF_Y_H
 DDF_Y_H                          EQU 1314          ; 0X522
GLOBAL	DELAYTEMP
 DELAYTEMP                        EQU 1280          ; 0X500
GLOBAL	DELAYTEMP2
 DELAYTEMP2                       EQU 1281          ; 0X501
GLOBAL	DRAWLINE
 DRAWLINE                         EQU 1315          ; 0X523
GLOBAL	DRAWLINE_H
 DRAWLINE_H                       EQU 1316          ; 0X524
GLOBAL	FF
 FF                               EQU 1317          ; 0X525
GLOBAL	FF_H
 FF_H                             EQU 1318          ; 0X526
GLOBAL	FILLCIRCLEXX
 FILLCIRCLEXX                     EQU 1319          ; 0X527
GLOBAL	FILLCIRCLEYY
 FILLCIRCLEYY                     EQU 1320          ; 0X528
GLOBAL	GLCDBACKGROUND
 GLCDBACKGROUND                   EQU 1321          ; 0X529
GLOBAL	GLCDBACKGROUND_H
 GLCDBACKGROUND_H                 EQU 1322          ; 0X52A
GLOBAL	GLCDBITNO
 GLCDBITNO                        EQU 1323          ; 0X52B
GLOBAL	GLCDCHANGE
 GLCDCHANGE                       EQU 1324          ; 0X52C
GLOBAL	GLCDCOLOUR
 GLCDCOLOUR                       EQU 1325          ; 0X52D
GLOBAL	GLCDCOLOUR_H
 GLCDCOLOUR_H                     EQU 1326          ; 0X52E
GLOBAL	GLCDDATATEMP
 GLCDDATATEMP                     EQU 1327          ; 0X52F
GLOBAL	GLCDFNTDEFAULT
 GLCDFNTDEFAULT                   EQU 1328          ; 0X530
GLOBAL	GLCDFNTDEFAULTHEIGHT
 GLCDFNTDEFAULTHEIGHT             EQU 1329          ; 0X531
GLOBAL	GLCDFNTDEFAULTSIZE
 GLCDFNTDEFAULTSIZE               EQU 1330          ; 0X532
GLOBAL	GLCDFONTWIDTH
 GLCDFONTWIDTH                    EQU 1331          ; 0X533
GLOBAL	GLCDFOREGROUND
 GLCDFOREGROUND                   EQU 1332          ; 0X534
GLOBAL	GLCDFOREGROUND_H
 GLCDFOREGROUND_H                 EQU 1333          ; 0X535
GLOBAL	GLCDPRINTLEN
 GLCDPRINTLEN                     EQU 1334          ; 0X536
GLOBAL	GLCDPRINTLOC
 GLCDPRINTLOC                     EQU 1335          ; 0X537
GLOBAL	GLCDPRINTLOC_H
 GLCDPRINTLOC_H                   EQU 1336          ; 0X538
GLOBAL	GLCDPRINT_STRING_COUNTER
 GLCDPRINT_STRING_COUNTER         EQU 1337          ; 0X539
GLOBAL	GLCDTEMP
 GLCDTEMP                         EQU 1338          ; 0X53A
GLOBAL	GLCDTEMP_H
 GLCDTEMP_H                       EQU 1339          ; 0X53B
GLOBAL	GLCDX
 GLCDX                            EQU 1340          ; 0X53C
GLOBAL	GLCDY
 GLCDY                            EQU 1341          ; 0X53D
GLOBAL	GLCD_YORDINATE
 GLCD_YORDINATE                   EQU 1342          ; 0X53E
GLOBAL	GLCD_YORDINATE_H
 GLCD_YORDINATE_H                 EQU 1343          ; 0X53F
GLOBAL	HI2C1LASTERROR
 HI2C1LASTERROR                   EQU 1344          ; 0X540
GLOBAL	HI2C1STATEMACHINE
 HI2C1STATEMACHINE                EQU 1345          ; 0X541
GLOBAL	HI2CACKPOLLSTATE
 HI2CACKPOLLSTATE                 EQU 1346          ; 0X542
GLOBAL	HI2CCURRENTMODE
 HI2CCURRENTMODE                  EQU 1347          ; 0X543
GLOBAL	HI2CWAITMSSPTIMEOUT
 HI2CWAITMSSPTIMEOUT              EQU 1348          ; 0X544
GLOBAL	I2CBYTE
 I2CBYTE                          EQU 1349          ; 0X545
GLOBAL	INXRADIUS
 INXRADIUS                        EQU 1350          ; 0X546
GLOBAL	INXRADIUS_H
 INXRADIUS_H                      EQU 1351          ; 0X547
GLOBAL	LCDVALUE
 LCDVALUE                         EQU 1352          ; 0X548
GLOBAL	LCDVALUE_E
 LCDVALUE_E                       EQU 1355          ; 0X54B
GLOBAL	LCDVALUE_H
 LCDVALUE_H                       EQU 1353          ; 0X549
GLOBAL	LCDVALUE_U
 LCDVALUE_U                       EQU 1354          ; 0X54A
GLOBAL	LINECOLOUR
 LINECOLOUR                       EQU 1356          ; 0X54C
GLOBAL	LINECOLOUR_E
 LINECOLOUR_E                     EQU 1359          ; 0X54F
GLOBAL	LINECOLOUR_H
 LINECOLOUR_H                     EQU 1357          ; 0X54D
GLOBAL	LINECOLOUR_U
 LINECOLOUR_U                     EQU 1358          ; 0X54E
GLOBAL	LINEDIFFX
 LINEDIFFX                        EQU 1360          ; 0X550
GLOBAL	LINEDIFFX_H
 LINEDIFFX_H                      EQU 1361          ; 0X551
GLOBAL	LINEDIFFX_X2
 LINEDIFFX_X2                     EQU 1362          ; 0X552
GLOBAL	LINEDIFFX_X2_H
 LINEDIFFX_X2_H                   EQU 1363          ; 0X553
GLOBAL	LINEDIFFY
 LINEDIFFY                        EQU 1364          ; 0X554
GLOBAL	LINEDIFFY_H
 LINEDIFFY_H                      EQU 1365          ; 0X555
GLOBAL	LINEDIFFY_X2
 LINEDIFFY_X2                     EQU 1366          ; 0X556
GLOBAL	LINEDIFFY_X2_H
 LINEDIFFY_X2_H                   EQU 1367          ; 0X557
GLOBAL	LINEERR
 LINEERR                          EQU 1368          ; 0X558
GLOBAL	LINEERR_H
 LINEERR_H                        EQU 1369          ; 0X559
GLOBAL	LINESTEPX
 LINESTEPX                        EQU 1370          ; 0X55A
GLOBAL	LINESTEPX_H
 LINESTEPX_H                      EQU 1371          ; 0X55B
GLOBAL	LINESTEPY
 LINESTEPY                        EQU 1372          ; 0X55C
GLOBAL	LINESTEPY_H
 LINESTEPY_H                      EQU 1373          ; 0X55D
GLOBAL	LINEX1
 LINEX1                           EQU 1374          ; 0X55E
GLOBAL	LINEX1_H
 LINEX1_H                         EQU 1375          ; 0X55F
GLOBAL	LINEX2
 LINEX2                           EQU 1376          ; 0X560
GLOBAL	LINEX2_H
 LINEX2_H                         EQU 1377          ; 0X561
GLOBAL	LINEY1
 LINEY1                           EQU 1378          ; 0X562
GLOBAL	LINEY1_H
 LINEY1_H                         EQU 1379          ; 0X563
GLOBAL	LINEY2
 LINEY2                           EQU 1380          ; 0X564
GLOBAL	LINEY2_H
 LINEY2_H                         EQU 1381          ; 0X565
GLOBAL	LOCX
 LOCX                             EQU 1382          ; 0X566
GLOBAL	LOCY
 LOCY                             EQU 1383          ; 0X567
GLOBAL	LONGNUMBER
 LONGNUMBER                       EQU 1384          ; 0X568
GLOBAL	LONGNUMBER_E
 LONGNUMBER_E                     EQU 1387          ; 0X56B
GLOBAL	LONGNUMBER_H
 LONGNUMBER_H                     EQU 1385          ; 0X569
GLOBAL	LONGNUMBER_U
 LONGNUMBER_U                     EQU 1386          ; 0X56A
GLOBAL	OUTSTRING
 OUTSTRING                        EQU 4310          ; 0X10D6
GLOBAL	PAD
 PAD                              EQU 4269          ; 0X10AD
GLOBAL	POSCHARX
 POSCHARX                         EQU 1388          ; 0X56C
GLOBAL	POSCHARX_H
 POSCHARX_H                       EQU 1389          ; 0X56D
GLOBAL	POSCHARY
 POSCHARY                         EQU 1390          ; 0X56E
GLOBAL	PRINTLOCX
 PRINTLOCX                        EQU 1391          ; 0X56F
GLOBAL	PRINTLOCX_H
 PRINTLOCX_H                      EQU 1392          ; 0X570
GLOBAL	PRINTLOCY
 PRINTLOCY                        EQU 1393          ; 0X571
GLOBAL	PRINTLOCY_H
 PRINTLOCY_H                      EQU 1394          ; 0X572
GLOBAL	RADIUSERR
 RADIUSERR                        EQU 1395          ; 0X573
GLOBAL	RADIUSERR_H
 RADIUSERR_H                      EQU 1396          ; 0X574
GLOBAL	ROW
 ROW                              EQU 1397          ; 0X575
GLOBAL	SSD1306SENDBYTE
 SSD1306SENDBYTE                  EQU 1398          ; 0X576
GLOBAL	SSD1306_BUFFERALIAS
 SSD1306_BUFFERALIAS              EQU 4351          ; 0X10FF
GLOBAL	SSD1306_BUFFERLOCATIONCALC
 SSD1306_BUFFERLOCATIONCALC       EQU 1399          ; 0X577
GLOBAL	SSD1306_BUFFERLOCATIONCALC_H
 SSD1306_BUFFERLOCATIONCALC_H     EQU 1400          ; 0X578
GLOBAL	STR
 STR                              EQU 4230          ; 0X1086
GLOBAL	STRINGLOCX
 STRINGLOCX                       EQU 1401          ; 0X579
GLOBAL	STRINGPOINTER
 STRINGPOINTER                    EQU 1402          ; 0X57A
GLOBAL	SYSARRAYTEMP1
 SYSARRAYTEMP1                    EQU 1403          ; 0X57B
GLOBAL	SYSARRAYTEMP2
 SYSARRAYTEMP2                    EQU 1404          ; 0X57C
GLOBAL	SYSBYTETEMPA
 SYSBYTETEMPA                     EQU 1285          ; 0X505
GLOBAL	SYSBYTETEMPB
 SYSBYTETEMPB                     EQU 1289          ; 0X509
GLOBAL	SYSBYTETEMPX
 SYSBYTETEMPX                     EQU 1280          ; 0X500
GLOBAL	SYSCALCTEMPA
 SYSCALCTEMPA                     EQU 1285          ; 0X505
GLOBAL	SYSCALCTEMPA_E
 SYSCALCTEMPA_E                   EQU 1288          ; 0X508
GLOBAL	SYSCALCTEMPA_H
 SYSCALCTEMPA_H                   EQU 1286          ; 0X506
GLOBAL	SYSCALCTEMPA_U
 SYSCALCTEMPA_U                   EQU 1287          ; 0X507
GLOBAL	SYSCALCTEMPX
 SYSCALCTEMPX                     EQU 1280          ; 0X500
GLOBAL	SYSCALCTEMPX_H
 SYSCALCTEMPX_H                   EQU 1281          ; 0X501
GLOBAL	SYSCHARCOUNT
 SYSCHARCOUNT                     EQU 1405          ; 0X57D
GLOBAL	SYSCHARSHANDLER
 SYSCHARSHANDLER                  EQU 1406          ; 0X57E
GLOBAL	SYSCHARSHANDLER_H
 SYSCHARSHANDLER_H                EQU 1407          ; 0X57F
GLOBAL	SYSDIVLOOP
 SYSDIVLOOP                       EQU 1284          ; 0X504
GLOBAL	SYSDIVMULTA
 SYSDIVMULTA                      EQU 1287          ; 0X507
GLOBAL	SYSDIVMULTA_H
 SYSDIVMULTA_H                    EQU 1288          ; 0X508
GLOBAL	SYSDIVMULTB
 SYSDIVMULTB                      EQU 1291          ; 0X50B
GLOBAL	SYSDIVMULTB_H
 SYSDIVMULTB_H                    EQU 1292          ; 0X50C
GLOBAL	SYSDIVMULTX
 SYSDIVMULTX                      EQU 1282          ; 0X502
GLOBAL	SYSDIVMULTX_H
 SYSDIVMULTX_H                    EQU 1283          ; 0X503
GLOBAL	SYSFORLOOPABSVALUE12
 SYSFORLOOPABSVALUE12             EQU 1408          ; 0X580
GLOBAL	SYSFORLOOPABSVALUE12_H
 SYSFORLOOPABSVALUE12_H           EQU 1409          ; 0X581
GLOBAL	SYSFORLOOPSTEP11
 SYSFORLOOPSTEP11                 EQU 1410          ; 0X582
GLOBAL	SYSFORLOOPSTEP11_H
 SYSFORLOOPSTEP11_H               EQU 1411          ; 0X583
GLOBAL	SYSFORLOOPSTEP2
 SYSFORLOOPSTEP2                  EQU 1412          ; 0X584
GLOBAL	SYSFORLOOPSTEP2_H
 SYSFORLOOPSTEP2_H                EQU 1413          ; 0X585
GLOBAL	SYSINTEGERTEMPA
 SYSINTEGERTEMPA                  EQU 1285          ; 0X505
GLOBAL	SYSINTEGERTEMPA_H
 SYSINTEGERTEMPA_H                EQU 1286          ; 0X506
GLOBAL	SYSINTEGERTEMPB
 SYSINTEGERTEMPB                  EQU 1289          ; 0X509
GLOBAL	SYSINTEGERTEMPB_H
 SYSINTEGERTEMPB_H                EQU 1290          ; 0X50A
GLOBAL	SYSINTEGERTEMPX
 SYSINTEGERTEMPX                  EQU 1280          ; 0X500
GLOBAL	SYSINTEGERTEMPX_H
 SYSINTEGERTEMPX_H                EQU 1281          ; 0X501
GLOBAL	SYSLCDPRINTDATAHANDLER
 SYSLCDPRINTDATAHANDLER           EQU 1414          ; 0X586
GLOBAL	SYSLCDPRINTDATAHANDLER_H
 SYSLCDPRINTDATAHANDLER_H         EQU 1415          ; 0X587
GLOBAL	SYSLONGDIVMULTA
 SYSLONGDIVMULTA                  EQU 1416          ; 0X588
GLOBAL	SYSLONGDIVMULTA_E
 SYSLONGDIVMULTA_E                EQU 1419          ; 0X58B
GLOBAL	SYSLONGDIVMULTA_H
 SYSLONGDIVMULTA_H                EQU 1417          ; 0X589
GLOBAL	SYSLONGDIVMULTA_U
 SYSLONGDIVMULTA_U                EQU 1418          ; 0X58A
GLOBAL	SYSLONGDIVMULTB
 SYSLONGDIVMULTB                  EQU 1420          ; 0X58C
GLOBAL	SYSLONGDIVMULTB_E
 SYSLONGDIVMULTB_E                EQU 1423          ; 0X58F
GLOBAL	SYSLONGDIVMULTB_H
 SYSLONGDIVMULTB_H                EQU 1421          ; 0X58D
GLOBAL	SYSLONGDIVMULTB_U
 SYSLONGDIVMULTB_U                EQU 1422          ; 0X58E
GLOBAL	SYSLONGDIVMULTX
 SYSLONGDIVMULTX                  EQU 1424          ; 0X590
GLOBAL	SYSLONGDIVMULTX_E
 SYSLONGDIVMULTX_E                EQU 1427          ; 0X593
GLOBAL	SYSLONGDIVMULTX_H
 SYSLONGDIVMULTX_H                EQU 1425          ; 0X591
GLOBAL	SYSLONGDIVMULTX_U
 SYSLONGDIVMULTX_U                EQU 1426          ; 0X592
GLOBAL	SYSLONGTEMPA
 SYSLONGTEMPA                     EQU 1285          ; 0X505
GLOBAL	SYSLONGTEMPA_E
 SYSLONGTEMPA_E                   EQU 1288          ; 0X508
GLOBAL	SYSLONGTEMPA_H
 SYSLONGTEMPA_H                   EQU 1286          ; 0X506
GLOBAL	SYSLONGTEMPA_U
 SYSLONGTEMPA_U                   EQU 1287          ; 0X507
GLOBAL	SYSLONGTEMPB
 SYSLONGTEMPB                     EQU 1289          ; 0X509
GLOBAL	SYSLONGTEMPB_E
 SYSLONGTEMPB_E                   EQU 1292          ; 0X50C
GLOBAL	SYSLONGTEMPB_H
 SYSLONGTEMPB_H                   EQU 1290          ; 0X50A
GLOBAL	SYSLONGTEMPB_U
 SYSLONGTEMPB_U                   EQU 1291          ; 0X50B
GLOBAL	SYSLONGTEMPX
 SYSLONGTEMPX                     EQU 1280          ; 0X500
GLOBAL	SYSLONGTEMPX_E
 SYSLONGTEMPX_E                   EQU 1283          ; 0X503
GLOBAL	SYSLONGTEMPX_H
 SYSLONGTEMPX_H                   EQU 1281          ; 0X501
GLOBAL	SYSLONGTEMPX_U
 SYSLONGTEMPX_U                   EQU 1282          ; 0X502
GLOBAL	SYSPRINTBUFFER
 SYSPRINTBUFFER                   EQU 4236          ; 0X108C
GLOBAL	SYSPRINTBUFFLEN
 SYSPRINTBUFFLEN                  EQU 1428          ; 0X594
GLOBAL	SYSREPEATTEMP1
 SYSREPEATTEMP1                   EQU 1429          ; 0X595
GLOBAL	SYSREPEATTEMP4
 SYSREPEATTEMP4                   EQU 1430          ; 0X596
GLOBAL	SYSSIGNBYTE
 SYSSIGNBYTE                      EQU 1293          ; 0X50D
GLOBAL	SYSSTRDATA
 SYSSTRDATA                       EQU 1431          ; 0X597
GLOBAL	SYSSTRINGA
 SYSSTRINGA                       EQU 1287          ; 0X507
GLOBAL	SYSSTRINGA_H
 SYSSTRINGA_H                     EQU 1288          ; 0X508
GLOBAL	SYSSTRINGLENGTH
 SYSSTRINGLENGTH                  EQU 1286          ; 0X506
GLOBAL	SYSSTRINGPARAM1
 SYSSTRINGPARAM1                  EQU 4247          ; 0X1097
GLOBAL	SYSSTRINGTEMP
 SYSSTRINGTEMP                    EQU 1432          ; 0X598
GLOBAL	SYSSTRLEN
 SYSSTRLEN                        EQU 1433          ; 0X599
GLOBAL	SYSSYSINSTRING3HANDLER
 SYSSYSINSTRING3HANDLER           EQU 1434          ; 0X59A
GLOBAL	SYSSYSINSTRING3HANDLER_H
 SYSSYSINSTRING3HANDLER_H         EQU 1435          ; 0X59B
GLOBAL	SYSSYSINSTRINGHANDLER
 SYSSYSINSTRINGHANDLER            EQU 1436          ; 0X59C
GLOBAL	SYSSYSINSTRINGHANDLER_H
 SYSSYSINSTRINGHANDLER_H          EQU 1437          ; 0X59D
GLOBAL	SYSTEMP1
 SYSTEMP1                         EQU 1438          ; 0X59E
GLOBAL	SYSTEMP1_E
 SYSTEMP1_E                       EQU 1441          ; 0X5A1
GLOBAL	SYSTEMP1_H
 SYSTEMP1_H                       EQU 1439          ; 0X59F
GLOBAL	SYSTEMP1_U
 SYSTEMP1_U                       EQU 1440          ; 0X5A0
GLOBAL	SYSTEMP2
 SYSTEMP2                         EQU 1442          ; 0X5A2
GLOBAL	SYSTEMP2_H
 SYSTEMP2_H                       EQU 1443          ; 0X5A3
GLOBAL	SYSTEMP3
 SYSTEMP3                         EQU 1444          ; 0X5A4
GLOBAL	SYSVALTEMP
 SYSVALTEMP                       EQU 1445          ; 0X5A5
GLOBAL	SYSVALTEMP_H
 SYSVALTEMP_H                     EQU 1446          ; 0X5A6
GLOBAL	SYSWAITTEMPMS
 SYSWAITTEMPMS                    EQU 1282          ; 0X502
GLOBAL	SYSWAITTEMPMS_H
 SYSWAITTEMPMS_H                  EQU 1283          ; 0X503
GLOBAL	SYSWAITTEMPS
 SYSWAITTEMPS                     EQU 1284          ; 0X504
GLOBAL	SYSWAITTEMPUS
 SYSWAITTEMPUS                    EQU 1285          ; 0X505
GLOBAL	SYSWAITTEMPUS_H
 SYSWAITTEMPUS_H                  EQU 1286          ; 0X506
GLOBAL	SYSWORDTEMPA
 SYSWORDTEMPA                     EQU 1285          ; 0X505
GLOBAL	SYSWORDTEMPA_H
 SYSWORDTEMPA_H                   EQU 1286          ; 0X506
GLOBAL	SYSWORDTEMPB
 SYSWORDTEMPB                     EQU 1289          ; 0X509
GLOBAL	SYSWORDTEMPB_H
 SYSWORDTEMPB_H                   EQU 1290          ; 0X50A
GLOBAL	SYSWORDTEMPX
 SYSWORDTEMPX                     EQU 1280          ; 0X500
GLOBAL	SYSWORDTEMPX_H
 SYSWORDTEMPX_H                   EQU 1281          ; 0X501
GLOBAL	WORDNUMBER
 WORDNUMBER                       EQU 1447          ; 0X5A7
GLOBAL	WORDNUMBER_H
 WORDNUMBER_H                     EQU 1448          ; 0X5A8
GLOBAL	XCHAR
 XCHAR                            EQU 1449          ; 0X5A9
GLOBAL	XOFFSET
 XOFFSET                          EQU 1450          ; 0X5AA
GLOBAL	XOFFSET_H
 XOFFSET_H                        EQU 1451          ; 0X5AB
GLOBAL	XRADIUS
 XRADIUS                          EQU 1452          ; 0X5AC
GLOBAL	XRADIUS_H
 XRADIUS_H                        EQU 1453          ; 0X5AD
GLOBAL	YCALC1
 YCALC1                           EQU 1454          ; 0X5AE
GLOBAL	YCALC1_H
 YCALC1_H                         EQU 1455          ; 0X5AF
GLOBAL	YCALC2
 YCALC2                           EQU 1456          ; 0X5B0
GLOBAL	YCALC2_H
 YCALC2_H                         EQU 1457          ; 0X5B1
GLOBAL	YOFFSET
 YOFFSET                          EQU 1458          ; 0X5B2
GLOBAL	YOFFSET_H
 YOFFSET_H                        EQU 1459          ; 0X5B3
GLOBAL	YORDINATE
 YORDINATE                        EQU 1460          ; 0X5B4
GLOBAL	_HEXPICAS
 _HEXPICAS                        EQU 4226          ; 0X1082

;'********************************************************************************

;'ALIAS VARIABLES
GLOBAL	AFSR0
 AFSR0                            EQU 1257
GLOBAL	AFSR0_H
 AFSR0_H                          EQU 1258
GLOBAL	SYSPAD_0
 SYSPAD_0                         EQU 4269
GLOBAL	SYSSTR_0
 SYSSTR_0                         EQU 4230
GLOBAL	SYS_HEXPICAS_0
 SYS_HEXPICAS_0                   EQU 4226
GLOBAL	SYS_HEXPICAS_1
 SYS_HEXPICAS_1                   EQU 4227
GLOBAL	SYS_HEXPICAS_2
 SYS_HEXPICAS_2                   EQU 4228

;'********************************************************************************

 PSECT   RESETVEC,delta=1, abs
 RESETVEC:
;'VECTORS
	ORG	0
	GOTO	BASPROGRAMSTART
	ORG	8
	RETFIE

;'********************************************************************************

;'PROGRAM_MEMORY_PAGE: 0
	ORG	12
GLOBAL	BASPROGRAMSTART
BASPROGRAMSTART:
;'CALL INITIALISATION ROUTINES
	CALL	INITSYS
	CALL	INITPPS
	CALL	HI2CINIT
	CALL	INITGLCD_SSD1306

;'START_OF_THE_MAIN_PROGRAM
;''
;''THIS DEMONSTRATION PROGRAM IS A SIMPLE GLCD DEMONSTRATION OF THE SSD1306 GLCD CAPABILITIES.
;''
;''THIS PROGRAM IS A SIMPLE GLCD DEMONSTRATION OF THE SSD1306 GLCD CAPABILITIES.
;''THIS PROGRAM DRAWS LINES, BOXES, CIRCLES AND PRINTS STRINGS AND NUMBERS.
;''THE SSD1306 CONTROLLER A SMALL GRAPHICAL OLED, SUITABLE FOR A LOT OF VARIOUS PROJECTS.
;''THE DISPLAY IS 38*35 MM, WITH AN ACTIVE DISPLAY SURFACE OF 0.96INCHES, AND A 128*64 PIXEL RESOLUTION.
;''THE DISPLAY IS EASY TO INTERFACE, USING AN I2C TYPE OF COMMUNICATION.
;''THE GLCD IS CONNECTED TO THE MICROPROCESSOR AS SHOWN IN THE HARDWARE SECTION OF THIS CODE.
;''
;''THIS VERSION IS COMPATIBLE WILL ALL VERSION OF GCBASIC AS THIS DEMONSTRATION USES FULL MEMORY GLCD MODE ONLY.  THIS CAN BE ADAPTED TO LOW MEMORY GLCD MODE.
;''
;''************************************************************************
;''AUTHOR  EVANV
;''LICENCE GPL
;''VERSION 1.00
;''DATE    31.11.2022
;'----- CONFIGURATION
;'CHIP SETTINGS.
;'PIC PPS TOOL VERSION: 0.0.6.5
;'ADD THIS CODE SEGMENT TO YOUR GCBASIC SOURCE PROGRAM
;'
;'HARDWARE
;'-------------------PORTA----------------
;'BIT#:  -7---6---5---4---3---2---1---0---
;'IO:    -----------------SW---------ADC--
;'-----------------------------------------
;'
;'
;'-------------------PORTB----------------
;'BIT#:  -7---6---5---4---3---2---1---0---
;'IO:    TX--SCL-SDA----------------------
;'----------------------------------------
;'
;'------------------PORTC-----------------
;'BIT#:  -7---6---5---4---3---2---1---0---
;'IO:    LED-LED-LED-LED------------------
;'----------------------------------------
;'
;'DEFINE CONSTANTS TO MAKE THINGS EASIER. WE CAN REUSE THESE AT ANY TIME.
;'SET THE PORTS AS AN OUTPUT
;'DIR LEDD7 OUT
	BCF	TRISC,7,ACCESS
;'DIR LEDD6 OUT
	BCF	TRISC,6,ACCESS
;'DIR LEDD5 OUT
	BCF	TRISC,5,ACCESS
;'DIR LEDD4 OUT
	BCF	TRISC,4,ACCESS
;'THIS IS THE PORTA.0 PORT
;'DIR POTENTIOMETER IN
	BSF	TRISA,0,ACCESS
;'DIR     SWITCHIN      IN
	BSF	TRISA,3,ACCESS
;'DEFINE I2C SETTINGS
;'HI2CMODE (MASTER)
	MOVLW	12
	MOVWF	HI2CCURRENTMODE,ACCESS
	CALL	HI2CMODE
;'A CONSTANT TO  ALLOW YOU TO CHANGE THE GLCD MEMORY USAGE.
;'*****************************************************************************************************
;'MAIN PROGRAM COMMENCES HERE.. EVERYTHING BEFORE THIS IS SETUP FOR THE BOARD.
;'----- DEFINE VARIABLES
;'DIM BYTENUMBER, CCOUNT AS BYTE
;'CCOUNT = 0
	CLRF	CCOUNT,ACCESS
;'DIM LONGNUMBER AS LONG
;'MAX VALUE = 4294967290
;'LONGNUMBER = 123456
	MOVLW	64
	BANKSEL	LONGNUMBER
	MOVWF	LONGNUMBER,BANKED
	MOVLW	226
	MOVWF	LONGNUMBER_H,BANKED
	MOVLW	1
	MOVWF	LONGNUMBER_U,BANKED
	CLRF	LONGNUMBER_E,BANKED
;'DIM WORDNUMBER AS WORD
;'DIM OUTSTRING AS STRING
;'WORDNUMBER = 0
	CLRF	WORDNUMBER,BANKED
	CLRF	WORDNUMBER_H,BANKED
;'BYTENUMBER = 0
	CLRF	BYTENUMBER,ACCESS
;'----- MAIN PROGRAM
;'GLCDPRINT 2, 2,   "GCBASIC"
	MOVLW	2
	MOVWF	PRINTLOCX,BANKED
	CLRF	PRINTLOCX_H,BANKED
	MOVLW	2
	MOVWF	PRINTLOCY,BANKED
	CLRF	PRINTLOCY_H,BANKED
	LFSR	1,SYSSTRINGPARAM1
	MOVLW	LOW STRINGTABLE1
	MOVWF	TBLPTR,ACCESS
	MOVLW	HIGH STRINGTABLE1
	MOVWF	TBLPTRH,ACCESS
	MOVLW	UPPER STRINGTABLE1
	MOVWF	TBLPTRU,ACCESS
	BANKSEL	0
	CALL	SYSREADSTRING
	MOVLW	LOW SYSSTRINGPARAM1
	BANKSEL	SYSLCDPRINTDATAHANDLER
	MOVWF	SYSLCDPRINTDATAHANDLER,BANKED
	MOVLW	HIGH SYSSTRINGPARAM1
	MOVWF	SYSLCDPRINTDATAHANDLER_H,BANKED
;'USING SYSSTRINGPARAM1*7
	BANKSEL	0
	CALL	GLCDPRINT5
;'GLCDPRINT (2, 18, "ANOBIUM 2024")
	MOVLW	2
	BANKSEL	PRINTLOCX
	MOVWF	PRINTLOCX,BANKED
	CLRF	PRINTLOCX_H,BANKED
	MOVLW	18
	MOVWF	PRINTLOCY,BANKED
	CLRF	PRINTLOCY_H,BANKED
	LFSR	1,SYSSTRINGPARAM1
	MOVLW	LOW STRINGTABLE2
	MOVWF	TBLPTR,ACCESS
	MOVLW	HIGH STRINGTABLE2
	MOVWF	TBLPTRH,ACCESS
	MOVLW	UPPER STRINGTABLE2
	MOVWF	TBLPTRU,ACCESS
	BANKSEL	0
	CALL	SYSREADSTRING
	MOVLW	LOW SYSSTRINGPARAM1
	BANKSEL	SYSLCDPRINTDATAHANDLER
	MOVWF	SYSLCDPRINTDATAHANDLER,BANKED
	MOVLW	HIGH SYSSTRINGPARAM1
	MOVWF	SYSLCDPRINTDATAHANDLER_H,BANKED
;'USING SYSSTRINGPARAM1*12
	BANKSEL	0
	CALL	GLCDPRINT5
;'GLCDPRINT (2, 34, "GLCD PORTABILITY DEMO")
	MOVLW	2
	BANKSEL	PRINTLOCX
	MOVWF	PRINTLOCX,BANKED
	CLRF	PRINTLOCX_H,BANKED
	MOVLW	34
	MOVWF	PRINTLOCY,BANKED
	CLRF	PRINTLOCY_H,BANKED
	LFSR	1,SYSSTRINGPARAM1
	MOVLW	LOW STRINGTABLE3
	MOVWF	TBLPTR,ACCESS
	MOVLW	HIGH STRINGTABLE3
	MOVWF	TBLPTRH,ACCESS
	MOVLW	UPPER STRINGTABLE3
	MOVWF	TBLPTRU,ACCESS
	BANKSEL	0
	CALL	SYSREADSTRING
	MOVLW	LOW SYSSTRINGPARAM1
	BANKSEL	SYSLCDPRINTDATAHANDLER
	MOVWF	SYSLCDPRINTDATAHANDLER,BANKED
	MOVLW	HIGH SYSSTRINGPARAM1
	MOVWF	SYSLCDPRINTDATAHANDLER_H,BANKED
;'USING SYSSTRINGPARAM1*21
	BANKSEL	0
	CALL	GLCDPRINT5
;'GLCDPRINT (2, 50, CHIPNAMESTR )
	MOVLW	2
	BANKSEL	PRINTLOCX
	MOVWF	PRINTLOCX,BANKED
	CLRF	PRINTLOCX_H,BANKED
	MOVLW	50
	MOVWF	PRINTLOCY,BANKED
	CLRF	PRINTLOCY_H,BANKED
	LFSR	1,SYSSTRINGPARAM1
	MOVLW	LOW STRINGTABLE134
	MOVWF	TBLPTR,ACCESS
	MOVLW	HIGH STRINGTABLE134
	MOVWF	TBLPTRH,ACCESS
	MOVLW	UPPER STRINGTABLE134
	MOVWF	TBLPTRU,ACCESS
	BANKSEL	0
	CALL	SYSREADSTRING
	MOVLW	LOW SYSSTRINGPARAM1
	BANKSEL	SYSLCDPRINTDATAHANDLER
	MOVWF	SYSLCDPRINTDATAHANDLER,BANKED
	MOVLW	HIGH SYSSTRINGPARAM1
	MOVWF	SYSLCDPRINTDATAHANDLER_H,BANKED
;'USING SYSSTRINGPARAM1*8
	BANKSEL	0
	CALL	GLCDPRINT5
;'BOX 0,0,127,63
	CLRF	LINEX1,ACCESS
	CLRF	LINEX1_H,ACCESS
	BANKSEL	LINEY1
	CLRF	LINEY1,BANKED
	CLRF	LINEY1_H,BANKED
	MOVLW	127
	MOVWF	LINEX2,BANKED
	CLRF	LINEX2_H,BANKED
	MOVLW	63
	MOVWF	LINEY2,BANKED
	CLRF	LINEY2_H,BANKED
	MOVFF	GLCDFOREGROUND,LINECOLOUR
	MOVFF	GLCDFOREGROUND_H,LINECOLOUR_H
	BANKSEL	0
	RCALL	BOX17
;'WAIT 3 S
	MOVLW	3
	MOVWF	SYSWAITTEMPS,ACCESS
	RCALL	DELAY_S
;'GLCDCLS
	CALL	GLCDCLS_SSD1306
;'PREPARE THE STATIC COMPONENTS OF THE SCREEN
;'PRINT SOME TEXT
;'GLCDPRINT ( 2,   1, "GLCDPRINT")
	MOVLW	2
	BANKSEL	PRINTLOCX
	MOVWF	PRINTLOCX,BANKED
	CLRF	PRINTLOCX_H,BANKED
	MOVLW	1
	MOVWF	PRINTLOCY,BANKED
	CLRF	PRINTLOCY_H,BANKED
	LFSR	1,SYSSTRINGPARAM1
	MOVLW	LOW STRINGTABLE4
	MOVWF	TBLPTR,ACCESS
	MOVLW	HIGH STRINGTABLE4
	MOVWF	TBLPTRH,ACCESS
	MOVLW	UPPER STRINGTABLE4
	MOVWF	TBLPTRU,ACCESS
	BANKSEL	0
	CALL	SYSREADSTRING
	MOVLW	LOW SYSSTRINGPARAM1
	BANKSEL	SYSLCDPRINTDATAHANDLER
	MOVWF	SYSLCDPRINTDATAHANDLER,BANKED
	MOVLW	HIGH SYSSTRINGPARAM1
	MOVWF	SYSLCDPRINTDATAHANDLER_H,BANKED
;'USING SYSSTRINGPARAM1*9
	BANKSEL	0
	CALL	GLCDPRINT5
;'PRINT SOME MORE TEXT
;'GLCDPRINT ( 64,  1, "")
	MOVLW	64
	BANKSEL	PRINTLOCX
	MOVWF	PRINTLOCX,BANKED
	CLRF	PRINTLOCX_H,BANKED
	MOVLW	1
	MOVWF	PRINTLOCY,BANKED
	CLRF	PRINTLOCY_H,BANKED
	LFSR	1,SYSSTRINGPARAM1
	MOVLW	LOW STRINGTABLE5
	MOVWF	TBLPTR,ACCESS
	MOVLW	HIGH STRINGTABLE5
	MOVWF	TBLPTRH,ACCESS
	MOVLW	UPPER STRINGTABLE5
	MOVWF	TBLPTRU,ACCESS
	BANKSEL	0
	CALL	SYSREADSTRING
	MOVLW	LOW SYSSTRINGPARAM1
	BANKSEL	SYSLCDPRINTDATAHANDLER
	MOVWF	SYSLCDPRINTDATAHANDLER,BANKED
	MOVLW	HIGH SYSSTRINGPARAM1
	MOVWF	SYSLCDPRINTDATAHANDLER_H,BANKED
;'USING SYSSTRINGPARAM1*1
	BANKSEL	0
	CALL	GLCDPRINT5
;'PRINT CHIP SPEED
;'GLCDPRINT ( 72,  1, CHIPMHZ)
	MOVLW	72
	BANKSEL	PRINTLOCX
	MOVWF	PRINTLOCX,BANKED
	CLRF	PRINTLOCX_H,BANKED
	MOVLW	1
	MOVWF	PRINTLOCY,BANKED
	CLRF	PRINTLOCY_H,BANKED
	MOVLW	64
	MOVWF	LCDVALUE,ACCESS
	CLRF	LCDVALUE_H,ACCESS
	CLRF	LCDVALUE_U,ACCESS
	CLRF	LCDVALUE_E,ACCESS
	BANKSEL	0
	CALL	GLCDPRINT8
;'PRINT SOME TEXT
;'GLCDPRINT ( 86, 1, "MHZ")
	MOVLW	86
	BANKSEL	PRINTLOCX
	MOVWF	PRINTLOCX,BANKED
	CLRF	PRINTLOCX_H,BANKED
	MOVLW	1
	MOVWF	PRINTLOCY,BANKED
	CLRF	PRINTLOCY_H,BANKED
	LFSR	1,SYSSTRINGPARAM1
	MOVLW	LOW STRINGTABLE6
	MOVWF	TBLPTR,ACCESS
	MOVLW	HIGH STRINGTABLE6
	MOVWF	TBLPTRH,ACCESS
	MOVLW	UPPER STRINGTABLE6
	MOVWF	TBLPTRU,ACCESS
	BANKSEL	0
	CALL	SYSREADSTRING
	MOVLW	LOW SYSSTRINGPARAM1
	BANKSEL	SYSLCDPRINTDATAHANDLER
	MOVWF	SYSLCDPRINTDATAHANDLER,BANKED
	MOVLW	HIGH SYSSTRINGPARAM1
	MOVWF	SYSLCDPRINTDATAHANDLER_H,BANKED
;'USING SYSSTRINGPARAM1*3
	BANKSEL	0
	CALL	GLCDPRINT5
;'DRAW SOME TEXT
;'GLCDDRAWSTRING( 2,9,"DRAWSTR")
	MOVLW	2
	BANKSEL	STRINGLOCX
	MOVWF	STRINGLOCX,BANKED
	MOVLW	9
	MOVWF	CHARLOCY,ACCESS
	LFSR	1,SYSSTRINGPARAM1
	MOVLW	LOW STRINGTABLE7
	MOVWF	TBLPTR,ACCESS
	MOVLW	HIGH STRINGTABLE7
	MOVWF	TBLPTRH,ACCESS
	MOVLW	UPPER STRINGTABLE7
	MOVWF	TBLPTRU,ACCESS
	BANKSEL	0
	CALL	SYSREADSTRING
	MOVLW	LOW SYSSTRINGPARAM1
	BANKSEL	SYSCHARSHANDLER
	MOVWF	SYSCHARSHANDLER,BANKED
	MOVLW	HIGH SYSSTRINGPARAM1
	MOVWF	SYSCHARSHANDLER_H,BANKED
	MOVFF	GLCDFOREGROUND,LINECOLOUR
	MOVFF	GLCDFOREGROUND_H,LINECOLOUR_H
;'USING SYSSTRINGPARAM1*7
	BANKSEL	0
	CALL	GLCDDRAWSTRING
;'DRAW A BOX
;'BOX 0,0,GLCD_WIDTH-1, GLCD_HEIGHT-1
	CLRF	LINEX1,ACCESS
	CLRF	LINEX1_H,ACCESS
	BANKSEL	LINEY1
	CLRF	LINEY1,BANKED
	CLRF	LINEY1_H,BANKED
	MOVLW	127
	MOVWF	LINEX2,BANKED
	CLRF	LINEX2_H,BANKED
	MOVLW	63
	MOVWF	LINEY2,BANKED
	CLRF	LINEY2_H,BANKED
	MOVFF	GLCDFOREGROUND,LINECOLOUR
	MOVFF	GLCDFOREGROUND_H,LINECOLOUR_H
	BANKSEL	0
	RCALL	BOX17
;'DRAW A BOX
;'BOX GLCD_WIDTH-5, GLCD_HEIGHT-5,GLCD_WIDTH-1, GLCD_HEIGHT-1
	MOVLW	123
	MOVWF	LINEX1,ACCESS
	CLRF	LINEX1_H,ACCESS
	MOVLW	59
	BANKSEL	LINEY1
	MOVWF	LINEY1,BANKED
	CLRF	LINEY1_H,BANKED
	MOVLW	127
	MOVWF	LINEX2,BANKED
	CLRF	LINEX2_H,BANKED
	MOVLW	63
	MOVWF	LINEY2,BANKED
	CLRF	LINEY2_H,BANKED
	MOVFF	GLCDFOREGROUND,LINECOLOUR
	MOVFF	GLCDFOREGROUND_H,LINECOLOUR_H
	BANKSEL	0
	RCALL	BOX17
;'DRAW A CIRCLE
;'CIRCLE (44,41,15)
	MOVLW	44
	BANKSEL	XOFFSET
	MOVWF	XOFFSET,BANKED
	CLRF	XOFFSET_H,BANKED
	MOVLW	41
	MOVWF	YOFFSET,BANKED
	CLRF	YOFFSET_H,BANKED
	MOVLW	15
	MOVWF	INXRADIUS,ACCESS
	CLRF	INXRADIUS_H,ACCESS
	MOVFF	GLCDFOREGROUND,LINECOLOUR
	MOVFF	GLCDFOREGROUND_H,LINECOLOUR_H
	MOVFF	GLCD_YORDINATE,YORDINATE
	BANKSEL	0
	RCALL	CIRCLE20
;'DRAW A LINE
;'LINE 64,31,0,31
	MOVLW	64
	MOVWF	LINEX1,ACCESS
	CLRF	LINEX1_H,ACCESS
	MOVLW	31
	BANKSEL	LINEY1
	MOVWF	LINEY1,BANKED
	CLRF	LINEY1_H,BANKED
	CLRF	LINEX2,BANKED
	CLRF	LINEX2_H,BANKED
	MOVLW	31
	MOVWF	LINEY2,BANKED
	CLRF	LINEY2_H,BANKED
	MOVFF	GLCDFOREGROUND,LINECOLOUR
	MOVFF	GLCDFOREGROUND_H,LINECOLOUR_H
	BANKSEL	0
	CALL	_LINE69
;'DO FOREVER
GLOBAL	SYSDOLOOP_S1
SYSDOLOOP_S1:
;'FOR CCOUNT = 31 TO 127
;'LEGACY METHOD
	MOVLW	30
	MOVWF	CCOUNT,ACCESS
GLOBAL	SYSFORLOOP1
SYSFORLOOP1:
	INCF	CCOUNT,F,ACCESS
;'PRINT A HEX STRING
;'GLCDPRINT ( 64 ,  36,  HEX(LONGNUMBER_E ) )
	MOVLW	64
	BANKSEL	PRINTLOCX
	MOVWF	PRINTLOCX,BANKED
	CLRF	PRINTLOCX_H,BANKED
	MOVLW	36
	MOVWF	PRINTLOCY,BANKED
	CLRF	PRINTLOCY_H,BANKED
	MOVFF	LONGNUMBER_E,SYSVALTEMP
	BANKSEL	0
	CALL	FN__HEXPICAS
	MOVLW	LOW _HEXPICAS
	BANKSEL	SYSLCDPRINTDATAHANDLER
	MOVWF	SYSLCDPRINTDATAHANDLER,BANKED
	MOVLW	HIGH _HEXPICAS
	MOVWF	SYSLCDPRINTDATAHANDLER_H,BANKED
	BANKSEL	0
	CALL	GLCDPRINT5
;'PRINT A HEX STRING
;'GLCDPRINT ( 76 ,  36,  HEX(LONGNUMBER_U ) )
	MOVLW	76
	BANKSEL	PRINTLOCX
	MOVWF	PRINTLOCX,BANKED
	CLRF	PRINTLOCX_H,BANKED
	MOVLW	36
	MOVWF	PRINTLOCY,BANKED
	CLRF	PRINTLOCY_H,BANKED
	MOVFF	LONGNUMBER_U,SYSVALTEMP
	BANKSEL	0
	CALL	FN__HEXPICAS
	MOVLW	LOW _HEXPICAS
	BANKSEL	SYSLCDPRINTDATAHANDLER
	MOVWF	SYSLCDPRINTDATAHANDLER,BANKED
	MOVLW	HIGH _HEXPICAS
	MOVWF	SYSLCDPRINTDATAHANDLER_H,BANKED
	BANKSEL	0
	CALL	GLCDPRINT5
;'PRINT A HEX STRING
;'GLCDPRINT ( 88 ,  36,  HEX(LONGNUMBER_H ) )
	MOVLW	88
	BANKSEL	PRINTLOCX
	MOVWF	PRINTLOCX,BANKED
	CLRF	PRINTLOCX_H,BANKED
	MOVLW	36
	MOVWF	PRINTLOCY,BANKED
	CLRF	PRINTLOCY_H,BANKED
	MOVFF	LONGNUMBER_H,SYSVALTEMP
	BANKSEL	0
	CALL	FN__HEXPICAS
	MOVLW	LOW _HEXPICAS
	BANKSEL	SYSLCDPRINTDATAHANDLER
	MOVWF	SYSLCDPRINTDATAHANDLER,BANKED
	MOVLW	HIGH _HEXPICAS
	MOVWF	SYSLCDPRINTDATAHANDLER_H,BANKED
	BANKSEL	0
	CALL	GLCDPRINT5
;'PRINT A HEX STRING
;'GLCDPRINT ( 100 ,  36, HEX(LONGNUMBER   ) )
	MOVLW	100
	BANKSEL	PRINTLOCX
	MOVWF	PRINTLOCX,BANKED
	CLRF	PRINTLOCX_H,BANKED
	MOVLW	36
	MOVWF	PRINTLOCY,BANKED
	CLRF	PRINTLOCY_H,BANKED
	MOVFF	LONGNUMBER,SYSVALTEMP
	BANKSEL	0
	CALL	FN__HEXPICAS
	MOVLW	LOW _HEXPICAS
	BANKSEL	SYSLCDPRINTDATAHANDLER
	MOVWF	SYSLCDPRINTDATAHANDLER,BANKED
	MOVLW	HIGH _HEXPICAS
	MOVWF	SYSLCDPRINTDATAHANDLER_H,BANKED
	BANKSEL	0
	CALL	GLCDPRINT5
;'PRINT A HEX STRING
;'GLCDPRINT ( 112 ,  36, "H" )
	MOVLW	112
	BANKSEL	PRINTLOCX
	MOVWF	PRINTLOCX,BANKED
	CLRF	PRINTLOCX_H,BANKED
	MOVLW	36
	MOVWF	PRINTLOCY,BANKED
	CLRF	PRINTLOCY_H,BANKED
	LFSR	1,SYSSTRINGPARAM1
	MOVLW	LOW STRINGTABLE8
	MOVWF	TBLPTR,ACCESS
	MOVLW	HIGH STRINGTABLE8
	MOVWF	TBLPTRH,ACCESS
	MOVLW	UPPER STRINGTABLE8
	MOVWF	TBLPTRU,ACCESS
	BANKSEL	0
	CALL	SYSREADSTRING
	MOVLW	LOW SYSSTRINGPARAM1
	BANKSEL	SYSLCDPRINTDATAHANDLER
	MOVWF	SYSLCDPRINTDATAHANDLER,BANKED
	MOVLW	HIGH SYSSTRINGPARAM1
	MOVWF	SYSLCDPRINTDATAHANDLER_H,BANKED
;'USING SYSSTRINGPARAM1*1
	BANKSEL	0
	CALL	GLCDPRINT5
;'PRINT A PADDED STRING
;'GLCDPRINT ( 64 ,  44, PAD(STR(WORDNUMBER), 5 ) )
	MOVLW	64
	BANKSEL	PRINTLOCX
	MOVWF	PRINTLOCX,BANKED
	CLRF	PRINTLOCX_H,BANKED
	MOVLW	44
	MOVWF	PRINTLOCY,BANKED
	CLRF	PRINTLOCY_H,BANKED
	MOVFF	WORDNUMBER,SYSVALTEMP
	MOVFF	WORDNUMBER_H,SYSVALTEMP_H
	BANKSEL	0
	CALL	FN_STR
	MOVLW	LOW STR
	BANKSEL	SYSSYSINSTRINGHANDLER
	MOVWF	SYSSYSINSTRINGHANDLER,BANKED
	MOVLW	HIGH STR
	MOVWF	SYSSYSINSTRINGHANDLER_H,BANKED
	MOVLW	5
	MOVWF	SYSSTRLEN,BANKED
	LFSR	1,SYSSTRINGPARAM1
	MOVLW	LOW STRINGTABLE52
	MOVWF	TBLPTR,ACCESS
	MOVLW	HIGH STRINGTABLE52
	MOVWF	TBLPTRH,ACCESS
	MOVLW	UPPER STRINGTABLE52
	MOVWF	TBLPTRU,ACCESS
	BANKSEL	0
	CALL	SYSREADSTRING
	MOVLW	LOW SYSSTRINGPARAM1
	BANKSEL	SYSSYSINSTRING3HANDLER
	MOVWF	SYSSYSINSTRING3HANDLER,BANKED
	MOVLW	HIGH SYSSTRINGPARAM1
	MOVWF	SYSSYSINSTRING3HANDLER_H,BANKED
;'USING SYSSTRINGPARAM1*1
	BANKSEL	0
	CALL	FN_PAD
	MOVLW	LOW PAD
	BANKSEL	SYSLCDPRINTDATAHANDLER
	MOVWF	SYSLCDPRINTDATAHANDLER,BANKED
	MOVLW	HIGH PAD
	MOVWF	SYSLCDPRINTDATAHANDLER_H,BANKED
	BANKSEL	0
	CALL	GLCDPRINT5
;'PRINT A PADDED STRING
;'GLCDPRINT ( 64 ,  52, PAD(STR(BYTENUMBER), 3 ) )
	MOVLW	64
	BANKSEL	PRINTLOCX
	MOVWF	PRINTLOCX,BANKED
	CLRF	PRINTLOCX_H,BANKED
	MOVLW	52
	MOVWF	PRINTLOCY,BANKED
	CLRF	PRINTLOCY_H,BANKED
	MOVFF	BYTENUMBER,SYSVALTEMP
	CLRF	SYSVALTEMP_H,BANKED
	BANKSEL	0
	CALL	FN_STR
	MOVLW	LOW STR
	BANKSEL	SYSSYSINSTRINGHANDLER
	MOVWF	SYSSYSINSTRINGHANDLER,BANKED
	MOVLW	HIGH STR
	MOVWF	SYSSYSINSTRINGHANDLER_H,BANKED
	MOVLW	3
	MOVWF	SYSSTRLEN,BANKED
	LFSR	1,SYSSTRINGPARAM1
	MOVLW	LOW STRINGTABLE52
	MOVWF	TBLPTR,ACCESS
	MOVLW	HIGH STRINGTABLE52
	MOVWF	TBLPTRH,ACCESS
	MOVLW	UPPER STRINGTABLE52
	MOVWF	TBLPTRU,ACCESS
	BANKSEL	0
	CALL	SYSREADSTRING
	MOVLW	LOW SYSSTRINGPARAM1
	BANKSEL	SYSSYSINSTRING3HANDLER
	MOVWF	SYSSYSINSTRING3HANDLER,BANKED
	MOVLW	HIGH SYSSTRINGPARAM1
	MOVWF	SYSSYSINSTRING3HANDLER_H,BANKED
;'USING SYSSTRINGPARAM1*1
	BANKSEL	0
	CALL	FN_PAD
	MOVLW	LOW PAD
	BANKSEL	SYSLCDPRINTDATAHANDLER
	MOVWF	SYSLCDPRINTDATAHANDLER,BANKED
	MOVLW	HIGH PAD
	MOVWF	SYSLCDPRINTDATAHANDLER_H,BANKED
	BANKSEL	0
	CALL	GLCDPRINT5
;'DRAW A BOX
;'BOX (46,9,56,19)
	MOVLW	46
	MOVWF	LINEX1,ACCESS
	CLRF	LINEX1_H,ACCESS
	MOVLW	9
	BANKSEL	LINEY1
	MOVWF	LINEY1,BANKED
	CLRF	LINEY1_H,BANKED
	MOVLW	56
	MOVWF	LINEX2,BANKED
	CLRF	LINEX2_H,BANKED
	MOVLW	19
	MOVWF	LINEY2,BANKED
	CLRF	LINEY2_H,BANKED
	MOVFF	GLCDFOREGROUND,LINECOLOUR
	MOVFF	GLCDFOREGROUND_H,LINECOLOUR_H
	BANKSEL	0
	RCALL	BOX17
;'DRAW A CHARACTER
;'GLCDDRAWCHAR(48, 10, CCOUNT )
	MOVLW	48
	MOVWF	CHARLOCX,ACCESS
	CLRF	CHARLOCX_H,ACCESS
	MOVLW	10
	MOVWF	CHARLOCY,ACCESS
	CLRF	CHARLOCY_H,ACCESS
	MOVFF	CCOUNT,CHARCODE
	MOVFF	GLCDFOREGROUND,LINECOLOUR
	MOVFF	GLCDFOREGROUND_H,LINECOLOUR_H
	CALL	GLCDDRAWCHAR_SSD1306
;'PREPARE A STRING
;'OUTSTRING = STR( CCOUNT )
	MOVFF	CCOUNT,SYSVALTEMP
	BANKSEL	SYSVALTEMP_H
	CLRF	SYSVALTEMP_H,BANKED
	BANKSEL	0
	CALL	FN_STR
	LFSR	1,OUTSTRING
	LFSR	0,STR
	CALL	SYSCOPYSTRING
;'DRAW A STRING
;'GLCDDRAWSTRING(64, 9, PAD(OUTSTRING,3) )
	MOVLW	64
	BANKSEL	STRINGLOCX
	MOVWF	STRINGLOCX,BANKED
	MOVLW	9
	MOVWF	CHARLOCY,ACCESS
	MOVLW	LOW OUTSTRING
	MOVWF	SYSSYSINSTRINGHANDLER,BANKED
	MOVLW	HIGH OUTSTRING
	MOVWF	SYSSYSINSTRINGHANDLER_H,BANKED
	MOVLW	3
	MOVWF	SYSSTRLEN,BANKED
	LFSR	1,SYSSTRINGPARAM1
	MOVLW	LOW STRINGTABLE52
	MOVWF	TBLPTR,ACCESS
	MOVLW	HIGH STRINGTABLE52
	MOVWF	TBLPTRH,ACCESS
	MOVLW	UPPER STRINGTABLE52
	MOVWF	TBLPTRU,ACCESS
	BANKSEL	0
	CALL	SYSREADSTRING
	MOVLW	LOW SYSSTRINGPARAM1
	BANKSEL	SYSSYSINSTRING3HANDLER
	MOVWF	SYSSYSINSTRING3HANDLER,BANKED
	MOVLW	HIGH SYSSTRINGPARAM1
	MOVWF	SYSSYSINSTRING3HANDLER_H,BANKED
;'USING SYSSTRINGPARAM1*1
	BANKSEL	0
	CALL	FN_PAD
	MOVLW	LOW PAD
	BANKSEL	SYSCHARSHANDLER
	MOVWF	SYSCHARSHANDLER,BANKED
	MOVLW	HIGH PAD
	MOVWF	SYSCHARSHANDLER_H,BANKED
	MOVFF	GLCDFOREGROUND,LINECOLOUR
	MOVFF	GLCDFOREGROUND_H,LINECOLOUR_H
	BANKSEL	0
	CALL	GLCDDRAWSTRING
;'DRAW A FILLED BOX
;'FILLEDBOX 3,43,11,51, WORDNUMBER
	MOVLW	3
	MOVWF	LINEX1,ACCESS
	MOVLW	43
	BANKSEL	LINEY1
	MOVWF	LINEY1,BANKED
	MOVLW	11
	MOVWF	LINEX2,BANKED
	MOVLW	51
	MOVWF	LINEY2,BANKED
	MOVFF	WORDNUMBER,LINECOLOUR
	MOVFF	WORDNUMBER_H,LINECOLOUR_H
	BANKSEL	0
	RCALL	FILLEDBOX_SSD1306
;'DRAW A FILLED BOX
;'FILLEDCIRCLE( 44,41,9, LONGNUMBER XOR 1)
	MOVLW	44
	BANKSEL	XOFFSET
	MOVWF	XOFFSET,BANKED
	CLRF	XOFFSET_H,BANKED
	MOVLW	41
	MOVWF	YOFFSET,BANKED
	CLRF	YOFFSET_H,BANKED
	MOVLW	9
	MOVWF	XRADIUS,BANKED
	CLRF	XRADIUS_H,BANKED
	MOVLW	1
	XORWF	LONGNUMBER,W,BANKED
	MOVWF	LINECOLOUR,ACCESS
	MOVFF	LONGNUMBER_H,LINECOLOUR_H
	MOVFF	LONGNUMBER_U,LINECOLOUR_U
	MOVFF	LONGNUMBER_E,LINECOLOUR_E
	BANKSEL	0
	RCALL	FILLEDCIRCLE23
;'DRAW A LINE
;'LINE 0,63,64,31
	CLRF	LINEX1,ACCESS
	CLRF	LINEX1_H,ACCESS
	MOVLW	63
	BANKSEL	LINEY1
	MOVWF	LINEY1,BANKED
	CLRF	LINEY1_H,BANKED
	MOVLW	64
	MOVWF	LINEX2,BANKED
	CLRF	LINEX2_H,BANKED
	MOVLW	31
	MOVWF	LINEY2,BANKED
	CLRF	LINEY2_H,BANKED
	MOVFF	GLCDFOREGROUND,LINECOLOUR
	MOVFF	GLCDFOREGROUND_H,LINECOLOUR_H
	BANKSEL	0
	CALL	_LINE69
;'DO SOME SIMPLE MATHS
;'LONGNUMBER = LONGNUMBER + 7 : WORDNUMBER = WORDNUMBER + 3 : BYTENUMBER++
	MOVLW	7
	BANKSEL	LONGNUMBER
	ADDWF	LONGNUMBER,F,BANKED
	MOVLW	0
	ADDWFC	LONGNUMBER_H,F,BANKED
	MOVLW	0
	ADDWFC	LONGNUMBER_U,F,BANKED
	MOVLW	0
	ADDWFC	LONGNUMBER_E,F,BANKED
;'LONGNUMBER = LONGNUMBER + 7 : WORDNUMBER = WORDNUMBER + 3 : BYTENUMBER++
	MOVLW	3
	ADDWF	WORDNUMBER,F,BANKED
	MOVLW	0
	ADDWFC	WORDNUMBER_H,F,BANKED
;'LONGNUMBER = LONGNUMBER + 7 : WORDNUMBER = WORDNUMBER + 3 : BYTENUMBER++
	INCF	BYTENUMBER,F,ACCESS
;'NEXT
	MOVLW	127
	SUBWF	CCOUNT,W,ACCESS
	BTFSS	STATUS,0,ACCESS
	BRA	SYSFORLOOP1
GLOBAL	SYSFORLOOPEND1
SYSFORLOOPEND1:
;'LOOP
	BRA	SYSDOLOOP_S1
GLOBAL	SYSDOLOOP_E1
SYSDOLOOP_E1:
;'END
	BRA	BASPROGRAMEND
;'ASM SHOWDEBUG  GGLCD SSD1306 BUFFER IS 1024BYTES
GLOBAL	BASPROGRAMEND
BASPROGRAMEND:
	SLEEP
	BRA	BASPROGRAMEND

;'********************************************************************************

;'OVERLOADED SIGNATURE: WORD:WORD:WORD:WORD:WORD:, SOURCE: GLCD.H (1732)
GLOBAL	BOX17
BOX17:
;'DIM GLCDTEMP AS WORD
;'MAKE SURE THAT STARTING POINT (1) IS ALWAYS LESS THAN END POINT (2)
;'IF LINEX1 > LINEX2 THEN
	MOVFF	LINEX1,SYSWORDTEMPB
	MOVFF	LINEX1_H,SYSWORDTEMPB_H
	MOVFF	LINEX2,SYSWORDTEMPA
	MOVFF	LINEX2_H,SYSWORDTEMPA_H
	CALL	SYSCOMPLESSTHAN16
	BTFSS	SYSBYTETEMPX,0,ACCESS
	BRA	ENDIF8
;'GLCDTEMP = LINEX1
	MOVFF	LINEX1,GLCDTEMP
	MOVFF	LINEX1_H,GLCDTEMP_H
;'LINEX1 = LINEX2
	MOVFF	LINEX2,LINEX1
	MOVFF	LINEX2_H,LINEX1_H
;'LINEX2 = GLCDTEMP
	MOVFF	GLCDTEMP,LINEX2
	MOVFF	GLCDTEMP_H,LINEX2_H
;'END IF
GLOBAL	ENDIF8
ENDIF8:
;'IF LINEY1 > LINEY2 THEN
	MOVFF	LINEY1,SYSWORDTEMPB
	MOVFF	LINEY1_H,SYSWORDTEMPB_H
	MOVFF	LINEY2,SYSWORDTEMPA
	MOVFF	LINEY2_H,SYSWORDTEMPA_H
	CALL	SYSCOMPLESSTHAN16
	BTFSS	SYSBYTETEMPX,0,ACCESS
	BRA	ENDIF9
;'GLCDTEMP = LINEY1
	MOVFF	LINEY1,GLCDTEMP
	MOVFF	LINEY1_H,GLCDTEMP_H
;'LINEY1 = LINEY2
	MOVFF	LINEY2,LINEY1
	MOVFF	LINEY2_H,LINEY1_H
;'LINEY2 = GLCDTEMP
	MOVFF	GLCDTEMP,LINEY2
	MOVFF	GLCDTEMP_H,LINEY2_H
;'END IF
GLOBAL	ENDIF9
ENDIF9:
;'DIM DRAWLINE AS WORD
;'DRAW LINES GOING ACROSS
;'FOR DRAWLINE = LINEX1 TO LINEX2
	MOVFF	LINEX1,DRAWLINE
	MOVFF	LINEX1_H,DRAWLINE_H
GLOBAL	SYSFORLOOP5
SYSFORLOOP5:
;'PSET DRAWLINE, LINEY1, LINECOLOUR
	MOVFF	DRAWLINE,GLCDX
	MOVFF	LINEY1,GLCDY
	MOVFF	LINECOLOUR,GLCDCOLOUR
	MOVFF	LINECOLOUR_H,GLCDCOLOUR_H
	CALL	PSET_SSD1306
;'PSET DRAWLINE, LINEY2, LINECOLOUR
	MOVFF	DRAWLINE,GLCDX
	MOVFF	LINEY2,GLCDY
	MOVFF	LINECOLOUR,GLCDCOLOUR
	MOVFF	LINECOLOUR_H,GLCDCOLOUR_H
	CALL	PSET_SSD1306
;'NEXT
;'POSITIVE VALUE STEP HANDLER IN FOR-NEXT STATEMENT :#4P 
	MOVF	DRAWLINE,W,ACCESS
	BANKSEL	LINEX2
	SUBWF	LINEX2,W,BANKED
	MOVWF	SYSTEMP1,BANKED
	MOVF	DRAWLINE_H,W,ACCESS
	SUBWFB	LINEX2_H,W,BANKED
	MOVWF	SYSTEMP1_H,BANKED
	MOVFF	SYSTEMP1,SYSWORDTEMPA
	MOVFF	SYSTEMP1_H,SYSWORDTEMPA_H
	CLRF	SYSWORDTEMPB,ACCESS
	CLRF	SYSWORDTEMPB_H,ACCESS
	BANKSEL	0
	CALL	SYSCOMPEQUAL16
	COMF	SYSBYTETEMPX,F,ACCESS
	BTFSS	SYSBYTETEMPX,0,ACCESS
	BRA	ENDIF10
;'SET LOOPVAR TO LOOPVAR + STEPVALUE WHERE STEPVALUE IS A POSITIVE VALUE
	INCF	DRAWLINE,F,ACCESS
	BTFSC	STATUS,2,ACCESS
	INCF	DRAWLINE_H,F,ACCESS
	BRA	SYSFORLOOP5
;'END IF
GLOBAL	ENDIF10
ENDIF10:
GLOBAL	SYSFORLOOPEND5
SYSFORLOOPEND5:
;'DRAW LINES GOING DOWN
;'FOR DRAWLINE = LINEY1 TO LINEY2
	MOVFF	LINEY1,DRAWLINE
	MOVFF	LINEY1_H,DRAWLINE_H
GLOBAL	SYSFORLOOP6
SYSFORLOOP6:
;'PSET LINEX1, DRAWLINE, LINECOLOUR
	MOVFF	LINEX1,GLCDX
	MOVFF	DRAWLINE,GLCDY
	MOVFF	LINECOLOUR,GLCDCOLOUR
	MOVFF	LINECOLOUR_H,GLCDCOLOUR_H
	CALL	PSET_SSD1306
;'PSET LINEX2, DRAWLINE, LINECOLOUR
	MOVFF	LINEX2,GLCDX
	MOVFF	DRAWLINE,GLCDY
	MOVFF	LINECOLOUR,GLCDCOLOUR
	MOVFF	LINECOLOUR_H,GLCDCOLOUR_H
	CALL	PSET_SSD1306
;'NEXT
;'POSITIVE VALUE STEP HANDLER IN FOR-NEXT STATEMENT :#4P 
	MOVF	DRAWLINE,W,ACCESS
	BANKSEL	LINEY2
	SUBWF	LINEY2,W,BANKED
	MOVWF	SYSTEMP1,BANKED
	MOVF	DRAWLINE_H,W,ACCESS
	SUBWFB	LINEY2_H,W,BANKED
	MOVWF	SYSTEMP1_H,BANKED
	MOVFF	SYSTEMP1,SYSWORDTEMPA
	MOVFF	SYSTEMP1_H,SYSWORDTEMPA_H
	CLRF	SYSWORDTEMPB,ACCESS
	CLRF	SYSWORDTEMPB_H,ACCESS
	BANKSEL	0
	CALL	SYSCOMPEQUAL16
	COMF	SYSBYTETEMPX,F,ACCESS
	BTFSS	SYSBYTETEMPX,0,ACCESS
	BRA	ENDIF11
;'SET LOOPVAR TO LOOPVAR + STEPVALUE WHERE STEPVALUE IS A POSITIVE VALUE
	INCF	DRAWLINE,F,ACCESS
	BTFSC	STATUS,2,ACCESS
	INCF	DRAWLINE_H,F,ACCESS
	BRA	SYSFORLOOP6
;'END IF
GLOBAL	ENDIF11
ENDIF11:
GLOBAL	SYSFORLOOPEND6
SYSFORLOOPEND6:
	RETURN

;'********************************************************************************

;'OVERLOADED SIGNATURE: WORD:WORD:INTEGER:WORD:BYTE:, SOURCE: GLCD.H (1808)
GLOBAL	CIRCLE20
CIRCLE20:
;'DIM RADIUSERR, XRADIUS AS INTEGER
;'XRADIUS = INXRADIUS
	MOVFF	INXRADIUS,XRADIUS
	MOVFF	INXRADIUS_H,XRADIUS_H
;'RADIUSERR = -(XRADIUS/2)
	MOVFF	XRADIUS,SYSINTEGERTEMPA
	MOVFF	XRADIUS_H,SYSINTEGERTEMPA_H
	MOVLW	2
	MOVWF	SYSINTEGERTEMPB,ACCESS
	CLRF	SYSINTEGERTEMPB_H,ACCESS
	CALL	SYSDIVSUBINT
	MOVFF	SYSINTEGERTEMPA,SYSTEMP2
	MOVFF	SYSINTEGERTEMPA_H,SYSTEMP2_H
	BANKSEL	SYSTEMP2
	COMF	SYSTEMP2,W,BANKED
	MOVWF	RADIUSERR,BANKED
	COMF	SYSTEMP2_H,W,BANKED
	MOVWF	RADIUSERR_H,BANKED
	INCF	RADIUSERR,F,BANKED
	BTFSC	STATUS,2,ACCESS
	INCF	RADIUSERR_H,F,BANKED
;'DO WHILE XRADIUS >=  YORDINATE
GLOBAL	SYSDOLOOP_S3
SYSDOLOOP_S3:
	MOVFF	XRADIUS,SYSINTEGERTEMPA
	MOVFF	XRADIUS_H,SYSINTEGERTEMPA_H
	MOVFF	YORDINATE,SYSINTEGERTEMPB
	CLRF	SYSINTEGERTEMPB_H,ACCESS
	BANKSEL	0
	CALL	SYSCOMPLESSTHANINT
	COMF	SYSBYTETEMPX,F,ACCESS
	BTFSS	SYSBYTETEMPX,0,ACCESS
	BRA	SYSDOLOOP_E3
;'PSET ((XOFFSET + XRADIUS), (YOFFSET + YORDINATE), LINECOLOUR)
	BANKSEL	XRADIUS
	MOVF	XRADIUS,W,BANKED
	ADDWF	XOFFSET,W,BANKED
	MOVWF	GLCDX,ACCESS
	MOVF	YORDINATE,W,BANKED
	ADDWF	YOFFSET,W,BANKED
	MOVWF	GLCDY,ACCESS
	MOVFF	LINECOLOUR,GLCDCOLOUR
	MOVFF	LINECOLOUR_H,GLCDCOLOUR_H
	BANKSEL	0
	CALL	PSET_SSD1306
;'PSET ((XOFFSET + YORDINATE), (YOFFSET + XRADIUS), LINECOLOUR)
	BANKSEL	YORDINATE
	MOVF	YORDINATE,W,BANKED
	ADDWF	XOFFSET,W,BANKED
	MOVWF	GLCDX,ACCESS
	MOVF	XRADIUS,W,BANKED
	ADDWF	YOFFSET,W,BANKED
	MOVWF	GLCDY,ACCESS
	MOVFF	LINECOLOUR,GLCDCOLOUR
	MOVFF	LINECOLOUR_H,GLCDCOLOUR_H
	BANKSEL	0
	CALL	PSET_SSD1306
;'PSET ((XOFFSET - XRADIUS), (YOFFSET + YORDINATE), LINECOLOUR)
	BANKSEL	XRADIUS
	MOVF	XRADIUS,W,BANKED
	SUBWF	XOFFSET,W,BANKED
	MOVWF	GLCDX,ACCESS
	MOVF	YORDINATE,W,BANKED
	ADDWF	YOFFSET,W,BANKED
	MOVWF	GLCDY,ACCESS
	MOVFF	LINECOLOUR,GLCDCOLOUR
	MOVFF	LINECOLOUR_H,GLCDCOLOUR_H
	BANKSEL	0
	CALL	PSET_SSD1306
;'PSET ((XOFFSET - YORDINATE), (YOFFSET + XRADIUS), LINECOLOUR)
	BANKSEL	YORDINATE
	MOVF	YORDINATE,W,BANKED
	SUBWF	XOFFSET,W,BANKED
	MOVWF	GLCDX,ACCESS
	MOVF	XRADIUS,W,BANKED
	ADDWF	YOFFSET,W,BANKED
	MOVWF	GLCDY,ACCESS
	MOVFF	LINECOLOUR,GLCDCOLOUR
	MOVFF	LINECOLOUR_H,GLCDCOLOUR_H
	BANKSEL	0
	CALL	PSET_SSD1306
;'PSET ((XOFFSET - XRADIUS), (YOFFSET - YORDINATE), LINECOLOUR)
	BANKSEL	XRADIUS
	MOVF	XRADIUS,W,BANKED
	SUBWF	XOFFSET,W,BANKED
	MOVWF	GLCDX,ACCESS
	MOVF	YORDINATE,W,BANKED
	SUBWF	YOFFSET,W,BANKED
	MOVWF	GLCDY,ACCESS
	MOVFF	LINECOLOUR,GLCDCOLOUR
	MOVFF	LINECOLOUR_H,GLCDCOLOUR_H
	BANKSEL	0
	CALL	PSET_SSD1306
;'PSET ((XOFFSET - YORDINATE), (YOFFSET - XRADIUS), LINECOLOUR)
	BANKSEL	YORDINATE
	MOVF	YORDINATE,W,BANKED
	SUBWF	XOFFSET,W,BANKED
	MOVWF	GLCDX,ACCESS
	MOVF	XRADIUS,W,BANKED
	SUBWF	YOFFSET,W,BANKED
	MOVWF	GLCDY,ACCESS
	MOVFF	LINECOLOUR,GLCDCOLOUR
	MOVFF	LINECOLOUR_H,GLCDCOLOUR_H
	BANKSEL	0
	CALL	PSET_SSD1306
;'PSET ((XOFFSET + XRADIUS), (YOFFSET - YORDINATE), LINECOLOUR)
	BANKSEL	XRADIUS
	MOVF	XRADIUS,W,BANKED
	ADDWF	XOFFSET,W,BANKED
	MOVWF	GLCDX,ACCESS
	MOVF	YORDINATE,W,BANKED
	SUBWF	YOFFSET,W,BANKED
	MOVWF	GLCDY,ACCESS
	MOVFF	LINECOLOUR,GLCDCOLOUR
	MOVFF	LINECOLOUR_H,GLCDCOLOUR_H
	BANKSEL	0
	CALL	PSET_SSD1306
;'PSET ((XOFFSET + YORDINATE), (YOFFSET - XRADIUS), LINECOLOUR)
	BANKSEL	YORDINATE
	MOVF	YORDINATE,W,BANKED
	ADDWF	XOFFSET,W,BANKED
	MOVWF	GLCDX,ACCESS
	MOVF	XRADIUS,W,BANKED
	SUBWF	YOFFSET,W,BANKED
	MOVWF	GLCDY,ACCESS
	MOVFF	LINECOLOUR,GLCDCOLOUR
	MOVFF	LINECOLOUR_H,GLCDCOLOUR_H
	BANKSEL	0
	CALL	PSET_SSD1306
;'YORDINATE ++
	BANKSEL	YORDINATE
	INCF	YORDINATE,F,BANKED
;'IF RADIUSERR < 0 THEN
	MOVFF	RADIUSERR,SYSINTEGERTEMPA
	MOVFF	RADIUSERR_H,SYSINTEGERTEMPA_H
	CLRF	SYSINTEGERTEMPB,ACCESS
	CLRF	SYSINTEGERTEMPB_H,ACCESS
	BANKSEL	0
	CALL	SYSCOMPLESSTHANINT
	BTFSS	SYSBYTETEMPX,0,ACCESS
	BRA	ELSE12_1
;'RADIUSERR = RADIUSERR + 2 * YORDINATE + 1
	BANKSEL	YORDINATE
	MOVF	YORDINATE,W,BANKED
	MULLW	2
	MOVF	PROD,W,ACCESS
	ADDWF	RADIUSERR,W,BANKED
	MOVWF	SYSTEMP2,BANKED
	MOVLW	0
	ADDWFC	RADIUSERR_H,W,BANKED
	MOVWF	SYSTEMP2_H,BANKED
	MOVLW	1
	ADDWF	SYSTEMP2,W,BANKED
	MOVWF	RADIUSERR,BANKED
	MOVLW	0
	ADDWFC	SYSTEMP2_H,W,BANKED
	MOVWF	RADIUSERR_H,BANKED
;'ELSE
	BRA	ENDIF12
GLOBAL	ELSE12_1
ELSE12_1:
;'XRADIUS --
	MOVLW	1
	BANKSEL	XRADIUS
	SUBWF	XRADIUS,F,BANKED
	MOVLW	0
	SUBWFB	XRADIUS_H,F,BANKED
;'RADIUSERR = RADIUSERR + 2 * (YORDINATE - XRADIUS + 1)
	MOVF	XRADIUS,W,BANKED
	SUBWF	YORDINATE,W,BANKED
	MOVWF	SYSTEMP2,BANKED
	CLRF	SYSTEMP3,BANKED
	MOVF	XRADIUS_H,W,BANKED
	SUBWFB	SYSTEMP3,W,BANKED
	MOVWF	SYSTEMP2_H,BANKED
	MOVLW	1
	ADDWF	SYSTEMP2,W,BANKED
	MOVWF	SYSTEMP1,BANKED
	MOVLW	0
	ADDWFC	SYSTEMP2_H,W,BANKED
	MOVWF	SYSTEMP1_H,BANKED
	MOVFF	SYSTEMP1,SYSINTEGERTEMPA
	MOVFF	SYSTEMP1_H,SYSINTEGERTEMPA_H
	MOVLW	2
	MOVWF	SYSINTEGERTEMPB,ACCESS
	CLRF	SYSINTEGERTEMPB_H,ACCESS
	BANKSEL	0
	CALL	SYSMULTSUBINT
	MOVF	SYSINTEGERTEMPX,W,ACCESS
	BANKSEL	RADIUSERR
	ADDWF	RADIUSERR,F,BANKED
	MOVF	SYSINTEGERTEMPX_H,W,ACCESS
	ADDWFC	RADIUSERR_H,F,BANKED
;'END IF
GLOBAL	ENDIF12
ENDIF12:
;'LOOP
	BRA	SYSDOLOOP_S3
GLOBAL	SYSDOLOOP_E3
SYSDOLOOP_E3:
	RETURN

;'********************************************************************************

;'SOURCE: GLCD_SSD1306.H (1063)
GLOBAL	CURSOR_POSITION_SSD1306
CURSOR_POSITION_SSD1306:
;'DIM POSCHARX, POSCHARX AS WORD
;'POSCHARY = LOCY / 8
;'FASTER THAN /8
;'POSCHARY = LOCY
	MOVFF	LOCY,POSCHARY
;'REPEAT 3
	MOVLW	3
	BANKSEL	SYSREPEATTEMP4
	MOVWF	SYSREPEATTEMP4,BANKED
GLOBAL	SYSREPEATLOOP4
SYSREPEATLOOP4:
;'SET C OFF
	BCF	STATUS,0,ACCESS
;'ROTATE POSCHARY RIGHT
	RRCF	POSCHARY,F,BANKED
;'END REPEAT
	DECFSZ	SYSREPEATTEMP4,F,BANKED
	BRA	SYSREPEATLOOP4
GLOBAL	SYSREPEATLOOPEND4
SYSREPEATLOOPEND4:
;'WRITE_COMMAND_SSD1306( 0XB0 + POSCHARY )   ' SET PAGE ADDRESS
	MOVLW	176
	ADDWF	POSCHARY,W,BANKED
	MOVWF	SSD1306SENDBYTE,BANKED
	BANKSEL	0
	CALL	WRITE_COMMAND_SSD1306
;'POSCHARX = ( LOCX  & 0X0F )  ' LOWER NIBBLE
	MOVLW	15
	BANKSEL	LOCX
	ANDWF	LOCX,W,BANKED
	MOVWF	POSCHARX,BANKED
	CLRF	POSCHARX_H,BANKED
;'WRITE_COMMAND_SSD1306( POSCHARX )
	MOVFF	POSCHARX,SSD1306SENDBYTE
	BANKSEL	0
	CALL	WRITE_COMMAND_SSD1306
;'POSCHARX = LOCX
	MOVFF	LOCX,POSCHARX
	BANKSEL	POSCHARX_H
	CLRF	POSCHARX_H,BANKED
;'REPEAT 4
	MOVLW	4
	MOVWF	SYSREPEATTEMP4,BANKED
GLOBAL	SYSREPEATLOOP5
SYSREPEATLOOP5:
;'SET C OFF
	BCF	STATUS,0,ACCESS
;'ROTATE POSCHARX RIGHT
	RRCF	POSCHARX_H,F,BANKED
	RRCF	POSCHARX,F,BANKED
;'END REPEAT
	DECFSZ	SYSREPEATTEMP4,F,BANKED
	BRA	SYSREPEATLOOP5
GLOBAL	SYSREPEATLOOPEND5
SYSREPEATLOOPEND5:
;'POSCHARX = ( POSCHARX & 0X0F ) + 0X10
	MOVLW	15
	ANDWF	POSCHARX,W,BANKED
	MOVWF	SYSTEMP1,BANKED
	CLRF	SYSTEMP1_H,BANKED
	MOVLW	16
	ADDWF	SYSTEMP1,W,BANKED
	MOVWF	POSCHARX,BANKED
	MOVLW	0
	ADDWFC	SYSTEMP1_H,W,BANKED
	MOVWF	POSCHARX_H,BANKED
;'WRITE_COMMAND_SSD1306 ( POSCHARX )
	MOVFF	POSCHARX,SSD1306SENDBYTE
	BANKSEL	0
	GOTO	WRITE_COMMAND_SSD1306

;'********************************************************************************

GLOBAL	DELAY_MS
DELAY_MS:
	INCF	SYSWAITTEMPMS_H, F,ACCESS
GLOBAL	DMS_START
DMS_START:
	MOVLW	129
	MOVWF	DELAYTEMP2,ACCESS
GLOBAL	DMS_OUTER
DMS_OUTER:
	MOVLW	40
	MOVWF	DELAYTEMP,ACCESS
GLOBAL	DMS_INNER
DMS_INNER:
	DECFSZ	DELAYTEMP, F,ACCESS
	BRA	DMS_INNER
	DECFSZ	DELAYTEMP2, F,ACCESS
	BRA	DMS_OUTER
	DECFSZ	SYSWAITTEMPMS, F,ACCESS
	BRA	DMS_START
	DECFSZ	SYSWAITTEMPMS_H, F,ACCESS
	BRA	DMS_START
	RETURN

;'********************************************************************************

GLOBAL	DELAY_S
DELAY_S:
GLOBAL	DS_START
DS_START:
	MOVLW	232
	MOVWF	SYSWAITTEMPMS,ACCESS
	MOVLW	3
	MOVWF	SYSWAITTEMPMS_H,ACCESS
	RCALL	DELAY_MS
	DECFSZ	SYSWAITTEMPS, F,ACCESS
	BRA	DS_START
	RETURN

;'********************************************************************************

;'SOURCE: GLCD_SSD1306.H (869)
GLOBAL	FILLEDBOX_SSD1306
FILLEDBOX_SSD1306:
;'MAKE SURE THAT STARTING POINT (1) IS ALWAYS LESS THAN END POINT (2)
;'IF LINEX1 > LINEX2 THEN
	MOVF	LINEX1,W,ACCESS
	BANKSEL	LINEX2
	SUBWF	LINEX2,W,BANKED
	BTFSC	STATUS,0,ACCESS
	BRA	ENDIF58
;'GLCDTEMP = LINEX1
	MOVFF	LINEX1,GLCDTEMP
;'LINEX1 = LINEX2
	MOVFF	LINEX2,LINEX1
;'LINEX2 = GLCDTEMP
	MOVFF	GLCDTEMP,LINEX2
;'END IF
GLOBAL	ENDIF58
ENDIF58:
;'IF LINEY1 > LINEY2 THEN
	MOVF	LINEY1,W,BANKED
	SUBWF	LINEY2,W,BANKED
	BTFSC	STATUS,0,ACCESS
	BRA	ENDIF59
;'GLCDTEMP = LINEY1
	MOVFF	LINEY1,GLCDTEMP
;'LINEY1 = LINEY2
	MOVFF	LINEY2,LINEY1
;'LINEY2 = GLCDTEMP
	MOVFF	GLCDTEMP,LINEY2
;'END IF
GLOBAL	ENDIF59
ENDIF59:
;'DRAW LINES GOING ACROSS
;'FOR DRAWLINE = LINEX1 TO LINEX2
	MOVFF	LINEX1,DRAWLINE
GLOBAL	SYSFORLOOP18
SYSFORLOOP18:
;'FOR GLCDTEMP = LINEY1 TO LINEY2
	MOVFF	LINEY1,GLCDTEMP
GLOBAL	SYSFORLOOP19
SYSFORLOOP19:
;'PSET DRAWLINE, GLCDTEMP, LINECOLOUR
	MOVFF	DRAWLINE,GLCDX
	MOVFF	GLCDTEMP,GLCDY
	MOVFF	LINECOLOUR,GLCDCOLOUR
	MOVFF	LINECOLOUR_H,GLCDCOLOUR_H
	BANKSEL	0
	CALL	PSET_SSD1306
;'NEXT
;'POSITIVE VALUE STEP HANDLER IN FOR-NEXT STATEMENT :#4P 
	MOVF	GLCDTEMP,W,ACCESS
	BANKSEL	LINEY2
	SUBWF	LINEY2,W,BANKED
	MOVWF	SYSTEMP3,BANKED
	MOVFF	SYSTEMP3,SYSBYTETEMPA
	CLRF	SYSBYTETEMPB,ACCESS
	BANKSEL	0
	CALL	SYSCOMPEQUAL
	COMF	SYSBYTETEMPX,F,ACCESS
	BTFSS	SYSBYTETEMPX,0,ACCESS
	BRA	ENDIF60
;'SET LOOPVAR TO LOOPVAR + STEPVALUE WHERE STEPVALUE IS A POSITIVE VALUE
	INCF	GLCDTEMP,F,ACCESS
	BRA	SYSFORLOOP19
;'END IF
GLOBAL	ENDIF60
ENDIF60:
GLOBAL	SYSFORLOOPEND19
SYSFORLOOPEND19:
;'NEXT
;'POSITIVE VALUE STEP HANDLER IN FOR-NEXT STATEMENT :#4P 
	MOVF	DRAWLINE,W,ACCESS
	BANKSEL	LINEX2
	SUBWF	LINEX2,W,BANKED
	MOVWF	SYSTEMP3,BANKED
	MOVFF	SYSTEMP3,SYSBYTETEMPA
	CLRF	SYSBYTETEMPB,ACCESS
	BANKSEL	0
	CALL	SYSCOMPEQUAL
	COMF	SYSBYTETEMPX,F,ACCESS
	BTFSS	SYSBYTETEMPX,0,ACCESS
	BRA	ENDIF61
;'SET LOOPVAR TO LOOPVAR + STEPVALUE WHERE STEPVALUE IS A POSITIVE VALUE
	INCF	DRAWLINE,F,ACCESS
	BRA	SYSFORLOOP18
;'END IF
GLOBAL	ENDIF61
ENDIF61:
GLOBAL	SYSFORLOOPEND18
SYSFORLOOPEND18:
	RETURN

;'********************************************************************************

;'OVERLOADED SIGNATURE: WORD:WORD:WORD:LONG:, SOURCE: GLCD.H (1906)
GLOBAL	FILLEDCIRCLE23
FILLEDCIRCLE23:
;'CIRCLE FILL CODE IS MERELY A MODIFICATION OF THE MIDPOINT
;'CIRCLE ALGORITHEM WHICH IS AN ADAPTION OF BRESENHAM'S LINE ALGORITHM
;'HTTP://EN.WIKIPEDIA.ORG/WIKI/MIDPOINT_CIRCLE_ALGORITHM
;'HTTP://EN.WIKIPEDIA.ORG/WIKI/BRESENHAM%27S_LINE_ALGORITHM
;'DIM FF, DDF_X, DDF_Y AS INTEGER
;'DIM YCALC2, YCALC1 AS WORD
;'FF = 1 - XRADIUS
	BANKSEL	XRADIUS
	MOVF	XRADIUS,W,BANKED
	SUBLW	1
	MOVWF	FF,ACCESS
	CLRF	SYSTEMP3,BANKED
	MOVF	XRADIUS_H,W,BANKED
	SUBWFB	SYSTEMP3,W,BANKED
	MOVWF	FF_H,ACCESS
;'DDF_X = 1
	MOVLW	1
	MOVWF	DDF_X,ACCESS
	CLRF	DDF_X_H,ACCESS
;'DDF_Y = -2 * XRADIUS
	MOVFF	XRADIUS,SYSINTEGERTEMPA
	MOVFF	XRADIUS_H,SYSINTEGERTEMPA_H
	MOVLW	254
	MOVWF	SYSINTEGERTEMPB,ACCESS
	SETF	SYSINTEGERTEMPB_H,ACCESS
	BANKSEL	0
	CALL	SYSMULTSUBINT
	MOVFF	SYSINTEGERTEMPX,DDF_Y
	MOVFF	SYSINTEGERTEMPX_H,DDF_Y_H
;'FILLCIRCLEXX = 0
	CLRF	FILLCIRCLEXX,ACCESS
;'FILLCIRCLEYY = XRADIUS
	MOVFF	XRADIUS,FILLCIRCLEYY
;'FILL IN THE CENTER BETWEEN THE TWO HALVES
;'YCALC2 = YOFFSET+XRADIUS
	BANKSEL	XRADIUS
	MOVF	XRADIUS,W,BANKED
	ADDWF	YOFFSET,W,BANKED
	MOVWF	YCALC2,BANKED
	MOVF	XRADIUS_H,W,BANKED
	ADDWFC	YOFFSET_H,W,BANKED
	MOVWF	YCALC2_H,BANKED
;'YCALC1 = YOFFSET-XRADIUS
	MOVF	XRADIUS,W,BANKED
	SUBWF	YOFFSET,W,BANKED
	MOVWF	YCALC1,BANKED
	MOVF	XRADIUS_H,W,BANKED
	SUBWFB	YOFFSET_H,W,BANKED
	MOVWF	YCALC1_H,BANKED
;'LINE( XOFFSET, YCALC1 , XOFFSET, YCALC2, LINECOLOUR)
	MOVFF	XOFFSET,LINEX1
	MOVFF	XOFFSET_H,LINEX1_H
	MOVFF	YCALC1,LINEY1
	MOVFF	YCALC1_H,LINEY1_H
	MOVFF	XOFFSET,LINEX2
	MOVFF	XOFFSET_H,LINEX2_H
	MOVFF	YCALC2,LINEY2
	MOVFF	YCALC2_H,LINEY2_H
	BANKSEL	0
	CALL	_LINE70
;'DO WHILE (FILLCIRCLEXX < FILLCIRCLEYY)
GLOBAL	SYSDOLOOP_S4
SYSDOLOOP_S4:
	MOVF	FILLCIRCLEYY,W,ACCESS
	SUBWF	FILLCIRCLEXX,W,ACCESS
	BTFSC	STATUS,0,ACCESS
	BRA	SYSDOLOOP_E4
;'IF FF >= 0 THEN
	MOVFF	FF,SYSINTEGERTEMPA
	MOVFF	FF_H,SYSINTEGERTEMPA_H
	CLRF	SYSINTEGERTEMPB,ACCESS
	CLRF	SYSINTEGERTEMPB_H,ACCESS
	CALL	SYSCOMPLESSTHANINT
	COMF	SYSBYTETEMPX,F,ACCESS
	BTFSS	SYSBYTETEMPX,0,ACCESS
	BRA	ENDIF13
;'FILLCIRCLEYY--
	DECF	FILLCIRCLEYY,F,ACCESS
;'DDF_Y += 2
	MOVLW	2
	ADDWF	DDF_Y,F,ACCESS
	MOVLW	0
	ADDWFC	DDF_Y_H,F,ACCESS
;'FF += DDF_Y
	MOVF	DDF_Y,W,ACCESS
	ADDWF	FF,F,ACCESS
	MOVF	DDF_Y_H,W,ACCESS
	ADDWFC	FF_H,F,ACCESS
;'END IF
GLOBAL	ENDIF13
ENDIF13:
;'FILLCIRCLEXX++
	INCF	FILLCIRCLEXX,F,ACCESS
;'DDF_X += 2
	MOVLW	2
	ADDWF	DDF_X,F,ACCESS
	MOVLW	0
	ADDWFC	DDF_X_H,F,ACCESS
;'FF += DDF_X
	MOVF	DDF_X,W,ACCESS
	ADDWF	FF,F,ACCESS
	MOVF	DDF_X_H,W,ACCESS
	ADDWFC	FF_H,F,ACCESS
;'NOW DRAW VERTICAL LINES BETWEEN THE POINTS ON THE CIRCLE RATHER THAN
;'DRAW THE POINTS OF THE CIRCLE. THIS DRAWS LINES BETWEEN THE
;'PERIMETER POINTS ON THE UPPER AND LOWER QUADRANTS OF THE 2 HALVES OF THE CIRCLE.
;'LINE(XOFFSET+FILLCIRCLEXX, YOFFSET+FILLCIRCLEYY, XOFFSET+FILLCIRCLEXX, YOFFSET-FILLCIRCLEYY, LINECOLOUR);
	MOVF	FILLCIRCLEXX,W,ACCESS
	BANKSEL	XOFFSET
	ADDWF	XOFFSET,W,BANKED
	MOVWF	LINEX1,ACCESS
	MOVLW	0
	ADDWFC	XOFFSET_H,W,BANKED
	MOVWF	LINEX1_H,ACCESS
	MOVF	FILLCIRCLEYY,W,ACCESS
	ADDWF	YOFFSET,W,BANKED
	MOVWF	LINEY1,BANKED
	MOVLW	0
	ADDWFC	YOFFSET_H,W,BANKED
	MOVWF	LINEY1_H,BANKED
	MOVF	FILLCIRCLEXX,W,ACCESS
	ADDWF	XOFFSET,W,BANKED
	MOVWF	LINEX2,BANKED
	MOVLW	0
	ADDWFC	XOFFSET_H,W,BANKED
	MOVWF	LINEX2_H,BANKED
	MOVF	FILLCIRCLEYY,W,ACCESS
	SUBWF	YOFFSET,W,BANKED
	MOVWF	LINEY2,BANKED
	MOVLW	0
	SUBWFB	YOFFSET_H,W,BANKED
	MOVWF	LINEY2_H,BANKED
	BANKSEL	0
	CALL	_LINE70
;'LINE(XOFFSET-FILLCIRCLEXX, YOFFSET+FILLCIRCLEYY, XOFFSET-FILLCIRCLEXX, YOFFSET-FILLCIRCLEYY, LINECOLOUR);
	MOVF	FILLCIRCLEXX,W,ACCESS
	BANKSEL	XOFFSET
	SUBWF	XOFFSET,W,BANKED
	MOVWF	LINEX1,ACCESS
	MOVLW	0
	SUBWFB	XOFFSET_H,W,BANKED
	MOVWF	LINEX1_H,ACCESS
	MOVF	FILLCIRCLEYY,W,ACCESS
	ADDWF	YOFFSET,W,BANKED
	MOVWF	LINEY1,BANKED
	MOVLW	0
	ADDWFC	YOFFSET_H,W,BANKED
	MOVWF	LINEY1_H,BANKED
	MOVF	FILLCIRCLEXX,W,ACCESS
	SUBWF	XOFFSET,W,BANKED
	MOVWF	LINEX2,BANKED
	MOVLW	0
	SUBWFB	XOFFSET_H,W,BANKED
	MOVWF	LINEX2_H,BANKED
	MOVF	FILLCIRCLEYY,W,ACCESS
	SUBWF	YOFFSET,W,BANKED
	MOVWF	LINEY2,BANKED
	MOVLW	0
	SUBWFB	YOFFSET_H,W,BANKED
	MOVWF	LINEY2_H,BANKED
	BANKSEL	0
	CALL	_LINE70
;'LINE(XOFFSET+FILLCIRCLEYY, YOFFSET+FILLCIRCLEXX, FILLCIRCLEYY+XOFFSET, YOFFSET-FILLCIRCLEXX, LINECOLOUR);
	MOVF	FILLCIRCLEYY,W,ACCESS
	BANKSEL	XOFFSET
	ADDWF	XOFFSET,W,BANKED
	MOVWF	LINEX1,ACCESS
	MOVLW	0
	ADDWFC	XOFFSET_H,W,BANKED
	MOVWF	LINEX1_H,ACCESS
	MOVF	FILLCIRCLEXX,W,ACCESS
	ADDWF	YOFFSET,W,BANKED
	MOVWF	LINEY1,BANKED
	MOVLW	0
	ADDWFC	YOFFSET_H,W,BANKED
	MOVWF	LINEY1_H,BANKED
	MOVF	XOFFSET,W,BANKED
	ADDWF	FILLCIRCLEYY,W,ACCESS
	MOVWF	LINEX2,BANKED
	CLRF	SYSTEMP3,BANKED
	MOVF	XOFFSET_H,W,BANKED
	ADDWFC	SYSTEMP3,W,BANKED
	MOVWF	LINEX2_H,BANKED
	MOVF	FILLCIRCLEXX,W,ACCESS
	SUBWF	YOFFSET,W,BANKED
	MOVWF	LINEY2,BANKED
	MOVLW	0
	SUBWFB	YOFFSET_H,W,BANKED
	MOVWF	LINEY2_H,BANKED
	BANKSEL	0
	CALL	_LINE70
;'LINE(XOFFSET-FILLCIRCLEYY, YOFFSET+FILLCIRCLEXX, XOFFSET-FILLCIRCLEYY, YOFFSET-FILLCIRCLEXX, LINECOLOUR);
	MOVF	FILLCIRCLEYY,W,ACCESS
	BANKSEL	XOFFSET
	SUBWF	XOFFSET,W,BANKED
	MOVWF	LINEX1,ACCESS
	MOVLW	0
	SUBWFB	XOFFSET_H,W,BANKED
	MOVWF	LINEX1_H,ACCESS
	MOVF	FILLCIRCLEXX,W,ACCESS
	ADDWF	YOFFSET,W,BANKED
	MOVWF	LINEY1,BANKED
	MOVLW	0
	ADDWFC	YOFFSET_H,W,BANKED
	MOVWF	LINEY1_H,BANKED
	MOVF	FILLCIRCLEYY,W,ACCESS
	SUBWF	XOFFSET,W,BANKED
	MOVWF	LINEX2,BANKED
	MOVLW	0
	SUBWFB	XOFFSET_H,W,BANKED
	MOVWF	LINEX2_H,BANKED
	MOVF	FILLCIRCLEXX,W,ACCESS
	SUBWF	YOFFSET,W,BANKED
	MOVWF	LINEY2,BANKED
	MOVLW	0
	SUBWFB	YOFFSET_H,W,BANKED
	MOVWF	LINEY2_H,BANKED
	BANKSEL	0
	CALL	_LINE70
;'LOOP
	BRA	SYSDOLOOP_S4
GLOBAL	SYSDOLOOP_E4
SYSDOLOOP_E4:
	RETURN

;'********************************************************************************

GLOBAL	GLCDCHARCOL3
GLCDCHARCOL3:
	MOVLW	113
	CPFSLT	SYSSTRINGA,ACCESS
	RETLW	0
	MOVF	SYSSTRINGA, W,ACCESS
	ADDLW	LOW TABLEGLCDCHARCOL3
	MOVWF	TBLPTR,ACCESS
	MOVLW	HIGH TABLEGLCDCHARCOL3
	BTFSC	STATUS,0,ACCESS
	ADDLW	1
	MOVWF	TBLPTRH,ACCESS
	MOVLW	UPPER TABLEGLCDCHARCOL3
	BTFSC	STATUS,0,ACCESS
	ADDLW	1
	MOVWF	TBLPTRU,ACCESS
	TBLRD*
	MOVF	TABLAT, W,ACCESS
	RETURN
GLOBAL	TABLEGLCDCHARCOL3
TABLEGLCDCHARCOL3:
	DB	112,0,16,12,10,136,34,56,32,8,32,16,16,128,128,64,4,0,0,0,40,72,70,108,0,0,0,40
	DB	16,0,16,0,64,124,0,132,130,48,78,120,6,108,12,0,0,16,40,0,4,100,248,254,124,254
	DB	254,254,124,254,0,64,254,254,254,254,124,254,124,254,76,2,126,62,126,198,14,194
	DB	0,4,0,8,128,0,64,254,112,112,112,16,16,254,0,64,254,0,248,248,112,248,16,248
	DB	144,16,120,56,120,136,24,136,0,0,0,32,120
	ALIGN	2;X4

;'********************************************************************************

GLOBAL	GLCDCHARCOL4
GLCDCHARCOL4:
	MOVLW	113
	CPFSLT	SYSSTRINGA,ACCESS
	RETLW	0
	MOVF	SYSSTRINGA, W,ACCESS
	ADDLW	LOW TABLEGLCDCHARCOL4
	MOVWF	TBLPTR,ACCESS
	MOVLW	HIGH TABLEGLCDCHARCOL4
	BTFSC	STATUS,0,ACCESS
	ADDLW	1
	MOVWF	TBLPTRH,ACCESS
	MOVLW	UPPER TABLEGLCDCHARCOL4
	BTFSC	STATUS,0,ACCESS
	ADDLW	1
	MOVWF	TBLPTRU,ACCESS
	TBLRD*
	MOVF	TABLAT, W,ACCESS
	RETURN
GLOBAL	TABLEGLCDCHARCOL4
TABLEGLCDCHARCOL4:
	DB	112,254,56,10,6,204,102,124,112,4,64,16,56,136,162,112,28,0,0,14,254,84,38,146
	DB	10,56,130,16,16,160,16,192,32,162,132,194,130,40,138,148,2,146,146,108,172,40
	DB	40,130,2,146,36,146,130,130,146,18,130,16,130,128,16,128,4,8,130,18,130,18,146,2
	DB	128,64,128,40,16,162,254,8,130,4,128,2,168,144,136,136,168,252,168,16,144,128
	DB	32,130,8,16,136,40,40,16,168,124,128,64,128,80,160,200,16,0,130,16,68
	ALIGN	2;X4

;'********************************************************************************

GLOBAL	GLCDCHARCOL5
GLCDCHARCOL5:
	MOVLW	113
	CPFSLT	SYSSTRINGA,ACCESS
	RETLW	0
	MOVF	SYSSTRINGA, W,ACCESS
	ADDLW	LOW TABLEGLCDCHARCOL5
	MOVWF	TBLPTR,ACCESS
	MOVLW	HIGH TABLEGLCDCHARCOL5
	BTFSC	STATUS,0,ACCESS
	ADDLW	1
	MOVWF	TBLPTRH,ACCESS
	MOVLW	UPPER TABLEGLCDCHARCOL5
	BTFSC	STATUS,0,ACCESS
	ADDLW	1
	MOVWF	TBLPTRU,ACCESS
	TBLRD*
	MOVF	TABLAT, W,ACCESS
	RETURN
GLOBAL	TABLEGLCDCHARCOL5
TABLEGLCDCHARCOL5:
	DB	112,124,124,0,0,238,238,124,168,254,254,84,84,148,148,124,124,0,158,0,40,254,16,170
	DB	6,68,68,124,124,96,16,192,16,146,254,162,138,36,138,146,226,146,146,108,108,68
	DB	40,68,162,242,34,146,130,130,146,18,146,16,254,130,40,128,24,16,130,18,162,50
	DB	146,254,128,128,112,16,224,146,130,16,130,2,128,4,168,136,136,136,168,18,168,8
	DB	250,136,80,254,240,8,136,40,40,8,168,144,128,128,96,32,160,168,108,254,108,16
	DB	66
	ALIGN	2;X4

;'********************************************************************************

GLOBAL	GLCDCHARCOL6
GLCDCHARCOL6:
	MOVLW	113
	CPFSLT	SYSSTRINGA,ACCESS
	RETLW	0
	MOVF	SYSSTRINGA, W,ACCESS
	ADDLW	LOW TABLEGLCDCHARCOL6
	MOVWF	TBLPTR,ACCESS
	MOVLW	HIGH TABLEGLCDCHARCOL6
	BTFSC	STATUS,0,ACCESS
	ADDLW	1
	MOVWF	TBLPTRH,ACCESS
	MOVLW	UPPER TABLEGLCDCHARCOL6
	BTFSC	STATUS,0,ACCESS
	ADDLW	1
	MOVWF	TBLPTRU,ACCESS
	TBLRD*
	MOVF	TABLAT, W,ACCESS
	RETURN
GLOBAL	TABLEGLCDCHARCOL6
TABLEGLCDCHARCOL6:
	DB	112,56,254,12,10,204,102,124,32,4,64,56,16,162,136,112,28,0,0,14,254,84,200,68
	DB	0,130,56,16,16,0,16,0,8,138,128,146,150,254,138,146,18,146,82,0,0,130,40,40,18,130
	DB	36,146,130,68,146,18,146,16,130,126,68,128,4,32,130,18,66,82,146,2,128,64,128,40
	DB	16,138,130,32,254,4,128,8,168,136,136,144,168,2,168,8,128,122,136,128,8,8,136,40
	DB	48,8,168,128,64,64,128,80,160,152,130,0,16,32,68
	ALIGN	2;X4

;'********************************************************************************

GLOBAL	GLCDCHARCOL7
GLCDCHARCOL7:
	MOVLW	113
	CPFSLT	SYSSTRINGA,ACCESS
	RETLW	0
	MOVF	SYSSTRINGA, W,ACCESS
	ADDLW	LOW TABLEGLCDCHARCOL7
	MOVWF	TBLPTR,ACCESS
	MOVLW	HIGH TABLEGLCDCHARCOL7
	BTFSC	STATUS,0,ACCESS
	ADDLW	1
	MOVWF	TBLPTRH,ACCESS
	MOVLW	UPPER TABLEGLCDCHARCOL7
	BTFSC	STATUS,0,ACCESS
	ADDLW	1
	MOVWF	TBLPTRU,ACCESS
	TBLRD*
	MOVF	TABLAT, W,ACCESS
	RETURN
GLOBAL	TABLEGLCDCHARCOL7
TABLEGLCDCHARCOL7:
	DB	112,16,0,10,6,136,34,56,62,8,32,16,16,128,128,64,4,0,0,0,40,36,196,160,0,0,0,40
	DB	16,0,16,0,4,124,0,140,98,32,114,96,14,108,60,0,0,0,40,16,12,124,248,108,68,56
	DB	130,2,244,254,0,2,130,128,254,254,124,12,188,140,100,2,126,62,126,198,14,134,0,64
	DB	0,8,128,0,240,112,64,254,48,4,120,240,0,0,0,0,240,240,112,16,248,16,64,64,248,56
	DB	120,136,120,136,0,0,0,16,120
	ALIGN	2;X4

;'********************************************************************************

;'SOURCE: GLCD_SSD1306.H (442)
GLOBAL	GLCDCLS_SSD1306
GLCDCLS_SSD1306:
;'INITIALISE GLOBAL VARIABLE. REQUIRED VARIABLE FOR CIRCLE IN ALL DEVICE DRIVERS- DO NOT DELETE
;'GLCD_YORDINATE = 0
	CLRF	GLCD_YORDINATE,ACCESS
	CLRF	GLCD_YORDINATE_H,ACCESS
;'FOR SSD1306_BUFFERLOCATIONCALC = 1 TO GLCD_HEIGHT * GLCD_WIDTH / 8
	MOVLW	1
	BANKSEL	SSD1306_BUFFERLOCATIONCALC
	MOVWF	SSD1306_BUFFERLOCATIONCALC,BANKED
	CLRF	SSD1306_BUFFERLOCATIONCALC_H,BANKED
GLOBAL	SYSFORLOOP11
SYSFORLOOP11:
;'SSD1306_BUFFERALIAS(SSD1306_BUFFERLOCATIONCALC) = 0
	LFSR	0,SSD1306_BUFFERALIAS
	MOVF	SSD1306_BUFFERLOCATIONCALC,W,BANKED
	ADDWF	FSR0,F,ACCESS
	MOVF	SSD1306_BUFFERLOCATIONCALC_H,W,BANKED
	ADDWFC	FSR0H,F,ACCESS
	CLRF	INDF0,ACCESS
;'NEXT
;'POSITIVE VALUE STEP HANDLER IN FOR-NEXT STATEMENT :#4P 
	MOVF	SSD1306_BUFFERLOCATIONCALC,W,BANKED
	SUBLW	0
	MOVWF	SYSTEMP1,BANKED
	MOVLW	4
	MOVWF	SYSTEMP3,BANKED
	MOVF	SSD1306_BUFFERLOCATIONCALC_H,W,BANKED
	SUBWFB	SYSTEMP3,W,BANKED
	MOVWF	SYSTEMP1_H,BANKED
	MOVFF	SYSTEMP1,SYSWORDTEMPA
	MOVFF	SYSTEMP1_H,SYSWORDTEMPA_H
	CLRF	SYSWORDTEMPB,ACCESS
	CLRF	SYSWORDTEMPB_H,ACCESS
	BANKSEL	0
	CALL	SYSCOMPEQUAL16
	COMF	SYSBYTETEMPX,F,ACCESS
	BTFSS	SYSBYTETEMPX,0,ACCESS
	BRA	ENDIF46
;'SET LOOPVAR TO LOOPVAR + STEPVALUE WHERE STEPVALUE IS A POSITIVE VALUE
	BANKSEL	SSD1306_BUFFERLOCATIONCALC
	INCF	SSD1306_BUFFERLOCATIONCALC,F,BANKED
	BTFSC	STATUS,2,ACCESS
	INCF	SSD1306_BUFFERLOCATIONCALC_H,F,BANKED
	BRA	SYSFORLOOP11
;'END IF
GLOBAL	ENDIF46
ENDIF46:
GLOBAL	SYSFORLOOPEND11
SYSFORLOOPEND11:
;'1.14 CHANGED TO TRANSACTION
;'FOR SSD1306_BUFFERLOCATIONCALC = 0 TO GLCD_HEIGHT-1 STEP 8
	BANKSEL	SSD1306_BUFFERLOCATIONCALC
	CLRF	SSD1306_BUFFERLOCATIONCALC,BANKED
	CLRF	SSD1306_BUFFERLOCATIONCALC_H,BANKED
GLOBAL	SYSFORLOOP12
SYSFORLOOP12:
;'INIT SYSFORLOOPSTEP11 :#0
	MOVLW	8
	MOVWF	SYSFORLOOPSTEP11,BANKED
	CLRF	SYSFORLOOPSTEP11_H,BANKED
;'CURSOR_POSITION_SSD1306 ( 0 , SSD1306_BUFFERLOCATIONCALC )
	CLRF	LOCX,BANKED
	MOVFF	SSD1306_BUFFERLOCATIONCALC,LOCY
	BANKSEL	0
	RCALL	CURSOR_POSITION_SSD1306
;'OPEN_TRANSACTION_SSD1306
;'MACRO SOURCE: GLCD_SSD1306.H (1241)
;'4WIRE NOT SUPPORTED, SEE WRITE_TRANSACTION_DATA_SSD1306
;'HI2CSTART
	CALL	SI2CSTART
;'HI2CSEND GLCD_I2C_ADDRESS
	MOVLW	120
	MOVWF	I2CBYTE,ACCESS
	CALL	SI2CSEND
;'HI2CSEND 0X40
	MOVLW	64
	MOVWF	I2CBYTE,ACCESS
	CALL	SI2CSEND
;'FOR GLCDTEMP = 0 TO 127
;'LEGACY METHOD
	SETF	GLCDTEMP,ACCESS
GLOBAL	SYSFORLOOP13
SYSFORLOOP13:
	INCF	GLCDTEMP,F,ACCESS
;'WRITE_TRANSACTION_DATA_SSD1306(GLCDBACKGROUND)
;'MACRO SOURCE: GLCD_SSD1306.H (1272)
;'HI2CSEND SSD1306SENDBYTE
	MOVFF	GLCDBACKGROUND,I2CBYTE
	CALL	SI2CSEND
;'NEXT
	MOVLW	127
	SUBWF	GLCDTEMP,W,ACCESS
	BTFSS	STATUS,0,ACCESS
	BRA	SYSFORLOOP13
GLOBAL	SYSFORLOOPEND13
SYSFORLOOPEND13:
;'CLOSE_TRANSACTION_SSD1306
;'MACRO SOURCE: GLCD_SSD1306.H (1305)
;'4WIRE NOT SUPPORTED, SEE WRITE_TRANSACTION_DATA_SSD1306
;'HI2CSTOP
	CALL	SI2CSTOP
;'NEXT
;'INTEGER NEGATIVE STEP HANDLER IN FOR-NEXT STATEMENT
	BANKSEL	SYSFORLOOPSTEP11_H
	BTFSS	SYSFORLOOPSTEP11_H,7,BANKED
	BRA	ELSE48_1
;'SET SYSFORLOOPABSVALUE TO -STEPVALUE :#1 
	COMF	SYSFORLOOPSTEP11,W,BANKED
	MOVWF	SYSFORLOOPABSVALUE12,BANKED
	COMF	SYSFORLOOPSTEP11_H,W,BANKED
	MOVWF	SYSFORLOOPABSVALUE12_H,BANKED
	INCF	SYSFORLOOPABSVALUE12,F,BANKED
	BTFSC	STATUS,2,ACCESS
	INCF	SYSFORLOOPABSVALUE12_H,F,BANKED
;'IF ( SSD1306_BUFFERLOCATIONCALC - 64-1) } [WORD]SYSFORLOOPABSVALUE12 THEN  :#1N 
	MOVLW	64
	SUBWF	SSD1306_BUFFERLOCATIONCALC,W,BANKED
	MOVWF	SYSTEMP1,BANKED
	MOVLW	0
	SUBWFB	SSD1306_BUFFERLOCATIONCALC_H,W,BANKED
	MOVWF	SYSTEMP1_H,BANKED
	MOVLW	1
	SUBWF	SYSTEMP1,W,BANKED
	MOVWF	SYSTEMP2,BANKED
	MOVLW	0
	SUBWFB	SYSTEMP1_H,W,BANKED
	MOVWF	SYSTEMP2_H,BANKED
	MOVFF	SYSTEMP2,SYSWORDTEMPA
	MOVFF	SYSTEMP2_H,SYSWORDTEMPA_H
	MOVFF	SYSFORLOOPABSVALUE12,SYSWORDTEMPB
	MOVFF	SYSFORLOOPABSVALUE12_H,SYSWORDTEMPB_H
	BANKSEL	0
	CALL	SYSCOMPLESSTHAN16
	COMF	SYSBYTETEMPX,F,ACCESS
	BTFSS	SYSBYTETEMPX,0,ACCESS
	BRA	ENDIF49
;'SET LOOPVAR TO LOOPVAR + STEPVALUE WHERE STEPVALUE IS A NEGATIVE VALUE
	BANKSEL	SYSFORLOOPSTEP11
	MOVF	SYSFORLOOPSTEP11,W,BANKED
	ADDWF	SSD1306_BUFFERLOCATIONCALC,F,BANKED
	MOVF	SYSFORLOOPSTEP11_H,W,BANKED
	ADDWFC	SSD1306_BUFFERLOCATIONCALC_H,F,BANKED
	BRA	SYSFORLOOP12
;'END IF
GLOBAL	ENDIF49
ENDIF49:
	BRA	ENDIF48
GLOBAL	ELSE48_1
ELSE48_1:
;'INTEGER POSITIVE STEP HANDLER IN FOR-NEXT STATEMENT
;'IF ([WORD]64-1 - [WORD]SSD1306_BUFFERLOCATIONCALC) } [WORD]SYSFORLOOPSTEP11 THEN :#1P 
	MOVF	SSD1306_BUFFERLOCATIONCALC,W,BANKED
	SUBLW	63
	MOVWF	SYSTEMP1,BANKED
	CLRF	SYSTEMP3,BANKED
	MOVF	SSD1306_BUFFERLOCATIONCALC_H,W,BANKED
	SUBWFB	SYSTEMP3,W,BANKED
	MOVWF	SYSTEMP1_H,BANKED
	MOVFF	SYSTEMP1,SYSWORDTEMPA
	MOVFF	SYSTEMP1_H,SYSWORDTEMPA_H
	MOVFF	SYSFORLOOPSTEP11,SYSWORDTEMPB
	MOVFF	SYSFORLOOPSTEP11_H,SYSWORDTEMPB_H
	BANKSEL	0
	CALL	SYSCOMPLESSTHAN16
	COMF	SYSBYTETEMPX,F,ACCESS
	BTFSS	SYSBYTETEMPX,0,ACCESS
	BRA	ENDIF50
;'SET LOOPVAR TO LOOPVAR + STEPVALUE WHERE STEPVALUE IS A POSITIVE VALUE
	BANKSEL	SYSFORLOOPSTEP11
	MOVF	SYSFORLOOPSTEP11,W,BANKED
	ADDWF	SSD1306_BUFFERLOCATIONCALC,F,BANKED
	MOVF	SYSFORLOOPSTEP11_H,W,BANKED
	ADDWFC	SSD1306_BUFFERLOCATIONCALC_H,F,BANKED
	BRA	SYSFORLOOP12
;'END IF
GLOBAL	ENDIF50
ENDIF50:
;'END IF
GLOBAL	ENDIF48
ENDIF48:
GLOBAL	SYSFORLOOPEND12
SYSFORLOOPEND12:
;'REMOVED AT 1.14. RETAINED FOR DOCUMENTATION ONLY
;'CURSOR_POSITION_SSD1306 ( 0 , 0 )
;'FOR SSD1306_BUFFERLOCATIONCALC = 0 TO GLCD_HEIGHT-1 STEP 8
;'FOR GLCDTEMP = 0 TO 127
;'WRITE_DATA_SSD1306(GLCDBACKGROUND)
;'NEXT
;'NEXT
;'CURSOR_POSITION_SSD1306 ( 0 , 0 )
	BANKSEL	LOCX
	CLRF	LOCX,BANKED
	CLRF	LOCY,BANKED
	BANKSEL	0
	RCALL	CURSOR_POSITION_SSD1306
;'PRINTLOCX =0
	BANKSEL	PRINTLOCX
	CLRF	PRINTLOCX,BANKED
;'PRINTLOCY =0
	CLRF	PRINTLOCY,BANKED
	BANKSEL	0
	RETURN

;'********************************************************************************

;'SOURCE: GLCD_SSD1306.H (490)
GLOBAL	GLCDDRAWCHAR_SSD1306
GLCDDRAWCHAR_SSD1306:
;'THIS IS NOW IN FOUR PARTS
;'1. HANDLER FOR GLCD LM MODE
;'2. PREAMBLE
;'3. GCB FONT SET HANDLER
;'4. OLED FONT SET HANDLER
;'***** HANDLER FOR GLCD LM MODE
;'****** PREAMBLE
;'INVERT COLORS IF REQUIRED
;'IF LINECOLOUR <> GLCDFOREGROUND  THEN
	MOVFF	LINECOLOUR,SYSWORDTEMPA
	MOVFF	LINECOLOUR_H,SYSWORDTEMPA_H
	MOVFF	GLCDFOREGROUND,SYSWORDTEMPB
	MOVFF	GLCDFOREGROUND_H,SYSWORDTEMPB_H
	CALL	SYSCOMPEQUAL16
	COMF	SYSBYTETEMPX,F,ACCESS
	BTFSS	SYSBYTETEMPX,0,ACCESS
	BRA	ENDIF51
;'INVERTED COLOURS
;'GLCDBACKGROUND = 1
	MOVLW	1
	MOVWF	GLCDBACKGROUND,ACCESS
	CLRF	GLCDBACKGROUND_H,ACCESS
;'GLCDFOREGROUND = 0
	CLRF	GLCDFOREGROUND,ACCESS
	CLRF	GLCDFOREGROUND_H,ACCESS
;'END IF
GLOBAL	ENDIF51
ENDIF51:
;'DIM CHARCOL, CHARROW AS WORD
;'CHARCODE -= 15
	MOVLW	15
	SUBWF	CHARCODE,F,ACCESS
;'CHARCOL=0
	CLRF	CHARCOL,ACCESS
	CLRF	CHARCOL_H,ACCESS
;'CURSOR_POSITION_SSD1306 ( CHARLOCX , CHARLOCY )
	MOVFF	CHARLOCX,LOCX
	MOVFF	CHARLOCY,LOCY
	RCALL	CURSOR_POSITION_SSD1306
;'1.14 ADDED TRANSACTION
;'****** GCB FONT SET HANDLER
;'IF CHARCODE>=178 AND CHARCODE<=202 THEN
	MOVFF	CHARCODE,SYSBYTETEMPA
	MOVLW	178
	MOVWF	SYSBYTETEMPB,ACCESS
	CALL	SYSCOMPLESSTHAN
	COMF	SYSBYTETEMPX,F,ACCESS
	MOVFF	SYSBYTETEMPX,SYSTEMP3
	MOVFF	CHARCODE,SYSBYTETEMPB
	MOVLW	202
	MOVWF	SYSBYTETEMPA,ACCESS
	CALL	SYSCOMPLESSTHAN
	COMF	SYSBYTETEMPX,F,ACCESS
	BANKSEL	SYSTEMP3
	MOVF	SYSTEMP3,W,BANKED
	ANDWF	SYSBYTETEMPX,W,ACCESS
	MOVWF	SYSTEMP1,BANKED
	BTFSS	SYSTEMP1,0,BANKED
	BRA	ENDIF52
;'CHARLOCY=CHARLOCY-1
	MOVLW	1
	SUBWF	CHARLOCY,F,ACCESS
	MOVLW	0
	SUBWFB	CHARLOCY_H,F,ACCESS
;'END IF
GLOBAL	ENDIF52
ENDIF52:
;'FOR CURRCHARCOL = 1 TO 5
;'LEGACY METHOD
	CLRF	CURRCHARCOL,ACCESS
GLOBAL	SYSFORLOOP14
SYSFORLOOP14:
	INCF	CURRCHARCOL,F,ACCESS
;'SELECT CASE CURRCHARCOL
;'CASE 1: READTABLE GLCDCHARCOL3, CHARCODE, CURRCHARVAL
GLOBAL	SYSSELECT1CASE1
SYSSELECT1CASE1:
	DECF	CURRCHARCOL,W,ACCESS
	BTFSS	STATUS,2,ACCESS
	BRA	SYSSELECT1CASE2
;'CASE 1: READTABLE GLCDCHARCOL3, CHARCODE, CURRCHARVAL
	MOVFF	CHARCODE,SYSSTRINGA
	BANKSEL	0
	RCALL	GLCDCHARCOL3
	MOVWF	CURRCHARVAL,ACCESS
;'CASE 2: READTABLE GLCDCHARCOL4, CHARCODE, CURRCHARVAL
	BRA	SYSSELECTEND1
GLOBAL	SYSSELECT1CASE2
SYSSELECT1CASE2:
	MOVLW	2
	SUBWF	CURRCHARCOL,W,ACCESS
	BTFSS	STATUS,2,ACCESS
	BRA	SYSSELECT1CASE3
;'CASE 2: READTABLE GLCDCHARCOL4, CHARCODE, CURRCHARVAL
	MOVFF	CHARCODE,SYSSTRINGA
	BANKSEL	0
	RCALL	GLCDCHARCOL4
	MOVWF	CURRCHARVAL,ACCESS
;'CASE 3: READTABLE GLCDCHARCOL5, CHARCODE, CURRCHARVAL
	BRA	SYSSELECTEND1
GLOBAL	SYSSELECT1CASE3
SYSSELECT1CASE3:
	MOVLW	3
	SUBWF	CURRCHARCOL,W,ACCESS
	BTFSS	STATUS,2,ACCESS
	BRA	SYSSELECT1CASE4
;'CASE 3: READTABLE GLCDCHARCOL5, CHARCODE, CURRCHARVAL
	MOVFF	CHARCODE,SYSSTRINGA
	BANKSEL	0
	RCALL	GLCDCHARCOL5
	MOVWF	CURRCHARVAL,ACCESS
;'CASE 4: READTABLE GLCDCHARCOL6, CHARCODE, CURRCHARVAL
	BRA	SYSSELECTEND1
GLOBAL	SYSSELECT1CASE4
SYSSELECT1CASE4:
	MOVLW	4
	SUBWF	CURRCHARCOL,W,ACCESS
	BTFSS	STATUS,2,ACCESS
	BRA	SYSSELECT1CASE5
;'CASE 4: READTABLE GLCDCHARCOL6, CHARCODE, CURRCHARVAL
	MOVFF	CHARCODE,SYSSTRINGA
	BANKSEL	0
	RCALL	GLCDCHARCOL6
	MOVWF	CURRCHARVAL,ACCESS
;'CASE 5: READTABLE GLCDCHARCOL7, CHARCODE, CURRCHARVAL
	BRA	SYSSELECTEND1
GLOBAL	SYSSELECT1CASE5
SYSSELECT1CASE5:
	MOVLW	5
	SUBWF	CURRCHARCOL,W,ACCESS
	BTFSS	STATUS,2,ACCESS
	BRA	SYSSELECTEND1
;'CASE 5: READTABLE GLCDCHARCOL7, CHARCODE, CURRCHARVAL
	MOVFF	CHARCODE,SYSSTRINGA
	BANKSEL	0
	RCALL	GLCDCHARCOL7
	MOVWF	CURRCHARVAL,ACCESS
;'END SELECT
GLOBAL	SYSSELECTEND1
SYSSELECTEND1:
;'FULL MEMORY GLCD MODE
;'CHARROW=0
	CLRF	CHARROW,ACCESS
	CLRF	CHARROW_H,ACCESS
;'FOR CURRCHARROW = 1 TO 8
;'LEGACY METHOD
	CLRF	CURRCHARROW,ACCESS
GLOBAL	SYSFORLOOP15
SYSFORLOOP15:
	INCF	CURRCHARROW,F,ACCESS
;'CHARCOLS=0
	CLRF	CHARCOLS,ACCESS
;'FOR COL=1 TO GLCDFNTDEFAULTSIZE
	MOVLW	1
	MOVWF	COL,ACCESS
GLOBAL	SYSFORLOOP16
SYSFORLOOP16:
;'CHARROWS=0
	CLRF	CHARROWS,ACCESS
;'FOR ROW=1 TO GLCDFNTDEFAULTSIZE
	MOVLW	1
	BANKSEL	ROW
	MOVWF	ROW,BANKED
GLOBAL	SYSFORLOOP17
SYSFORLOOP17:
;'IF CURRCHARVAL.0=1 THEN
	BTFSS	CURRCHARVAL,0,ACCESS
	BRA	ELSE53_1
;'PSET [WORD]CHARLOCX + CHARCOL + CHARCOLS, [WORD]CHARLOCY + CHARROW + CHARROWS, LINECOLOUR
	MOVF	CHARCOL,W,ACCESS
	ADDWF	CHARLOCX,W,ACCESS
	MOVWF	SYSTEMP3,BANKED
	MOVF	CHARCOLS,W,ACCESS
	ADDWF	SYSTEMP3,W,BANKED
	MOVWF	GLCDX,ACCESS
	MOVF	CHARROW,W,ACCESS
	ADDWF	CHARLOCY,W,ACCESS
	MOVWF	SYSTEMP3,BANKED
	MOVF	CHARROWS,W,ACCESS
	ADDWF	SYSTEMP3,W,BANKED
	MOVWF	GLCDY,ACCESS
	MOVFF	LINECOLOUR,GLCDCOLOUR
	MOVFF	LINECOLOUR_H,GLCDCOLOUR_H
	BANKSEL	0
	RCALL	PSET_SSD1306
;'ELSE
	BRA	ENDIF53
GLOBAL	ELSE53_1
ELSE53_1:
;'PSET [WORD]CHARLOCX + CHARCOL + CHARCOLS, [WORD]CHARLOCY + CHARROW + CHARROWS, GLCDBACKGROUND
	MOVF	CHARCOL,W,ACCESS
	ADDWF	CHARLOCX,W,ACCESS
	MOVWF	SYSTEMP3,BANKED
	MOVF	CHARCOLS,W,ACCESS
	ADDWF	SYSTEMP3,W,BANKED
	MOVWF	GLCDX,ACCESS
	MOVF	CHARROW,W,ACCESS
	ADDWF	CHARLOCY,W,ACCESS
	MOVWF	SYSTEMP3,BANKED
	MOVF	CHARROWS,W,ACCESS
	ADDWF	SYSTEMP3,W,BANKED
	MOVWF	GLCDY,ACCESS
	MOVFF	GLCDBACKGROUND,GLCDCOLOUR
	MOVFF	GLCDBACKGROUND_H,GLCDCOLOUR_H
	BANKSEL	0
	RCALL	PSET_SSD1306
;'END IF
GLOBAL	ENDIF53
ENDIF53:
;'PUT OUT A WHITE INTERCHARACTER PIXEL/SPACE
;'PSET [WORD]CHARLOCX + ( GLCDFONTWIDTH * GLCDFNTDEFAULTSIZE) , [WORD]CHARLOCY + CHARROW + CHARROWS , GLCDBACKGROUND
	MOVF	GLCDFONTWIDTH,W,ACCESS
	MULWF	GLCDFNTDEFAULTSIZE,ACCESS
	MOVFF	PRODL,SYSTEMP3
	BANKSEL	SYSTEMP3
	MOVF	SYSTEMP3,W,BANKED
	ADDWF	CHARLOCX,W,ACCESS
	MOVWF	GLCDX,ACCESS
	MOVF	CHARROW,W,ACCESS
	ADDWF	CHARLOCY,W,ACCESS
	MOVWF	SYSTEMP3,BANKED
	MOVF	CHARROWS,W,ACCESS
	ADDWF	SYSTEMP3,W,BANKED
	MOVWF	GLCDY,ACCESS
	MOVFF	GLCDBACKGROUND,GLCDCOLOUR
	MOVFF	GLCDBACKGROUND_H,GLCDCOLOUR_H
	BANKSEL	0
	RCALL	PSET_SSD1306
;'CHARROWS +=1
	INCF	CHARROWS,F,ACCESS
;'NEXT ROW
;'POSITIVE VALUE STEP HANDLER IN FOR-NEXT STATEMENT :#4P 
	BANKSEL	ROW
	MOVF	ROW,W,BANKED
	SUBWF	GLCDFNTDEFAULTSIZE,W,ACCESS
	MOVWF	SYSTEMP3,BANKED
	MOVFF	SYSTEMP3,SYSBYTETEMPA
	CLRF	SYSBYTETEMPB,ACCESS
	BANKSEL	0
	CALL	SYSCOMPEQUAL
	COMF	SYSBYTETEMPX,F,ACCESS
	BTFSS	SYSBYTETEMPX,0,ACCESS
	BRA	ENDIF54
;'SET LOOPVAR TO LOOPVAR + STEPVALUE WHERE STEPVALUE IS A POSITIVE VALUE
	BANKSEL	ROW
	INCF	ROW,F,BANKED
	BRA	SYSFORLOOP17
;'END IF
GLOBAL	ENDIF54
ENDIF54:
GLOBAL	SYSFORLOOPEND17
SYSFORLOOPEND17:
;'CHARCOLS +=1
	INCF	CHARCOLS,F,ACCESS
;'NEXT COL
;'POSITIVE VALUE STEP HANDLER IN FOR-NEXT STATEMENT :#4P 
	MOVF	COL,W,ACCESS
	SUBWF	GLCDFNTDEFAULTSIZE,W,ACCESS
	BANKSEL	SYSTEMP3
	MOVWF	SYSTEMP3,BANKED
	MOVFF	SYSTEMP3,SYSBYTETEMPA
	CLRF	SYSBYTETEMPB,ACCESS
	BANKSEL	0
	CALL	SYSCOMPEQUAL
	COMF	SYSBYTETEMPX,F,ACCESS
	BTFSS	SYSBYTETEMPX,0,ACCESS
	BRA	ENDIF55
;'SET LOOPVAR TO LOOPVAR + STEPVALUE WHERE STEPVALUE IS A POSITIVE VALUE
	INCF	COL,F,ACCESS
	BRA	SYSFORLOOP16
;'END IF
GLOBAL	ENDIF55
ENDIF55:
GLOBAL	SYSFORLOOPEND16
SYSFORLOOPEND16:
;'ROTATE CURRCHARVAL RIGHT
	RRCF	CURRCHARVAL,F,ACCESS
;'CHARROW +=GLCDFNTDEFAULTSIZE
	MOVF	GLCDFNTDEFAULTSIZE,W,ACCESS
	ADDWF	CHARROW,F,ACCESS
	MOVLW	0
	ADDWFC	CHARROW_H,F,ACCESS
;'NEXT
	MOVLW	8
	SUBWF	CURRCHARROW,W,ACCESS
	BTFSS	STATUS,0,ACCESS
	BRA	SYSFORLOOP15
GLOBAL	SYSFORLOOPEND15
SYSFORLOOPEND15:
;'CHARCOL +=GLCDFNTDEFAULTSIZE
	MOVF	GLCDFNTDEFAULTSIZE,W,ACCESS
	ADDWF	CHARCOL,F,ACCESS
	MOVLW	0
	ADDWFC	CHARCOL_H,F,ACCESS
;'1.14 LOW MEMORY GLCD MODE
;'1.12 CHARACTER GLCD MODE
;'HANDLES SPECIFIC DRAW SEQUENCE. THIS CATERS FOR WRITE ONLY OF A BIT VALUE. NO READ OPERATION.
;'NEXT
	MOVLW	5
	SUBWF	CURRCHARCOL,W,ACCESS
	BTFSS	STATUS,0,ACCESS
	BRA	SYSFORLOOP14
GLOBAL	SYSFORLOOPEND14
SYSFORLOOPEND14:
;'****** OLED FONT SET HANDLER
;'1.14 ADDED TRANSACTION
;'RESTORE
;'GLCDBACKGROUND = 0
	CLRF	GLCDBACKGROUND,ACCESS
	CLRF	GLCDBACKGROUND_H,ACCESS
;'GLCDFOREGROUND = 1
	MOVLW	1
	MOVWF	GLCDFOREGROUND,ACCESS
	CLRF	GLCDFOREGROUND_H,ACCESS
	RETURN

;'********************************************************************************

;'SOURCE: GLCD.H (1528)
GLOBAL	GLCDDRAWSTRING
GLCDDRAWSTRING:
;'DIM GLCDPRINTLOC AS WORD
;'GLCDPRINTLOC = STRINGLOCX
	MOVFF	STRINGLOCX,GLCDPRINTLOC
	CLRF	GLCDPRINTLOC_H,ACCESS
;'FOR XCHAR = 1 TO CHARS(0)
	MOVLW	1
	BANKSEL	XCHAR
	MOVWF	XCHAR,BANKED
GLOBAL	SYSFORLOOP4
SYSFORLOOP4:
;'GLCDDRAWCHAR GLCDPRINTLOC , CHARLOCY , CHARS(XCHAR), LINECOLOUR
	MOVFF	GLCDPRINTLOC,CHARLOCX
	MOVFF	GLCDPRINTLOC_H,CHARLOCX_H
	MOVF	XCHAR,W,BANKED
	ADDWF	SYSCHARSHANDLER,W,BANKED
	MOVWF	FSR0,ACCESS
	MOVLW	0
	ADDWFC	SYSCHARSHANDLER_H,W,BANKED
	MOVWF	FSR0H,ACCESS
	MOVFF	INDF0,CHARCODE
	BANKSEL	0
	RCALL	GLCDDRAWCHAR_SSD1306
;'GLCDPRINTINCREMENTPIXELPOSITIONMACRO
;'MACRO SOURCE: GLCD.H (1462)
;'GLCDPRINTLOC = GLCDPRINTLOC + ( GLCDFONTWIDTH * GLCDFNTDEFAULTSIZE )+1
	MOVF	GLCDFONTWIDTH,W,ACCESS
	MULWF	GLCDFNTDEFAULTSIZE,ACCESS
	MOVFF	PRODL,SYSTEMP3
	BANKSEL	SYSTEMP3
	MOVF	SYSTEMP3,W,BANKED
	ADDWF	GLCDPRINTLOC,W,ACCESS
	MOVWF	SYSTEMP1,BANKED
	MOVLW	0
	ADDWFC	GLCDPRINTLOC_H,W,ACCESS
	MOVWF	SYSTEMP1_H,BANKED
	MOVLW	1
	ADDWF	SYSTEMP1,W,BANKED
	MOVWF	GLCDPRINTLOC,ACCESS
	MOVLW	0
	ADDWFC	SYSTEMP1_H,W,BANKED
	MOVWF	GLCDPRINTLOC_H,ACCESS
;'NEXT
;'POSITIVE VALUE STEP HANDLER IN FOR-NEXT STATEMENT :#4P 
	MOVFF	SYSCHARSHANDLER,FSR0
	MOVFF	SYSCHARSHANDLER_H,FSR0H
	MOVF	XCHAR,W,BANKED
	SUBWF	INDF0,W,ACCESS
	MOVWF	SYSTEMP3,BANKED
	MOVFF	SYSTEMP3,SYSBYTETEMPA
	CLRF	SYSBYTETEMPB,ACCESS
	BANKSEL	0
	CALL	SYSCOMPEQUAL
	COMF	SYSBYTETEMPX,F,ACCESS
	BTFSS	SYSBYTETEMPX,0,ACCESS
	BRA	ENDIF7
;'SET LOOPVAR TO LOOPVAR + STEPVALUE WHERE STEPVALUE IS A POSITIVE VALUE
	BANKSEL	XCHAR
	INCF	XCHAR,F,BANKED
	BRA	SYSFORLOOP4
;'END IF
GLOBAL	ENDIF7
ENDIF7:
GLOBAL	SYSFORLOOPEND4
SYSFORLOOPEND4:
	RETURN

;'********************************************************************************

;'OVERLOADED SIGNATURE: WORD:WORD:STRING:, SOURCE: GLCD.H (1225)
GLOBAL	GLCDPRINT5
GLCDPRINT5:
;'GLCD.H SUB GLCDPRINT
;'DIM GLCDPRINTLOC  AS WORD
;'DIM GLCDPRINT_STRING_COUNTER, GLCDPRINTLEN AS BYTE
;'GLCDPRINTLEN = LCDPRINTDATA(0)
	MOVFF	SYSLCDPRINTDATAHANDLER,FSR0
	MOVFF	SYSLCDPRINTDATAHANDLER_H,FSR0H
	MOVFF	INDF0,GLCDPRINTLEN
;'IF GLCDPRINTLEN = 0 THEN EXIT SUB
	MOVF	GLCDPRINTLEN,F,ACCESS
	BTFSC	STATUS,2,ACCESS
;'IF GLCDPRINTLEN = 0 THEN EXIT SUB
	RETURN
;'IF GLCDPRINTLEN = 0 THEN EXIT SUB
;'GLCDPRINTLOC = PRINTLOCX
	MOVFF	PRINTLOCX,GLCDPRINTLOC
	MOVFF	PRINTLOCX_H,GLCDPRINTLOC_H
;'WRITE DATA
;'FOR GLCDPRINT_STRING_COUNTER = 1 TO GLCDPRINTLEN
	MOVLW	1
	MOVWF	GLCDPRINT_STRING_COUNTER,ACCESS
GLOBAL	SYSFORLOOP2
SYSFORLOOP2:
;'GLCDDRAWCHAR  GLCDPRINTLOC, PRINTLOCY, LCDPRINTDATA(GLCDPRINT_STRING_COUNTER)
	MOVFF	GLCDPRINTLOC,CHARLOCX
	MOVFF	GLCDPRINTLOC_H,CHARLOCX_H
	MOVFF	PRINTLOCY,CHARLOCY
	MOVFF	PRINTLOCY_H,CHARLOCY_H
	MOVF	GLCDPRINT_STRING_COUNTER,W,ACCESS
	BANKSEL	SYSLCDPRINTDATAHANDLER
	ADDWF	SYSLCDPRINTDATAHANDLER,W,BANKED
	MOVWF	FSR0,ACCESS
	MOVLW	0
	ADDWFC	SYSLCDPRINTDATAHANDLER_H,W,BANKED
	MOVWF	FSR0H,ACCESS
	MOVFF	INDF0,CHARCODE
	MOVFF	GLCDFOREGROUND,LINECOLOUR
	MOVFF	GLCDFOREGROUND_H,LINECOLOUR_H
	BANKSEL	0
	RCALL	GLCDDRAWCHAR_SSD1306
;'GLCDPRINTINCREMENTPIXELPOSITIONMACRO
;'MACRO SOURCE: GLCD.H (1462)
;'GLCDPRINTLOC = GLCDPRINTLOC + ( GLCDFONTWIDTH * GLCDFNTDEFAULTSIZE )+1
	MOVF	GLCDFONTWIDTH,W,ACCESS
	MULWF	GLCDFNTDEFAULTSIZE,ACCESS
	MOVFF	PRODL,SYSTEMP1
	BANKSEL	SYSTEMP1
	MOVF	SYSTEMP1,W,BANKED
	ADDWF	GLCDPRINTLOC,W,ACCESS
	MOVWF	SYSTEMP2,BANKED
	MOVLW	0
	ADDWFC	GLCDPRINTLOC_H,W,ACCESS
	MOVWF	SYSTEMP2_H,BANKED
	MOVLW	1
	ADDWF	SYSTEMP2,W,BANKED
	MOVWF	GLCDPRINTLOC,ACCESS
	MOVLW	0
	ADDWFC	SYSTEMP2_H,W,BANKED
	MOVWF	GLCDPRINTLOC_H,ACCESS
;'NEXT
;'POSITIVE VALUE STEP HANDLER IN FOR-NEXT STATEMENT :#4P 
	MOVF	GLCDPRINT_STRING_COUNTER,W,ACCESS
	SUBWF	GLCDPRINTLEN,W,ACCESS
	MOVWF	SYSTEMP1,BANKED
	MOVFF	SYSTEMP1,SYSBYTETEMPA
	CLRF	SYSBYTETEMPB,ACCESS
	BANKSEL	0
	CALL	SYSCOMPEQUAL
	COMF	SYSBYTETEMPX,F,ACCESS
	BTFSS	SYSBYTETEMPX,0,ACCESS
	BRA	ENDIF3
;'SET LOOPVAR TO LOOPVAR + STEPVALUE WHERE STEPVALUE IS A POSITIVE VALUE
	INCF	GLCDPRINT_STRING_COUNTER,F,ACCESS
	BRA	SYSFORLOOP2
;'END IF
GLOBAL	ENDIF3
ENDIF3:
GLOBAL	SYSFORLOOPEND2
SYSFORLOOPEND2:
;'UPDATE THE CURRENT X POSITION FOR GLCDPRINTSTRING
;'PRINTLOCX = GLCDPRINTLOC
	MOVFF	GLCDPRINTLOC,PRINTLOCX
	MOVFF	GLCDPRINTLOC_H,PRINTLOCX_H
	RETURN

;'********************************************************************************

;'OVERLOADED SIGNATURE: WORD:WORD:LONG:, SOURCE: GLCD.H (1337)
GLOBAL	GLCDPRINT8
GLCDPRINT8:
;'DIM SYSCALCTEMPA AS LONG
;'DIM GLCDPRINTLOC AS WORD
;'DIM SYSPRINTBUFFER(10)
;'SYSPRINTBUFFLEN = 0
	BANKSEL	SYSPRINTBUFFLEN
	CLRF	SYSPRINTBUFFLEN,BANKED
;'DO
GLOBAL	SYSDOLOOP_S2
SYSDOLOOP_S2:
;'DIVIDE NUMBER BY 10, REMAINDER INTO BUFFER
;'SYSPRINTBUFFLEN += 1
	BANKSEL	SYSPRINTBUFFLEN
	INCF	SYSPRINTBUFFLEN,F,BANKED
;'SYSPRINTBUFFER(SYSPRINTBUFFLEN) = LCDVALUE % 10
	LFSR	0,SYSPRINTBUFFER
	MOVF	SYSPRINTBUFFLEN,W,BANKED
	ADDWF	FSR0,F,ACCESS
	MOVLW	0
	ADDWFC	FSR0H,F,ACCESS
	MOVFF	LCDVALUE,SYSLONGTEMPA
	MOVFF	LCDVALUE_H,SYSLONGTEMPA_H
	MOVFF	LCDVALUE_U,SYSLONGTEMPA_U
	MOVFF	LCDVALUE_E,SYSLONGTEMPA_E
	MOVLW	10
	MOVWF	SYSLONGTEMPB,ACCESS
	CLRF	SYSLONGTEMPB_H,ACCESS
	CLRF	SYSLONGTEMPB_U,ACCESS
	CLRF	SYSLONGTEMPB_E,ACCESS
	BANKSEL	0
	CALL	SYSDIVSUB32
	MOVFF	SYSLONGTEMPX,INDF0
;'LCDVALUE = SYSCALCTEMPA
	MOVFF	SYSCALCTEMPA,LCDVALUE
	MOVFF	SYSCALCTEMPA_H,LCDVALUE_H
	MOVFF	SYSCALCTEMPA_U,LCDVALUE_U
	MOVFF	SYSCALCTEMPA_E,LCDVALUE_E
;'LOOP WHILE LCDVALUE <> 0
	MOVFF	LCDVALUE,SYSLONGTEMPA
	MOVFF	LCDVALUE_H,SYSLONGTEMPA_H
	MOVFF	LCDVALUE_U,SYSLONGTEMPA_U
	MOVFF	LCDVALUE_E,SYSLONGTEMPA_E
	CLRF	SYSLONGTEMPB,ACCESS
	CLRF	SYSLONGTEMPB_H,ACCESS
	CLRF	SYSLONGTEMPB_U,ACCESS
	CLRF	SYSLONGTEMPB_E,ACCESS
	CALL	SYSCOMPEQUAL32
	COMF	SYSBYTETEMPX,F,ACCESS
	BTFSC	SYSBYTETEMPX,0,ACCESS
	BRA	SYSDOLOOP_S2
GLOBAL	SYSDOLOOP_E2
SYSDOLOOP_E2:
;'DISPLAY
;'GLCDPRINTLOC = PRINTLOCX
	MOVFF	PRINTLOCX,GLCDPRINTLOC
	MOVFF	PRINTLOCX_H,GLCDPRINTLOC_H
;'FOR GLCDPRINT_STRING_COUNTER = SYSPRINTBUFFLEN TO 1 STEP -1
	MOVFF	SYSPRINTBUFFLEN,GLCDPRINT_STRING_COUNTER
GLOBAL	SYSFORLOOP3
SYSFORLOOP3:
;'INIT SYSFORLOOPSTEP2 :#0
	BANKSEL	SYSFORLOOPSTEP2
	SETF	SYSFORLOOPSTEP2,BANKED
	SETF	SYSFORLOOPSTEP2_H,BANKED
;'GLCDDRAWCHAR GLCDPRINTLOC, PRINTLOCY, SYSPRINTBUFFER(GLCDPRINT_STRING_COUNTER) + 48
	MOVFF	GLCDPRINTLOC,CHARLOCX
	MOVFF	GLCDPRINTLOC_H,CHARLOCX_H
	MOVFF	PRINTLOCY,CHARLOCY
	MOVFF	PRINTLOCY_H,CHARLOCY_H
	LFSR	0,SYSPRINTBUFFER
	MOVF	GLCDPRINT_STRING_COUNTER,W,ACCESS
	ADDWF	FSR0,F,ACCESS
	MOVLW	0
	ADDWFC	FSR0H,F,ACCESS
	MOVLW	48
	ADDWF	INDF0,W,ACCESS
	MOVWF	CHARCODE,ACCESS
	MOVFF	GLCDFOREGROUND,LINECOLOUR
	MOVFF	GLCDFOREGROUND_H,LINECOLOUR_H
	BANKSEL	0
	RCALL	GLCDDRAWCHAR_SSD1306
;'GLCDPRINTINCREMENTPIXELPOSITIONMACRO
;'MACRO SOURCE: GLCD.H (1462)
;'GLCDPRINTLOC = GLCDPRINTLOC + ( GLCDFONTWIDTH * GLCDFNTDEFAULTSIZE )+1
	MOVF	GLCDFONTWIDTH,W,ACCESS
	MULWF	GLCDFNTDEFAULTSIZE,ACCESS
	MOVFF	PRODL,SYSTEMP3
	BANKSEL	SYSTEMP3
	MOVF	SYSTEMP3,W,BANKED
	ADDWF	GLCDPRINTLOC,W,ACCESS
	MOVWF	SYSTEMP1,BANKED
	MOVLW	0
	ADDWFC	GLCDPRINTLOC_H,W,ACCESS
	MOVWF	SYSTEMP1_H,BANKED
	MOVLW	1
	ADDWF	SYSTEMP1,W,BANKED
	MOVWF	GLCDPRINTLOC,ACCESS
	MOVLW	0
	ADDWFC	SYSTEMP1_H,W,BANKED
	MOVWF	GLCDPRINTLOC_H,ACCESS
;'NEXT
;'INTEGER NEGATIVE STEP HANDLER IN FOR-NEXT STATEMENT
	BTFSS	SYSFORLOOPSTEP2_H,7,BANKED
	BRA	ELSE4_1
;'IF ( GLCDPRINT_STRING_COUNTER - 1) } -SYSFORLOOPSTEP2 THEN :#3N
	DECF	GLCDPRINT_STRING_COUNTER,W,ACCESS
	MOVWF	SYSTEMP1,BANKED
	COMF	SYSFORLOOPSTEP2,W,BANKED
	MOVWF	SYSTEMP2,BANKED
	COMF	SYSFORLOOPSTEP2_H,W,BANKED
	MOVWF	SYSTEMP2_H,BANKED
	INCF	SYSTEMP2,F,BANKED
	BTFSC	STATUS,2,ACCESS
	INCF	SYSTEMP2_H,F,BANKED
	MOVFF	SYSTEMP1,SYSINTEGERTEMPA
	CLRF	SYSINTEGERTEMPA_H,ACCESS
	MOVFF	SYSTEMP2,SYSINTEGERTEMPB
	MOVFF	SYSTEMP2_H,SYSINTEGERTEMPB_H
	BANKSEL	0
	CALL	SYSCOMPLESSTHANINT
	COMF	SYSBYTETEMPX,F,ACCESS
	BTFSS	SYSBYTETEMPX,0,ACCESS
	BRA	ENDIF5
;'SET LOOPVAR TO LOOPVAR + STEPVALUE WHERE STEPVALUE IS A NEGATIVE VALUE
	BANKSEL	SYSFORLOOPSTEP2
	MOVF	SYSFORLOOPSTEP2,W,BANKED
	ADDWF	GLCDPRINT_STRING_COUNTER,F,ACCESS
	BRA	SYSFORLOOP3
;'END IF
GLOBAL	ENDIF5
ENDIF5:
	BRA	ENDIF4
GLOBAL	ELSE4_1
ELSE4_1:
;'INTEGER POSITIVE STEP HANDLER IN FOR-NEXT STATEMENT
;'IF (1 - GLCDPRINT_STRING_COUNTER) } SYSFORLOOPSTEP2 THEN :#3P
	MOVF	GLCDPRINT_STRING_COUNTER,W,ACCESS
	SUBLW	1
	MOVWF	SYSTEMP1,BANKED
	MOVFF	SYSTEMP1,SYSINTEGERTEMPA
	CLRF	SYSINTEGERTEMPA_H,ACCESS
	MOVFF	SYSFORLOOPSTEP2,SYSINTEGERTEMPB
	MOVFF	SYSFORLOOPSTEP2_H,SYSINTEGERTEMPB_H
	BANKSEL	0
	CALL	SYSCOMPLESSTHANINT
	COMF	SYSBYTETEMPX,F,ACCESS
	BTFSS	SYSBYTETEMPX,0,ACCESS
	BRA	ENDIF6
;'SET LOOPVAR TO LOOPVAR + STEPVALUE WHERE STEPVALUE IS A POSITIVE VALUE
	BANKSEL	SYSFORLOOPSTEP2
	MOVF	SYSFORLOOPSTEP2,W,BANKED
	ADDWF	GLCDPRINT_STRING_COUNTER,F,ACCESS
	BRA	SYSFORLOOP3
;'END IF
GLOBAL	ENDIF6
ENDIF6:
;'END IF
GLOBAL	ENDIF4
ENDIF4:
GLOBAL	SYSFORLOOPEND3
SYSFORLOOPEND3:
;'UPDATE THE CURRENT X POSITION FOR GLCDPRINTSTRING
;'PRINTLOCX = GLCDPRINTLOC
	MOVFF	GLCDPRINTLOC,PRINTLOCX
	MOVFF	GLCDPRINTLOC_H,PRINTLOCX_H
	RETURN

;'********************************************************************************

;'SOURCE: HWI2C.H (722)
GLOBAL	HI2CINIT
HI2CINIT:
;'ASM SHOWDEBUG  THIS METHOD SETS THE VARIABLE `HI2CCURRENTMODE`, AND, IF REQUIRED CALLS THE METHOD `SI2CINIT` TO SET UP NEW MSSP MODULES - AKA K-MODE FAMILY CHIPS
;'HI2CCURRENTMODE = 0
	CLRF	HI2CCURRENTMODE,ACCESS
;'INITIALISE THE I2C MODULE
;'SI2CINIT
	BRA	SI2CINIT

;'********************************************************************************

;'SOURCE: HWI2C.H (260)
GLOBAL	HI2CMODE
HI2CMODE:
;'ASM SHOWDEBUG  THIS METHOD SETS THE VARIABLE `HI2CCURRENTMODE`, AND, IF REQUIRED, SETS THE SSPCON1.BITS
	RETURN

;'********************************************************************************

;'SOURCE: GLCD_SSD1306.H (332)
GLOBAL	INITGLCD_SSD1306
INITGLCD_SSD1306:
;'COLOURS //SET THESE FIRST
;'GLCDBACKGROUND = 0
	CLRF	GLCDBACKGROUND,ACCESS
	CLRF	GLCDBACKGROUND_H,ACCESS
;'GLCDFOREGROUND = 1
	MOVLW	1
	MOVWF	GLCDFOREGROUND,ACCESS
	CLRF	GLCDFOREGROUND_H,ACCESS
;'GLCDFONTWIDTH = 5
	MOVLW	5
	MOVWF	GLCDFONTWIDTH,ACCESS
;'GLCDFNTDEFAULTHEIGHT = 7  'USED BY GLCDPRINTSTRING AND GLCDPRINTSTRINGLN
	MOVLW	7
	MOVWF	GLCDFNTDEFAULTHEIGHT,ACCESS
;'DIM PRINTLOCX, PRINTLOCY AS WORD
;'GLCDFNTDEFAULT = 0
	CLRF	GLCDFNTDEFAULT,ACCESS
;'GLCDFNTDEFAULTSIZE = 1
	MOVLW	1
	MOVWF	GLCDFNTDEFAULTSIZE,ACCESS
;'WAIT 255 MS             'ADDED TO ENSURE THE CHARGE PUMP AND POWER IS OPERATIONAL.
	SETF	SYSWAITTEMPMS,ACCESS
	CLRF	SYSWAITTEMPMS_H,ACCESS
	CALL	DELAY_MS
;'HI2CMODE MASTER
	MOVLW	12
	MOVWF	HI2CCURRENTMODE,ACCESS
	RCALL	HI2CMODE
;'WAIT 15 MS  'WAIT FOR POWER-UP AND RESET
	MOVLW	15
	MOVWF	SYSWAITTEMPMS,ACCESS
	CLRF	SYSWAITTEMPMS_H,ACCESS
	CALL	DELAY_MS
;'SETUP CODE FOR SSD1306 CONTROLLERS
;'INIT SEQUENCE FOR 128X64 OLED MODULE
;'WRITE_COMMAND_SSD1306(SSD1306_DISPLAYOFF)                    ' 0XAE
	MOVLW	174
	BANKSEL	SSD1306SENDBYTE
	MOVWF	SSD1306SENDBYTE,BANKED
	BANKSEL	0
	CALL	WRITE_COMMAND_SSD1306
;'WRITE_COMMAND_SSD1306(SSD1306_DEACTIVATE_SCROLL)
	MOVLW	46
	BANKSEL	SSD1306SENDBYTE
	MOVWF	SSD1306SENDBYTE,BANKED
	BANKSEL	0
	CALL	WRITE_COMMAND_SSD1306
;'WRITE_COMMAND_SSD1306(SSD1306_SETDISPLAYCLOCKDIV)            ' 0XD5
	MOVLW	213
	BANKSEL	SSD1306SENDBYTE
	MOVWF	SSD1306SENDBYTE,BANKED
	BANKSEL	0
	CALL	WRITE_COMMAND_SSD1306
;'WRITE_COMMAND_SSD1306(0X80)                                  ' THE SUGGESTED RATIO 0X80
	MOVLW	128
	BANKSEL	SSD1306SENDBYTE
	MOVWF	SSD1306SENDBYTE,BANKED
	BANKSEL	0
	CALL	WRITE_COMMAND_SSD1306
;'WRITE_COMMAND_SSD1306(SSD1306_SETMULTIPLEX)                  ' 0XA8
	MOVLW	168
	BANKSEL	SSD1306SENDBYTE
	MOVWF	SSD1306SENDBYTE,BANKED
	BANKSEL	0
	CALL	WRITE_COMMAND_SSD1306
;'WRITE_COMMAND_SSD1306(0X3F)                                 '64 PIXELS
	MOVLW	63
	BANKSEL	SSD1306SENDBYTE
	MOVWF	SSD1306SENDBYTE,BANKED
	BANKSEL	0
	CALL	WRITE_COMMAND_SSD1306
;'WRITE_COMMAND_SSD1306(SSD1306_SETDISPLAYOFFSET)              ' 0XD3
	MOVLW	211
	BANKSEL	SSD1306SENDBYTE
	MOVWF	SSD1306SENDBYTE,BANKED
	BANKSEL	0
	CALL	WRITE_COMMAND_SSD1306
;'WRITE_COMMAND_SSD1306(0X00)                                   ' NO OFFSET
	BANKSEL	SSD1306SENDBYTE
	CLRF	SSD1306SENDBYTE,BANKED
	BANKSEL	0
	CALL	WRITE_COMMAND_SSD1306
;'WRITE_COMMAND_SSD1306(SSD1306_SETSTARTLINE | 0X00)            ' LINE #0
	MOVLW	64
	BANKSEL	SSD1306SENDBYTE
	MOVWF	SSD1306SENDBYTE,BANKED
	BANKSEL	0
	CALL	WRITE_COMMAND_SSD1306
;'WRITE_COMMAND_SSD1306(SSD1306_CHARGEPUMP)                    ' 0X8D
	MOVLW	141
	BANKSEL	SSD1306SENDBYTE
	MOVWF	SSD1306SENDBYTE,BANKED
	BANKSEL	0
	CALL	WRITE_COMMAND_SSD1306
;'IF (SSD1306_VCCSTATE = SSD1306_EXTERNALVCC) THEN
;'WRITE_COMMAND_SSD1306(0X14)
	MOVLW	20
	BANKSEL	SSD1306SENDBYTE
	MOVWF	SSD1306SENDBYTE,BANKED
	BANKSEL	0
	CALL	WRITE_COMMAND_SSD1306
;'END IF
;'WRITE_COMMAND_SSD1306(SSD1306_MEMORYMODE)                    ' 0X20
	MOVLW	32
	BANKSEL	SSD1306SENDBYTE
	MOVWF	SSD1306SENDBYTE,BANKED
	BANKSEL	0
	CALL	WRITE_COMMAND_SSD1306
;'WRITE_COMMAND_SSD1306(0X00)                                  ' 0X00 ACT LIKE KS0108 - DO NOT SELECT!!
;'WRITE_COMMAND_SSD1306(0X10)                                  ' 0X01 ACT LIKE PCD8544
	MOVLW	16
	BANKSEL	SSD1306SENDBYTE
	MOVWF	SSD1306SENDBYTE,BANKED
	BANKSEL	0
	CALL	WRITE_COMMAND_SSD1306
;'WRITE_COMMAND_SSD1306(SSD1306_SEGREMAP | 0X1)
	MOVLW	161
	BANKSEL	SSD1306SENDBYTE
	MOVWF	SSD1306SENDBYTE,BANKED
	BANKSEL	0
	CALL	WRITE_COMMAND_SSD1306
;'WRITE_COMMAND_SSD1306(SSD1306_COMSCANDEC)
	MOVLW	200
	BANKSEL	SSD1306SENDBYTE
	MOVWF	SSD1306SENDBYTE,BANKED
	BANKSEL	0
	CALL	WRITE_COMMAND_SSD1306
;'WRITE_COMMAND_SSD1306(SSD1306_SETCOMPINS)                    ' 0XDA
	MOVLW	218
	BANKSEL	SSD1306SENDBYTE
	MOVWF	SSD1306SENDBYTE,BANKED
	BANKSEL	0
	CALL	WRITE_COMMAND_SSD1306
;'WRITE_COMMAND_SSD1306(0X12)                                 '64 PIXELS
	MOVLW	18
	BANKSEL	SSD1306SENDBYTE
	MOVWF	SSD1306SENDBYTE,BANKED
	BANKSEL	0
	CALL	WRITE_COMMAND_SSD1306
;'WRITE_COMMAND_SSD1306(SSD1306_SETCONTRAST)                   ' 0X81
	MOVLW	129
	BANKSEL	SSD1306SENDBYTE
	MOVWF	SSD1306SENDBYTE,BANKED
	BANKSEL	0
	CALL	WRITE_COMMAND_SSD1306
;'IF SSD1306_VCCSTATE = SSD1306_EXTERNALVCC THEN
;'WRITE_COMMAND_SSD1306(0XCF)
	MOVLW	207
	BANKSEL	SSD1306SENDBYTE
	MOVWF	SSD1306SENDBYTE,BANKED
	BANKSEL	0
	CALL	WRITE_COMMAND_SSD1306
;'END IF
;'WRITE_COMMAND_SSD1306(SSD1306_SETPRECHARGE)                  ' 0XD9
	MOVLW	217
	BANKSEL	SSD1306SENDBYTE
	MOVWF	SSD1306SENDBYTE,BANKED
	BANKSEL	0
	CALL	WRITE_COMMAND_SSD1306
;'IF SSD1306_VCCSTATE = SSD1306_EXTERNALVCC THEN
;'WRITE_COMMAND_SSD1306(0XF1)
	MOVLW	241
	BANKSEL	SSD1306SENDBYTE
	MOVWF	SSD1306SENDBYTE,BANKED
	BANKSEL	0
	CALL	WRITE_COMMAND_SSD1306
;'END IF
;'WRITE_COMMAND_SSD1306(SSD1306_SETVCOMDETECT)                 ' 0XDB
	MOVLW	219
	BANKSEL	SSD1306SENDBYTE
	MOVWF	SSD1306SENDBYTE,BANKED
	BANKSEL	0
	CALL	WRITE_COMMAND_SSD1306
;'WRITE_COMMAND_SSD1306(0X40)
	MOVLW	64
	BANKSEL	SSD1306SENDBYTE
	MOVWF	SSD1306SENDBYTE,BANKED
	BANKSEL	0
	CALL	WRITE_COMMAND_SSD1306
;'WRITE_COMMAND_SSD1306(SSD1306_DISPLAYALLON_RESUME)           ' 0XA4
	MOVLW	164
	BANKSEL	SSD1306SENDBYTE
	MOVWF	SSD1306SENDBYTE,BANKED
	BANKSEL	0
	CALL	WRITE_COMMAND_SSD1306
;'WRITE_COMMAND_SSD1306(SSD1306_NORMALDISPLAY)                 ' 0XA6
	MOVLW	166
	BANKSEL	SSD1306SENDBYTE
	MOVWF	SSD1306SENDBYTE,BANKED
	BANKSEL	0
	CALL	WRITE_COMMAND_SSD1306
;'CLEAR SCREEN HERE
;'GLCDCLS_SSD1306
	RCALL	GLCDCLS_SSD1306
;'WRITE_COMMAND_SSD1306(SSD1306_DISPLAYON)                     '--TURN ON OLED PANEL
	MOVLW	175
	BANKSEL	SSD1306SENDBYTE
	MOVWF	SSD1306SENDBYTE,BANKED
	BANKSEL	0
	GOTO	WRITE_COMMAND_SSD1306

;'********************************************************************************

;'SOURCE: 190_I2C_GLCD_USING_SSD1306_128_64.GCB (33)
GLOBAL	INITPPS
INITPPS:
;'MODULE: I2C1
;'RB6PPS = 0X001C    // SCL1 > RB6
	MOVLW	28
	BANKSEL	RB6PPS
	MOVWF	RB6PPS,BANKED
;'I2C1SCLPPS = 0X000E    // RB6 > SCL1 (BI-DIRECTIONAL)
	MOVLW	14
	MOVWF	I2C1SCLPPS,BANKED
;'RB5PPS = 0X001D    // SDA1 > RB5
	MOVLW	29
	MOVWF	RB5PPS,BANKED
;'I2C1SDAPPS = 0X000D    // RB5 > SDA1 (BI-DIRECTIONAL)
	MOVLW	13
	MOVWF	I2C1SDAPPS,BANKED
;'MODULE: UART PIN DIRECTIONS
;'DIR PORTB.7 OUT    // MAKE TX1 PIN AN OUTPUT
	BCF	TRISB,7,ACCESS
;'MODULE: UART1
;'RB7PPS = 0X0013    // TX1 > RB7
	MOVLW	19
	MOVWF	RB7PPS,BANKED
	BANKSEL	0
	RETURN

;'********************************************************************************

;'SOURCE: SYSTEM.H (177)
GLOBAL	INITSYS
INITSYS:
;'CLEAR BSR
;'MOVLB 0
	MOVLB	0
;'ASM SHOWDEBUG DEFAULT SETTINGS FOR MICROCONTROLLERS WITH _OSCCON1_
	;DEFAULT	OSCCON1,NOSC HFINTOSC; NDIV 1 - COMMON AS THIS SIMPLY SETS THE HFINTOSC
;'OSCCON1 = 0X60
	MOVLW	96
	MOVWF	OSCCON1,BANKED
;'DEFAULT VALUE TYPICALLY, CSWHOLD MAY PROCEED; SOSCPWR LOW POWER
;'OSCCON3 = 0X00
	CLRF	OSCCON3,BANKED
;'DEFAULT VALUE TYPICALLY, MFOEN DISABLED; LFOEN DISABLED; ADOEN DISABLED; SOSCEN DISABLED; EXTOEN DISABLED; HFOEN DISABLED
;'OSCEN = 0X00
	CLRF	OSCEN,BANKED
;'DEFAULT VALUE
;'OSCTUNE = 0X00
	CLRF	OSCTUNE,BANKED
;'ASM SHOWDEBUG THE MCU IS A CHIP FAMILY 16
;'SECTION SUPPORTS MANY MCUS, 18FXXK40, 18FXXK42 ETC THAT HAVE NDIV3 BIT
;'ASM SHOWDEBUG OSCCON TYPE IS 101
;'OSCCON1 = 0X60          // SETTING OSCCON1 IMPLIES CLEARING CLEAR NDIV3:0
	MOVLW	96
	MOVWF	OSCCON1,BANKED
;'OSCFRQ = 0B00001000  '64MHZ
	MOVLW	8
	MOVWF	OSCFRQ,BANKED
;'ASM SHOWDEBUG _COMPLETE_THE_CHIP_SETUP_OF_BSR_ADCS_ANSEL_AND_OTHER_KEY_SETUP_REGISTERS_OR_REGISTER_BITS
;'CLEAR TBLPTRU
;'TBLPTRU = 0
	CLRF	TBLPTRU,ACCESS
;'ENSURE ALL PORTS ARE SET FOR DIGITAL I/O AND, TURN OFF A/D
;'SET ADFM OFF
	BANKSEL	ADCON0
	BCF	ADCON0,2,BANKED
;'SWITCH OFF A/D VAR(ADCON0)
;'SET ADCON0.ADON OFF
	BCF	ADCON0,7,BANKED
;'ANSELA = 0
	BANKSEL	ANSELA
	CLRF	ANSELA,BANKED
;'ANSELB = 0
	CLRF	ANSELB,BANKED
;'ANSELC = 0
	CLRF	ANSELC,BANKED
;'TURN OFF ALL PORTS
;'PORTA = 0
	CLRF	PORTA,ACCESS
;'PORTB = 0
	CLRF	PORTB,ACCESS
;'PORTC = 0
	CLRF	PORTC,ACCESS
	BANKSEL	0
	RETURN

;'********************************************************************************

;'SOURCE: STRING.H (646)
GLOBAL	FN_PAD
FN_PAD:
;'CHECK LENGTH OF SYSINSTRING
;'IF SYSINSTRING(0) = LONGER OR EQUAL SYSSTRLEN THEN
;'GIVE BACK SYSINSTRING AND EXIT FUNCTION
;'IF SYSINSTRING(0) < SYSSTRLEN THEN
	MOVFF	SYSSYSINSTRINGHANDLER,FSR0
	MOVFF	SYSSYSINSTRINGHANDLER_H,FSR0H
	BANKSEL	SYSSTRLEN
	MOVF	SYSSTRLEN,W,BANKED
	SUBWF	INDF0,W,ACCESS
	BTFSC	STATUS,0,ACCESS
	BRA	ELSE42_1
;'SYSCHARCOUNT = SYSINSTRING(0)
	MOVFF	SYSSYSINSTRINGHANDLER,FSR0
	MOVFF	SYSSYSINSTRINGHANDLER_H,FSR0H
	MOVFF	INDF0,SYSCHARCOUNT
;'CLEAR OUTPUT STRING
;'PAD=""
	LFSR	1,PAD
	MOVLW	LOW STRINGTABLE81
	MOVWF	TBLPTR,ACCESS
	MOVLW	HIGH STRINGTABLE81
	MOVWF	TBLPTRH,ACCESS
	MOVLW	UPPER STRINGTABLE81
	MOVWF	TBLPTRU,ACCESS
	BANKSEL	0
	CALL	SYSREADSTRING
;'COPY LEFTMOST CHARACTERS
;'FOR SYSSTRINGTEMP = 1 TO SYSCHARCOUNT
	MOVLW	1
	BANKSEL	SYSSTRINGTEMP
	MOVWF	SYSSTRINGTEMP,BANKED
GLOBAL	SYSFORLOOP8
SYSFORLOOP8:
;'PAD(SYSSTRINGTEMP) = SYSINSTRING(SYSSTRINGTEMP)
	MOVF	SYSSTRINGTEMP,W,BANKED
	ADDWF	SYSSYSINSTRINGHANDLER,W,BANKED
	MOVWF	FSR0,ACCESS
	MOVLW	0
	ADDWFC	SYSSYSINSTRINGHANDLER_H,W,BANKED
	MOVWF	FSR0H,ACCESS
	MOVFF	POSTINC0,SYSARRAYTEMP1
	MOVFF	SYSARRAYTEMP1,SYSARRAYTEMP2
	LFSR	0,PAD
	MOVF	SYSSTRINGTEMP,W,BANKED
	ADDWF	FSR0,F,ACCESS
	MOVLW	0
	ADDWFC	FSR0H,F,ACCESS
	MOVFF	SYSARRAYTEMP2,POSTINC0
;'NEXT
;'POSITIVE VALUE STEP HANDLER IN FOR-NEXT STATEMENT :#4P 
	MOVF	SYSSTRINGTEMP,W,BANKED
	SUBWF	SYSCHARCOUNT,W,BANKED
	MOVWF	SYSTEMP3,BANKED
	MOVFF	SYSTEMP3,SYSBYTETEMPA
	CLRF	SYSBYTETEMPB,ACCESS
	BANKSEL	0
	RCALL	SYSCOMPEQUAL
	COMF	SYSBYTETEMPX,F,ACCESS
	BTFSS	SYSBYTETEMPX,0,ACCESS
	BRA	ENDIF43
;'SET LOOPVAR TO LOOPVAR + STEPVALUE WHERE STEPVALUE IS A POSITIVE VALUE
	BANKSEL	SYSSTRINGTEMP
	INCF	SYSSTRINGTEMP,F,BANKED
	BRA	SYSFORLOOP8
;'END IF
GLOBAL	ENDIF43
ENDIF43:
GLOBAL	SYSFORLOOPEND8
SYSFORLOOPEND8:
;'FOR SYSSTRINGTEMP = SYSCHARCOUNT+1 TO SYSSTRLEN
	BANKSEL	SYSCHARCOUNT
	INCF	SYSCHARCOUNT,W,BANKED
	MOVWF	SYSSTRINGTEMP,BANKED
GLOBAL	SYSFORLOOP9
SYSFORLOOP9:
;'PAD(SYSSTRINGTEMP) = SYSINSTRING3(1)
	MOVLW	1
	ADDWF	SYSSYSINSTRING3HANDLER,W,BANKED
	MOVWF	FSR0,ACCESS
	MOVLW	0
	ADDWFC	SYSSYSINSTRING3HANDLER_H,W,BANKED
	MOVWF	FSR0H,ACCESS
	MOVFF	POSTINC0,SYSARRAYTEMP2
	MOVFF	SYSARRAYTEMP2,SYSARRAYTEMP1
	LFSR	0,PAD
	MOVF	SYSSTRINGTEMP,W,BANKED
	ADDWF	FSR0,F,ACCESS
	MOVLW	0
	ADDWFC	FSR0H,F,ACCESS
	MOVFF	SYSARRAYTEMP1,POSTINC0
;'NEXT
;'POSITIVE VALUE STEP HANDLER IN FOR-NEXT STATEMENT :#4P 
	MOVF	SYSSTRINGTEMP,W,BANKED
	SUBWF	SYSSTRLEN,W,BANKED
	MOVWF	SYSTEMP3,BANKED
	MOVFF	SYSTEMP3,SYSBYTETEMPA
	CLRF	SYSBYTETEMPB,ACCESS
	BANKSEL	0
	RCALL	SYSCOMPEQUAL
	COMF	SYSBYTETEMPX,F,ACCESS
	BTFSS	SYSBYTETEMPX,0,ACCESS
	BRA	ENDIF44
;'SET LOOPVAR TO LOOPVAR + STEPVALUE WHERE STEPVALUE IS A POSITIVE VALUE
	BANKSEL	SYSSTRINGTEMP
	INCF	SYSSTRINGTEMP,F,BANKED
	BRA	SYSFORLOOP9
;'END IF
GLOBAL	ENDIF44
ENDIF44:
GLOBAL	SYSFORLOOPEND9
SYSFORLOOPEND9:
;'SET NEW LENGTH TO PAD
;'PAD(0) = SYSSTRLEN
	MOVFFL	SYSSTRLEN,SYSPAD_0
;'ELSE
	BRA	ENDIF42
GLOBAL	ELSE42_1
ELSE42_1:
;'SYSINSTRING IS EQUAL OR LONGER THAN SYSSTRLEN
;'GIVE BACK OLD STRING; COPY SYSINSTRING TO PAD
;'FOR SYSSTRINGTEMP = 1 TO SYSINSTRING(0)
	MOVLW	1
	MOVWF	SYSSTRINGTEMP,BANKED
GLOBAL	SYSFORLOOP10
SYSFORLOOP10:
;'PAD(SYSSTRINGTEMP) = SYSINSTRING(SYSSTRINGTEMP)
	MOVF	SYSSTRINGTEMP,W,BANKED
	ADDWF	SYSSYSINSTRINGHANDLER,W,BANKED
	MOVWF	FSR0,ACCESS
	MOVLW	0
	ADDWFC	SYSSYSINSTRINGHANDLER_H,W,BANKED
	MOVWF	FSR0H,ACCESS
	MOVFF	POSTINC0,SYSARRAYTEMP1
	MOVFF	SYSARRAYTEMP1,SYSARRAYTEMP2
	LFSR	0,PAD
	MOVF	SYSSTRINGTEMP,W,BANKED
	ADDWF	FSR0,F,ACCESS
	MOVLW	0
	ADDWFC	FSR0H,F,ACCESS
	MOVFF	SYSARRAYTEMP2,POSTINC0
;'NEXT
;'POSITIVE VALUE STEP HANDLER IN FOR-NEXT STATEMENT :#4P 
	MOVFF	SYSSYSINSTRINGHANDLER,FSR0
	MOVFF	SYSSYSINSTRINGHANDLER_H,FSR0H
	MOVF	SYSSTRINGTEMP,W,BANKED
	SUBWF	INDF0,W,ACCESS
	MOVWF	SYSTEMP3,BANKED
	MOVFF	SYSTEMP3,SYSBYTETEMPA
	CLRF	SYSBYTETEMPB,ACCESS
	BANKSEL	0
	RCALL	SYSCOMPEQUAL
	COMF	SYSBYTETEMPX,F,ACCESS
	BTFSS	SYSBYTETEMPX,0,ACCESS
	BRA	ENDIF45
;'SET LOOPVAR TO LOOPVAR + STEPVALUE WHERE STEPVALUE IS A POSITIVE VALUE
	BANKSEL	SYSSTRINGTEMP
	INCF	SYSSTRINGTEMP,F,BANKED
	BRA	SYSFORLOOP10
;'END IF
GLOBAL	ENDIF45
ENDIF45:
GLOBAL	SYSFORLOOPEND10
SYSFORLOOPEND10:
;'PAD(0) = SYSINSTRING(0)
	MOVFF	SYSSYSINSTRINGHANDLER,FSR0
	MOVFF	SYSSYSINSTRINGHANDLER_H,FSR0H
	MOVFF	POSTINC0,SYSARRAYTEMP1
	MOVFFL	SYSARRAYTEMP1,SYSPAD_0
;'END IF
GLOBAL	ENDIF42
ENDIF42:
	RETURN

;'********************************************************************************

;'SOURCE: GLCD_SSD1306.H (898)
GLOBAL	PSET_SSD1306
PSET_SSD1306:
;'SET PIXEL AT X, Y ON LCD TO STATE
;'X IS 0 TO 127
;'Y IS 0 TO 63
;'ORIGIN IN TOP LEFT
;'ANYTHING OFF SCREEN WITH BE REJECTED
;'IF GLCDX => GLCD_WIDTH OR GLCDY => GLCD_HEIGHT THEN
	MOVFF	GLCDX,SYSBYTETEMPA
	MOVLW	128
	MOVWF	SYSBYTETEMPB,ACCESS
	RCALL	SYSCOMPLESSTHAN
	COMF	SYSBYTETEMPX,F,ACCESS
	MOVFF	SYSBYTETEMPX,SYSTEMP3
	MOVFF	GLCDY,SYSBYTETEMPA
	MOVLW	64
	MOVWF	SYSBYTETEMPB,ACCESS
	RCALL	SYSCOMPLESSTHAN
	COMF	SYSBYTETEMPX,F,ACCESS
	BANKSEL	SYSTEMP3
	MOVF	SYSTEMP3,W,BANKED
	IORWF	SYSBYTETEMPX,W,ACCESS
	MOVWF	SYSTEMP1,BANKED
	BTFSS	SYSTEMP1,0,BANKED
	BRA	ENDIF62
;'EXIT SUB
	BANKSEL	0
	RETURN
;'END IF
GLOBAL	ENDIF62
ENDIF62:
;'1.14 ADDRESSES CORRECT DEVICE HORIZONAL PAGE
;'DON'T NEED TO DO THESE CALCULATIONS FOR IN LOWMEMORY_GLCD_MODE
;'SSD1306_BUFFERLOCATIONCALC = ( GLCDY / 8 )* GLCD_WIDTH
;'FASTER THAN /8
;'SSD1306_BUFFERLOCATIONCALC = GLCDY
	MOVFF	GLCDY,SSD1306_BUFFERLOCATIONCALC
	CLRF	SSD1306_BUFFERLOCATIONCALC_H,BANKED
;'REPEAT 3
	MOVLW	3
	MOVWF	SYSREPEATTEMP1,BANKED
GLOBAL	SYSREPEATLOOP1
SYSREPEATLOOP1:
;'SET C OFF
	BCF	STATUS,0,ACCESS
;'ROTATE SSD1306_BUFFERLOCATIONCALC RIGHT
	RRCF	SSD1306_BUFFERLOCATIONCALC_H,F,BANKED
	RRCF	SSD1306_BUFFERLOCATIONCALC,F,BANKED
;'END REPEAT
	DECFSZ	SYSREPEATTEMP1,F,BANKED
	BRA	SYSREPEATLOOP1
GLOBAL	SYSREPEATLOOPEND1
SYSREPEATLOOPEND1:
;'FASTER THAN * 128
;'SET C OFF
	BCF	STATUS,0,ACCESS
;'REPEAT 7
	MOVLW	7
	MOVWF	SYSREPEATTEMP1,BANKED
GLOBAL	SYSREPEATLOOP2
SYSREPEATLOOP2:
;'ROTATE SSD1306_BUFFERLOCATIONCALC LEFT
	RLCF	SSD1306_BUFFERLOCATIONCALC,F,BANKED
	RLCF	SSD1306_BUFFERLOCATIONCALC_H,F,BANKED
;'END REPEAT
	DECFSZ	SYSREPEATTEMP1,F,BANKED
	BRA	SYSREPEATLOOP2
GLOBAL	SYSREPEATLOOPEND2
SYSREPEATLOOPEND2:
;'SSD1306_BUFFERLOCATIONCALC = GLCDX + SSD1306_BUFFERLOCATIONCALC + 1
	MOVF	SSD1306_BUFFERLOCATIONCALC,W,BANKED
	ADDWF	GLCDX,W,ACCESS
	MOVWF	SYSTEMP1,BANKED
	CLRF	SYSTEMP3,BANKED
	MOVF	SSD1306_BUFFERLOCATIONCALC_H,W,BANKED
	ADDWFC	SYSTEMP3,W,BANKED
	MOVWF	SYSTEMP1_H,BANKED
	MOVLW	1
	ADDWF	SYSTEMP1,W,BANKED
	MOVWF	SSD1306_BUFFERLOCATIONCALC,BANKED
	MOVLW	0
	ADDWFC	SYSTEMP1_H,W,BANKED
	MOVWF	SSD1306_BUFFERLOCATIONCALC_H,BANKED
;'ANYTHING BEYOND BUFFER BOUNDARY?
;'WHY? X = 127 AND Y = 64 (Y IS OVER 63!) WILL HAVE PASSED FIRST CHECK....
;'IF SSD1306_BUFFERLOCATIONCALC > GLCD_HEIGHT * GLCD_WIDTH THEN
	MOVFF	SSD1306_BUFFERLOCATIONCALC,SYSWORDTEMPB
	MOVFF	SSD1306_BUFFERLOCATIONCALC_H,SYSWORDTEMPB_H
	CLRF	SYSWORDTEMPA,ACCESS
	MOVLW	32
	MOVWF	SYSWORDTEMPA_H,ACCESS
	BANKSEL	0
	RCALL	SYSCOMPLESSTHAN16
	BTFSC	SYSBYTETEMPX,0,ACCESS
;'EXIT SUB
	RETURN
;'END IF
;'GLCDDATATEMP = SSD1306_BUFFERALIAS(SSD1306_BUFFERLOCATIONCALC)
	LFSR	0,SSD1306_BUFFERALIAS
	BANKSEL	SSD1306_BUFFERLOCATIONCALC
	MOVF	SSD1306_BUFFERLOCATIONCALC,W,BANKED
	ADDWF	FSR0,F,ACCESS
	MOVF	SSD1306_BUFFERLOCATIONCALC_H,W,BANKED
	ADDWFC	FSR0H,F,ACCESS
	MOVFF	INDF0,GLCDDATATEMP
;'CHANGE DATA TO SET/CLEAR PIXEL
;'GLCDBITNO = GLCDY AND 7
	MOVLW	7
	ANDWF	GLCDY,W,ACCESS
	MOVWF	GLCDBITNO,ACCESS
;'IF GLCDCOLOUR.0 = 0 THEN
	BTFSC	GLCDCOLOUR,0,ACCESS
	BRA	ELSE64_1
;'GLCDCHANGE = 254
	MOVLW	254
	MOVWF	GLCDCHANGE,ACCESS
;'SET C ON
	BSF	STATUS,0,ACCESS
;'ELSE
	BRA	ENDIF64
GLOBAL	ELSE64_1
ELSE64_1:
;'GLCDCHANGE = 1
	MOVLW	1
	MOVWF	GLCDCHANGE,ACCESS
;'SET C OFF
	BCF	STATUS,0,ACCESS
;'END IF
GLOBAL	ENDIF64
ENDIF64:
;'REPEAT GLCDBITNO
	MOVFF	GLCDBITNO,SYSREPEATTEMP1
	MOVF	SYSREPEATTEMP1,F,BANKED
	BTFSC	STATUS,2,ACCESS
	BRA	SYSREPEATLOOPEND3
GLOBAL	SYSREPEATLOOP3
SYSREPEATLOOP3:
;'ROTATE GLCDCHANGE LEFT
	RLCF	GLCDCHANGE,F,ACCESS
;'END REPEAT
	DECFSZ	SYSREPEATTEMP1,F,BANKED
	BRA	SYSREPEATLOOP3
GLOBAL	SYSREPEATLOOPEND3
SYSREPEATLOOPEND3:
;'IF GLCDCOLOUR.0 = 0 THEN
	BTFSC	GLCDCOLOUR,0,ACCESS
	BRA	ELSE65_1
;'GLCDDATATEMP = GLCDDATATEMP AND GLCDCHANGE
	MOVF	GLCDDATATEMP,W,ACCESS
	ANDWF	GLCDCHANGE,W,ACCESS
	MOVWF	GLCDDATATEMP,ACCESS
;'ELSE
	BRA	ENDIF65
GLOBAL	ELSE65_1
ELSE65_1:
;'GLCDDATATEMP = GLCDDATATEMP OR GLCDCHANGE
	MOVF	GLCDDATATEMP,W,ACCESS
	IORWF	GLCDCHANGE,W,ACCESS
	MOVWF	GLCDDATATEMP,ACCESS
;'END IF
GLOBAL	ENDIF65
ENDIF65:
;'ADDED 1.14 TO ISOLATE FROM FULL GLCD MODE
;'REVISED 1.14 TO ISOLATE FROM LOW MEMORY MODE
;'IF SSD1306_BUFFERALIAS(SSD1306_BUFFERLOCATIONCALC) <> GLCDDATATEMP THEN
	LFSR	0,SSD1306_BUFFERALIAS
	MOVF	SSD1306_BUFFERLOCATIONCALC,W,BANKED
	ADDWF	FSR0,F,ACCESS
	MOVF	SSD1306_BUFFERLOCATIONCALC_H,W,BANKED
	ADDWFC	FSR0H,F,ACCESS
	MOVF	GLCDDATATEMP,W,ACCESS
	SUBWF	INDF0,W,ACCESS
	BTFSC	STATUS,2,ACCESS
	BRA	ENDIF66
;'SSD1306_BUFFERALIAS(SSD1306_BUFFERLOCATIONCALC) = GLCDDATATEMP
	LFSR	0,SSD1306_BUFFERALIAS
	MOVF	SSD1306_BUFFERLOCATIONCALC,W,BANKED
	ADDWF	FSR0,F,ACCESS
	MOVF	SSD1306_BUFFERLOCATIONCALC_H,W,BANKED
	ADDWFC	FSR0H,F,ACCESS
	MOVFF	GLCDDATATEMP,INDF0
;'CURSOR_POSITION_SSD1306 ( GLCDX, GLCDY )
	MOVFF	GLCDX,LOCX
	MOVFF	GLCDY,LOCY
	BANKSEL	0
	CALL	CURSOR_POSITION_SSD1306
;'WRITE_DATA_SSD1306 ( GLCDDATATEMP )
	MOVFF	GLCDDATATEMP,SSD1306SENDBYTE
	RCALL	WRITE_DATA_SSD1306
;'END IF
GLOBAL	ENDIF66
ENDIF66:
	BANKSEL	0
	RETURN

;'********************************************************************************

;'SOURCE: HWI2C.H (802)
GLOBAL	SI2CINIT
SI2CINIT:
;'ASM SHOWDEBUG  THIS METHOD SETS THE MSSP MODULES FOR K-MODE FAMILY CHIPS
;'DIR HI2C_DATA OUT
	BCF	TRISB,5,ACCESS
;'DIR HI2C_CLOCK OUT
	BCF	TRISB,6,ACCESS
;'I2C1CON1 = I2C1I2C1CON1DEFAULT
	MOVLW	128
	BANKSEL	I2C1CON1
	MOVWF	I2C1CON1,BANKED
;'I2C1CON2 = I2C1I2C1CON2DEFAULT
	MOVLW	33
	MOVWF	I2C1CON2,BANKED
;'I2C1CLK =  I2C1CLOCKSOURCE
	MOVLW	3
	MOVWF	I2C1CLK,BANKED
;'I2C1CON0 = I2C1I2C1CON0DEFAULT
	MOVLW	132
	MOVWF	I2C1CON0,BANKED
;'I2C1PIR = 0    ;CLEAR ALL THE ERROR FLAGS
	CLRF	I2C1PIR,BANKED
;'I2C1ERR = 0
	CLRF	I2C1ERR,BANKED
;'I2C1CON0.EN=1
	BSF	I2C1CON0,7,BANKED
;'COMMENCE I2C PROTOCOL
;'I2C1CON2.ACNT = 0
	BCF	I2C1CON2,7,BANKED
;'I2C1CON2.ABD=0
	BCF	I2C1CON2,4,BANKED
;'I2C1CON0.MDR=1
	BSF	I2C1CON0,3,BANKED
;'INITIALISE CORRECT STATE OF I2C MODULE. NOT SURE WHY THIS IS NEEDED BUT IT IS. MICROCHIP FAILED TO EXPLAIN WHY THIS IS REQUIRED. BUT, IT IS.
;'SI2CSTART
	BANKSEL	0
	RCALL	SI2CSTART
;'SI2CSEND ( 0XFF )
	SETF	I2CBYTE,ACCESS
	RCALL	SI2CSEND
;'SI2CSTOP
	RCALL	SI2CSTOP
;'HI2CCURRENTMODE = 0
	CLRF	HI2CCURRENTMODE,ACCESS
	RETURN

;'********************************************************************************

;'SOURCE: HWI2C.H (879)
GLOBAL	SI2CSEND
SI2CSEND:
;'ASM SHOWDEBUG  REDIRECTED FOR K-MODE FAMILY PROBALBY CALLED HI2CSEND
;'ASM SHOWDEBUG  THIS METHOD SETS THE REGISTERS AND REGISTER BITS TO SEND I2C DATA
;'THIS IS NOW A STATE MACHINE TO CATER FOR THE NEW APPROACH WITH THE I2C MODULE
;'SELECT CASE HI2C1STATEMACHINE
;'CASE 2  'SEND DATA
GLOBAL	SYSSELECT2CASE1
SYSSELECT2CASE1:
	MOVLW	2
	SUBWF	HI2C1STATEMACHINE,W,ACCESS
	BTFSS	STATUS,2,ACCESS
	BRA	SYSSELECT2CASE2
;'HI2CWAITMSSPTIMEOUT = 0
	CLRF	HI2CWAITMSSPTIMEOUT,ACCESS
;'WAITS UP TO 254US THEN CREATES ERROR MESSAGE
;'DO WHILE HI2CWAITMSSPTIMEOUT < 255
GLOBAL	SYSDOLOOP_S10
SYSDOLOOP_S10:
	MOVLW	255
	SUBWF	HI2CWAITMSSPTIMEOUT,W,ACCESS
	BTFSC	STATUS,0,ACCESS
	BRA	SYSDOLOOP_E10
;'HI2CWAITMSSPTIMEOUT++
	INCF	HI2CWAITMSSPTIMEOUT,F,ACCESS
;'WAIT FOR THIS EVENT
;'IF I2C1STAT1.TXBE = 1 THEN
	BANKSEL	I2C1STAT1
	BTFSS	I2C1STAT1,5,BANKED
	BRA	ELSE71_1
;'SET THE BYTE COUNT TO 1, PLACE OUTBYTE IN REGISTER, AND WAIT FOR HARDWARE STATE MACHINE
;'I2C1CNT = 1
	MOVLW	1
	MOVWF	I2C1CNT,BANKED
;'I2C1TXB = I2CBYTE
	MOVFF	I2CBYTE,I2C1TXB
;'SI2CWAIT4ACK
	BANKSEL	0
	RCALL	SI2CWAIT4ACK
;'SI2CWAIT4MDR
	RCALL	SI2CWAIT4MDR
;'EXIT SUB
	RETURN
;'ELSE
	BRA	ENDIF71
GLOBAL	ELSE71_1
ELSE71_1:
;'WAIT 1 US
	MOVLW	5
	MOVWF	DELAYTEMP,ACCESS
GLOBAL	DELAYUS4
DELAYUS4:
	DECFSZ	DELAYTEMP,F,ACCESS
	BRA	DELAYUS4
;'END IF
GLOBAL	ENDIF71
ENDIF71:
;'LOOP
	BRA	SYSDOLOOP_S10
GLOBAL	SYSDOLOOP_E10
SYSDOLOOP_E10:
;'IF HI2CWAITMSSPTIMEOUT = 255 THEN HI2C1LASTERROR = HI2C1LASTERROR OR I2C1_TXBE_TIMEOUT
	INCF	HI2CWAITMSSPTIMEOUT,W,ACCESS
	BTFSS	STATUS,2,ACCESS
	BRA	ENDIF72
;'IF HI2CWAITMSSPTIMEOUT = 255 THEN HI2C1LASTERROR = HI2C1LASTERROR OR I2C1_TXBE_TIMEOUT
	MOVLW	2
	IORWF	HI2C1LASTERROR,F,ACCESS
;'IF HI2CWAITMSSPTIMEOUT = 255 THEN HI2C1LASTERROR = HI2C1LASTERROR OR I2C1_TXBE_TIMEOUT
GLOBAL	ENDIF72
ENDIF72:
;'CASE 1  'A START
	BRA	SYSSELECTEND2
GLOBAL	SYSSELECT2CASE2
SYSSELECT2CASE2:
	DECF	HI2C1STATEMACHINE,W,ACCESS
	BTFSS	STATUS,2,ACCESS
	BRA	SYSSELECT2CASE3
;'CLEAR THE OUTPUT BUFFERS, SET BYTE COUNT TO ZERO, CLEAR EVENT AND PLACE SLAVE ADDRESS IN REGISTER
;'I2C1STAT1.CLRBF = 1
	BANKSEL	I2C1STAT1
	BSF	I2C1STAT1,2,BANKED
;'I2C1CNT = 0
	CLRF	I2C1CNT,BANKED
;'I2C1PIR.SCIF = 0
	BCF	I2C1PIR,0,BANKED
;'I2C1ADB1 = I2CBYTE
	MOVFF	I2CBYTE,I2C1ADB1
;'WAIT HI2CITSCLWAITPERIOD US
	MOVLW	2
	MOVWF	DELAYTEMP2,ACCESS
GLOBAL	DELAYUSO5
DELAYUSO5:
	CLRF	DELAYTEMP,ACCESS
GLOBAL	DELAYUS5
DELAYUS5:
	DECFSZ	DELAYTEMP,F,ACCESS
	BRA	DELAYUS5
	DECFSZ	DELAYTEMP2,F,ACCESS
	BRA	DELAYUSO5
	MOVLW	19
	MOVWF	DELAYTEMP,ACCESS
GLOBAL	DELAYUS6
DELAYUS6:
	DECFSZ	DELAYTEMP,F,ACCESS
	BRA	DELAYUS6
;'HI2CWAITMSSPTIMEOUT = 0
	CLRF	HI2CWAITMSSPTIMEOUT,ACCESS
;'WAITS UP TO 254US THEN CREATES ERROR MESSAGE
;'DO WHILE HI2CWAITMSSPTIMEOUT < 255
GLOBAL	SYSDOLOOP_S11
SYSDOLOOP_S11:
	MOVLW	255
	SUBWF	HI2CWAITMSSPTIMEOUT,W,ACCESS
	BTFSC	STATUS,0,ACCESS
	BRA	SYSDOLOOP_E11
;'HI2CWAITMSSPTIMEOUT++
	INCF	HI2CWAITMSSPTIMEOUT,F,ACCESS
;'WAIT FOR THIS EVENT
;'IF I2C1PIR.SCIF = 1 THEN
	BTFSS	I2C1PIR,0,BANKED
	BRA	ELSE73_1
;'WAIT HI2CITSCLWAITPERIOD US
	MOVLW	2
	MOVWF	DELAYTEMP2,ACCESS
GLOBAL	DELAYUSO7
DELAYUSO7:
	CLRF	DELAYTEMP,ACCESS
GLOBAL	DELAYUS7
DELAYUS7:
	DECFSZ	DELAYTEMP,F,ACCESS
	BRA	DELAYUS7
	DECFSZ	DELAYTEMP2,F,ACCESS
	BRA	DELAYUSO7
	MOVLW	19
	MOVWF	DELAYTEMP,ACCESS
GLOBAL	DELAYUS8
DELAYUS8:
	DECFSZ	DELAYTEMP,F,ACCESS
	BRA	DELAYUS8
;'HI2C1STATEMACHINE = 2  'SET STATE MACHINE TO SEND DATA
	MOVLW	2
	MOVWF	HI2C1STATEMACHINE,ACCESS
;'HI2CACKPOLLSTATE = I2C1CON1.5
	CLRF	HI2CACKPOLLSTATE,ACCESS
	BTFSC	I2C1CON1,5,BANKED
	INCF	HI2CACKPOLLSTATE,F,ACCESS
;'EXIT SUB
	BANKSEL	0
	RETURN
;'ELSE
	BRA	ENDIF73
GLOBAL	ELSE73_1
ELSE73_1:
;'WAIT HI2CITSCLWAITPERIOD US
	MOVLW	2
	MOVWF	DELAYTEMP2,ACCESS
GLOBAL	DELAYUSO9
DELAYUSO9:
	CLRF	DELAYTEMP,ACCESS
GLOBAL	DELAYUS9
DELAYUS9:
	DECFSZ	DELAYTEMP,F,ACCESS
	BRA	DELAYUS9
	DECFSZ	DELAYTEMP2,F,ACCESS
	BRA	DELAYUSO9
	MOVLW	19
	MOVWF	DELAYTEMP,ACCESS
GLOBAL	DELAYUS10
DELAYUS10:
	DECFSZ	DELAYTEMP,F,ACCESS
	BRA	DELAYUS10
;'SET TO START
;'I2C1CON0.S = 1
	BSF	I2C1CON0,5,BANKED
;'END IF
GLOBAL	ENDIF73
ENDIF73:
;'LOOP
	BRA	SYSDOLOOP_S11
GLOBAL	SYSDOLOOP_E11
SYSDOLOOP_E11:
;'IF HI2CWAITMSSPTIMEOUT = 255 THEN HI2C1LASTERROR = HI2C1LASTERROR OR I2C1_START_TIMEOUT
	INCF	HI2CWAITMSSPTIMEOUT,W,ACCESS
	BTFSS	STATUS,2,ACCESS
	BRA	ENDIF74
;'IF HI2CWAITMSSPTIMEOUT = 255 THEN HI2C1LASTERROR = HI2C1LASTERROR OR I2C1_START_TIMEOUT
	MOVLW	4
	IORWF	HI2C1LASTERROR,F,ACCESS
;'IF HI2CWAITMSSPTIMEOUT = 255 THEN HI2C1LASTERROR = HI2C1LASTERROR OR I2C1_START_TIMEOUT
GLOBAL	ENDIF74
ENDIF74:
;'CASE 3  'A RESTART
	BRA	SYSSELECTEND2
GLOBAL	SYSSELECT2CASE3
SYSSELECT2CASE3:
	MOVLW	3
	SUBWF	HI2C1STATEMACHINE,W,ACCESS
	BTFSS	STATUS,2,ACCESS
	BRA	SYSSELECTEND2
;'WAIT FOR HARDWARE MACHINE TO SETTLE
;'WAIT WHILE I2C1STAT0.MMA = 1
GLOBAL	SYSWAITLOOP1
SYSWAITLOOP1:
	BANKSEL	I2C1STAT0
	BTFSC	I2C1STAT0,5,BANKED
	BRA	SYSWAITLOOP1
;'SET COUNT TO ZERO, PLACE SLAVE ADDRESS IN REGISTER AND CLEAR EVENT
;'I2C1CNT = 0
	CLRF	I2C1CNT,BANKED
;'I2C1ADB1 = I2CBYTE
	MOVFF	I2CBYTE,I2C1ADB1
;'I2C1PIR.SCIF = 0
	BCF	I2C1PIR,0,BANKED
;'HI2CWAITMSSPTIMEOUT = 0
	CLRF	HI2CWAITMSSPTIMEOUT,ACCESS
;'WAITS UP TO 254US THEN CREATES ERROR MESSAGE
;'DO WHILE HI2CWAITMSSPTIMEOUT < 255
GLOBAL	SYSDOLOOP_S12
SYSDOLOOP_S12:
	MOVLW	255
	SUBWF	HI2CWAITMSSPTIMEOUT,W,ACCESS
	BTFSC	STATUS,0,ACCESS
	BRA	SYSDOLOOP_E12
;'HI2CWAITMSSPTIMEOUT++
	INCF	HI2CWAITMSSPTIMEOUT,F,ACCESS
;'WAIT FOR THIS EVENT
;'IF I2C1PIR.SCIF = 1 THEN
	BTFSS	I2C1PIR,0,BANKED
	BRA	ELSE75_1
;'HI2C1STATEMACHINE = 2  'SET STATE MACHINE TO SEND DATA
	MOVLW	2
	MOVWF	HI2C1STATEMACHINE,ACCESS
;'HI2CACKPOLLSTATE = I2C1CON1.5
	CLRF	HI2CACKPOLLSTATE,ACCESS
	BTFSC	I2C1CON1,5,BANKED
	INCF	HI2CACKPOLLSTATE,F,ACCESS
;'EXIT SUB
	BANKSEL	0
	RETURN
;'ELSE
	BRA	ENDIF75
GLOBAL	ELSE75_1
ELSE75_1:
;'SET AS START AND CLEAR RESTART
;'I2C1CON0.S = 1
	BSF	I2C1CON0,5,BANKED
;'I2C1CON0.RSEN=0
	BCF	I2C1CON0,6,BANKED
;'WAIT 1 US
	MOVLW	5
	MOVWF	DELAYTEMP,ACCESS
GLOBAL	DELAYUS11
DELAYUS11:
	DECFSZ	DELAYTEMP,F,ACCESS
	BRA	DELAYUS11
;'END IF
GLOBAL	ENDIF75
ENDIF75:
;'LOOP
	BRA	SYSDOLOOP_S12
GLOBAL	SYSDOLOOP_E12
SYSDOLOOP_E12:
;'IF HI2CWAITMSSPTIMEOUT = 255 THEN HI2C1LASTERROR = HI2C1LASTERROR OR I2C1_RESTART_TIMEOUT
	INCF	HI2CWAITMSSPTIMEOUT,W,ACCESS
	BTFSS	STATUS,2,ACCESS
	BRA	ENDIF76
;'IF HI2CWAITMSSPTIMEOUT = 255 THEN HI2C1LASTERROR = HI2C1LASTERROR OR I2C1_RESTART_TIMEOUT
	MOVLW	8
	IORWF	HI2C1LASTERROR,F,ACCESS
;'IF HI2CWAITMSSPTIMEOUT = 255 THEN HI2C1LASTERROR = HI2C1LASTERROR OR I2C1_RESTART_TIMEOUT
GLOBAL	ENDIF76
ENDIF76:
;'END SELECT
GLOBAL	SYSSELECTEND2
SYSSELECTEND2:
	BANKSEL	0
	RETURN

;'********************************************************************************

;'SOURCE: HWI2C.H (831)
GLOBAL	SI2CSTART
SI2CSTART:
;'ASM SHOWDEBUG  REDIRECTED FOR K-MODE FAMILY PROBALBY CALLED HI2CSTART
;'ASM SHOWDEBUG  THIS METHOD SETS THE REGISTERS AND REGISTER BITS TO GENERATE THE I2C  START SIGNAL. MASTER_MODE ONLY.
;'HI2C1STATEMACHINE = 1
	MOVLW	1
	MOVWF	HI2C1STATEMACHINE,ACCESS
;'HI2CWAITMSSPTIMEOUT = FALSE
	CLRF	HI2CWAITMSSPTIMEOUT,ACCESS
;'CLEAR THE ERROR STATE VARIABLE
;'HI2C1LASTERROR = I2C1_GOOD
	CLRF	HI2C1LASTERROR,ACCESS
	RETURN

;'********************************************************************************

;'SOURCE: HWI2C.H (850)
GLOBAL	SI2CSTOP
SI2CSTOP:
;'ASM SHOWDEBUG  REDIRECTED FOR K-MODE FAMILY PROBALBY CALLED HI2CSTOP
;'ASM SHOWDEBUG  THIS METHOD SETS THE REGISTERS AND REGISTER BITS TO GENERATE THE I2C  STOP SIGNAL
;'WAITS UP TO 254US THEN SET THE ERROR STATE
;'HI2C1STATEMACHINE = 0
	CLRF	HI2C1STATEMACHINE,ACCESS
;'HI2CWAITMSSPTIMEOUT = 0
	CLRF	HI2CWAITMSSPTIMEOUT,ACCESS
;'DO WHILE HI2CWAITMSSPTIMEOUT < 255
GLOBAL	SYSDOLOOP_S9
SYSDOLOOP_S9:
	MOVLW	255
	SUBWF	HI2CWAITMSSPTIMEOUT,W,ACCESS
	BTFSC	STATUS,0,ACCESS
	BRA	SYSDOLOOP_E9
;'HI2CWAITMSSPTIMEOUT++
	INCF	HI2CWAITMSSPTIMEOUT,F,ACCESS
;'WAIT TILL THIS EVENT
;'IF I2C1PIR.PCIF = 1 THEN
	BANKSEL	I2C1PIR
	BTFSS	I2C1PIR,2,BANKED
	BRA	ELSE69_1
;'SI2CWAIT4STOP
	BANKSEL	0
	RCALL	SI2CWAIT4STOP
;'TSCL WAIT, PART OF THE SPECIFICIATION OF THE I2C MODULE
;'WAIT HI2CITSCLWAITPERIOD US
	MOVLW	2
	MOVWF	DELAYTEMP2,ACCESS
GLOBAL	DELAYUSO1
DELAYUSO1:
	CLRF	DELAYTEMP,ACCESS
GLOBAL	DELAYUS1
DELAYUS1:
	DECFSZ	DELAYTEMP,F,ACCESS
	BRA	DELAYUS1
	DECFSZ	DELAYTEMP2,F,ACCESS
	BRA	DELAYUSO1
	MOVLW	19
	MOVWF	DELAYTEMP,ACCESS
GLOBAL	DELAYUS2
DELAYUS2:
	DECFSZ	DELAYTEMP,F,ACCESS
	BRA	DELAYUS2
;'EXIT SUB
	RETURN
;'ELSE
	BRA	ENDIF69
GLOBAL	ELSE69_1
ELSE69_1:
;'WAIT 1 US
	MOVLW	5
	MOVWF	DELAYTEMP,ACCESS
GLOBAL	DELAYUS3
DELAYUS3:
	DECFSZ	DELAYTEMP,F,ACCESS
	BRA	DELAYUS3
;'END IF
GLOBAL	ENDIF69
ENDIF69:
;'LOOP
	BRA	SYSDOLOOP_S9
GLOBAL	SYSDOLOOP_E9
SYSDOLOOP_E9:
;'IF HI2CWAITMSSPTIMEOUT = 255 THEN HI2C1LASTERROR = HI2C1LASTERROR OR I2C1_STOP_TIMEOUT
	INCF	HI2CWAITMSSPTIMEOUT,W,ACCESS
	BTFSS	STATUS,2,ACCESS
	BRA	ENDIF70
;'IF HI2CWAITMSSPTIMEOUT = 255 THEN HI2C1LASTERROR = HI2C1LASTERROR OR I2C1_STOP_TIMEOUT
	MOVLW	128
	IORWF	HI2C1LASTERROR,F,ACCESS
;'IF HI2CWAITMSSPTIMEOUT = 255 THEN HI2C1LASTERROR = HI2C1LASTERROR OR I2C1_STOP_TIMEOUT
GLOBAL	ENDIF70
ENDIF70:
	BANKSEL	0
	RETURN

;'********************************************************************************

;'SOURCE: HWI2C.H (1012)
GLOBAL	SI2CWAIT4ACK
SI2CWAIT4ACK:
;'HI2CWAITMSSPTIMEOUT = 0
	CLRF	HI2CWAITMSSPTIMEOUT,ACCESS
;'WAITS UP TO 254US THEN CREATES ERROR MESSAGE
;'DO WHILE HI2CWAITMSSPTIMEOUT < 255
GLOBAL	SYSDOLOOP_S13
SYSDOLOOP_S13:
	MOVLW	255
	SUBWF	HI2CWAITMSSPTIMEOUT,W,ACCESS
	BTFSC	STATUS,0,ACCESS
	BRA	SYSDOLOOP_E13
;'HI2CWAITMSSPTIMEOUT++
	INCF	HI2CWAITMSSPTIMEOUT,F,ACCESS
;'WAIT FOR THIS EVENT
;'IF I2C1CON1.ACKSTAT = 0 THEN
	BANKSEL	I2C1CON1
	BTFSC	I2C1CON1,5,BANKED
	BRA	ELSE79_1
;'SET STATUS
;'HI2CACKPOLLSTATE = !I2C1CON1.ACKSTAT
	BANKSEL	SYSTEMP3
	CLRF	SYSTEMP3,BANKED
	BANKSEL	I2C1CON1
	BTFSS	I2C1CON1,5,BANKED
	BRA	ENDIF81
	BANKSEL	SYSTEMP3
	INCF	SYSTEMP3,F,BANKED
GLOBAL	ENDIF81
ENDIF81:
	BANKSEL	SYSTEMP3
	COMF	SYSTEMP3,W,BANKED
	MOVWF	HI2CACKPOLLSTATE,ACCESS
;'EXIT SUB
	BANKSEL	0
	RETURN
;'ELSE
	BRA	ENDIF79
GLOBAL	ELSE79_1
ELSE79_1:
;'WAIT 1 US
	MOVLW	5
	MOVWF	DELAYTEMP,ACCESS
GLOBAL	DELAYUS12
DELAYUS12:
	DECFSZ	DELAYTEMP,F,ACCESS
	BRA	DELAYUS12
;'END IF
GLOBAL	ENDIF79
ENDIF79:
;'LOOP
	BRA	SYSDOLOOP_S13
GLOBAL	SYSDOLOOP_E13
SYSDOLOOP_E13:
;'IF HI2CWAITMSSPTIMEOUT = 255 THEN HI2C1LASTERROR = HI2C1LASTERROR OR I2C1_ACK_TIMEOUT
	INCF	HI2CWAITMSSPTIMEOUT,W,ACCESS
	BTFSS	STATUS,2,ACCESS
	BRA	ENDIF80
;'IF HI2CWAITMSSPTIMEOUT = 255 THEN HI2C1LASTERROR = HI2C1LASTERROR OR I2C1_ACK_TIMEOUT
	MOVLW	32
	IORWF	HI2C1LASTERROR,F,ACCESS
;'IF HI2CWAITMSSPTIMEOUT = 255 THEN HI2C1LASTERROR = HI2C1LASTERROR OR I2C1_ACK_TIMEOUT
GLOBAL	ENDIF80
ENDIF80:
;'HI2CWAITMSSPTIMEOUT IS NOW TRUE = 255
	BANKSEL	0
	RETURN

;'********************************************************************************

;'SOURCE: HWI2C.H (1041)
GLOBAL	SI2CWAIT4MDR
SI2CWAIT4MDR:
;'HI2CWAITMSSPTIMEOUT = 0
	CLRF	HI2CWAITMSSPTIMEOUT,ACCESS
;'WAITS UP TO 254US THEN CREATES ERROR MESSAGE
;'DO WHILE HI2CWAITMSSPTIMEOUT < 255
GLOBAL	SYSDOLOOP_S14
SYSDOLOOP_S14:
	MOVLW	255
	SUBWF	HI2CWAITMSSPTIMEOUT,W,ACCESS
	BTFSC	STATUS,0,ACCESS
	BRA	SYSDOLOOP_E14
;'HI2CWAITMSSPTIMEOUT++
	INCF	HI2CWAITMSSPTIMEOUT,F,ACCESS
;'WAIT FOR THIS EVENT
;'IF I2C1CON0.MDR = 0 THEN
	BANKSEL	I2C1CON0
	BTFSC	I2C1CON0,3,BANKED
	BRA	ELSE82_1
;'EXIT SUB
	BANKSEL	0
	RETURN
;'ELSE
	BRA	ENDIF82
GLOBAL	ELSE82_1
ELSE82_1:
;'WAIT 1 US
	MOVLW	5
	MOVWF	DELAYTEMP,ACCESS
GLOBAL	DELAYUS13
DELAYUS13:
	DECFSZ	DELAYTEMP,F,ACCESS
	BRA	DELAYUS13
;'END IF
GLOBAL	ENDIF82
ENDIF82:
;'LOOP
	BRA	SYSDOLOOP_S14
GLOBAL	SYSDOLOOP_E14
SYSDOLOOP_E14:
;'IF HI2CWAITMSSPTIMEOUT = 255 THEN HI2C1LASTERROR = HI2C1LASTERROR OR I2C1_MDR_TIMEOUT
	INCF	HI2CWAITMSSPTIMEOUT,W,ACCESS
	BTFSS	STATUS,2,ACCESS
	BRA	ENDIF83
;'IF HI2CWAITMSSPTIMEOUT = 255 THEN HI2C1LASTERROR = HI2C1LASTERROR OR I2C1_MDR_TIMEOUT
	MOVLW	64
	IORWF	HI2C1LASTERROR,F,ACCESS
;'IF HI2CWAITMSSPTIMEOUT = 255 THEN HI2C1LASTERROR = HI2C1LASTERROR OR I2C1_MDR_TIMEOUT
GLOBAL	ENDIF83
ENDIF83:
;'HI2CWAITMSSPTIMEOUT IS NOW TRUE = 255
	BANKSEL	0
	RETURN

;'********************************************************************************

;'SOURCE: HWI2C.H (1064)
GLOBAL	SI2CWAIT4STOP
SI2CWAIT4STOP:
;'HI2CWAITMSSPTIMEOUT = 0
	CLRF	HI2CWAITMSSPTIMEOUT,ACCESS
;'WAITS UP TO 254US THEN CREATES ERROR MESSAGE
;'DO WHILE HI2CWAITMSSPTIMEOUT < 255
GLOBAL	SYSDOLOOP_S15
SYSDOLOOP_S15:
	MOVLW	255
	SUBWF	HI2CWAITMSSPTIMEOUT,W,ACCESS
	BTFSC	STATUS,0,ACCESS
	BRA	SYSDOLOOP_E15
;'HI2CWAITMSSPTIMEOUT++
	INCF	HI2CWAITMSSPTIMEOUT,F,ACCESS
;'WAIT FOR THIS EVENT
;'IF I2C1PIR.PCIF = 1 THEN
	BANKSEL	I2C1PIR
	BTFSS	I2C1PIR,2,BANKED
	BRA	ELSE84_1
;'EXIT SUB
	BANKSEL	0
	RETURN
;'ELSE
	BRA	ENDIF84
GLOBAL	ELSE84_1
ELSE84_1:
;'WAIT 1 US
	MOVLW	5
	MOVWF	DELAYTEMP,ACCESS
GLOBAL	DELAYUS14
DELAYUS14:
	DECFSZ	DELAYTEMP,F,ACCESS
	BRA	DELAYUS14
;'END IF
GLOBAL	ENDIF84
ENDIF84:
;'LOOP
	BRA	SYSDOLOOP_S15
GLOBAL	SYSDOLOOP_E15
SYSDOLOOP_E15:
;'IF HI2CWAITMSSPTIMEOUT = 255 THEN HI2C1LASTERROR = HI2C1LASTERROR OR I2C1_STOP_TIMEOUT
	INCF	HI2CWAITMSSPTIMEOUT,W,ACCESS
	BTFSS	STATUS,2,ACCESS
	BRA	ENDIF85
;'IF HI2CWAITMSSPTIMEOUT = 255 THEN HI2C1LASTERROR = HI2C1LASTERROR OR I2C1_STOP_TIMEOUT
	MOVLW	128
	IORWF	HI2C1LASTERROR,F,ACCESS
;'IF HI2CWAITMSSPTIMEOUT = 255 THEN HI2C1LASTERROR = HI2C1LASTERROR OR I2C1_STOP_TIMEOUT
GLOBAL	ENDIF85
ENDIF85:
;'HI2CWAITMSSPTIMEOUT IS NOW TRUE = 255
	BANKSEL	0
	RETURN

;'********************************************************************************

;'SOURCE: STRING.H (76)
GLOBAL	FN_STR
FN_STR:
;'SYSCHARCOUNT = 0
	BANKSEL	SYSCHARCOUNT
	CLRF	SYSCHARCOUNT,BANKED
;'DIM SYSCALCTEMPX AS WORD
;'TEN THOUSANDS
;'IF SYSVALTEMP >= 10000 THEN
	MOVFF	SYSVALTEMP,SYSWORDTEMPA
	MOVFF	SYSVALTEMP_H,SYSWORDTEMPA_H
	MOVLW	16
	MOVWF	SYSWORDTEMPB,ACCESS
	MOVLW	39
	MOVWF	SYSWORDTEMPB_H,ACCESS
	BANKSEL	0
	RCALL	SYSCOMPLESSTHAN16
	COMF	SYSBYTETEMPX,F,ACCESS
	BTFSS	SYSBYTETEMPX,0,ACCESS
	BRA	ENDIF38
;'SYSSTRDATA = SYSVALTEMP / 10000
	MOVFF	SYSVALTEMP,SYSWORDTEMPA
	MOVFF	SYSVALTEMP_H,SYSWORDTEMPA_H
	MOVLW	16
	MOVWF	SYSWORDTEMPB,ACCESS
	MOVLW	39
	MOVWF	SYSWORDTEMPB_H,ACCESS
	RCALL	SYSDIVSUB16
	MOVFF	SYSWORDTEMPA,SYSSTRDATA
;'SYSVALTEMP = SYSCALCTEMPX
	MOVFF	SYSCALCTEMPX,SYSVALTEMP
	MOVFF	SYSCALCTEMPX_H,SYSVALTEMP_H
;'SYSCHARCOUNT += 1
	BANKSEL	SYSCHARCOUNT
	INCF	SYSCHARCOUNT,F,BANKED
;'STR(SYSCHARCOUNT) = SYSSTRDATA + 48
	LFSR	0,STR
	MOVF	SYSCHARCOUNT,W,BANKED
	ADDWF	FSR0,F,ACCESS
	MOVLW	0
	ADDWFC	FSR0H,F,ACCESS
	MOVLW	48
	ADDWF	SYSSTRDATA,W,BANKED
	MOVWF	INDF0,ACCESS
;'GOTO SYSVALTHOUSANDS
	BRA	SYSVALTHOUSANDS
;'END IF
GLOBAL	ENDIF38
ENDIF38:
;'THOUSANDS
;'IF SYSVALTEMP >= 1000 THEN
	MOVFF	SYSVALTEMP,SYSWORDTEMPA
	MOVFF	SYSVALTEMP_H,SYSWORDTEMPA_H
	MOVLW	232
	MOVWF	SYSWORDTEMPB,ACCESS
	MOVLW	3
	MOVWF	SYSWORDTEMPB_H,ACCESS
	RCALL	SYSCOMPLESSTHAN16
	COMF	SYSBYTETEMPX,F,ACCESS
	BTFSS	SYSBYTETEMPX,0,ACCESS
	BRA	ENDIF39
GLOBAL	SYSVALTHOUSANDS
SYSVALTHOUSANDS:
;'SYSSTRDATA = SYSVALTEMP / 1000
	MOVFF	SYSVALTEMP,SYSWORDTEMPA
	MOVFF	SYSVALTEMP_H,SYSWORDTEMPA_H
	MOVLW	232
	MOVWF	SYSWORDTEMPB,ACCESS
	MOVLW	3
	MOVWF	SYSWORDTEMPB_H,ACCESS
	BANKSEL	0
	RCALL	SYSDIVSUB16
	MOVFF	SYSWORDTEMPA,SYSSTRDATA
;'SYSVALTEMP = SYSCALCTEMPX
	MOVFF	SYSCALCTEMPX,SYSVALTEMP
	MOVFF	SYSCALCTEMPX_H,SYSVALTEMP_H
;'SYSCHARCOUNT += 1
	BANKSEL	SYSCHARCOUNT
	INCF	SYSCHARCOUNT,F,BANKED
;'STR(SYSCHARCOUNT) = SYSSTRDATA + 48
	LFSR	0,STR
	MOVF	SYSCHARCOUNT,W,BANKED
	ADDWF	FSR0,F,ACCESS
	MOVLW	0
	ADDWFC	FSR0H,F,ACCESS
	MOVLW	48
	ADDWF	SYSSTRDATA,W,BANKED
	MOVWF	INDF0,ACCESS
;'GOTO SYSVALHUNDREDS
	BRA	SYSVALHUNDREDS
;'END IF
GLOBAL	ENDIF39
ENDIF39:
;'HUNDREDS
;'IF SYSVALTEMP >= 100 THEN
	MOVFF	SYSVALTEMP,SYSWORDTEMPA
	MOVFF	SYSVALTEMP_H,SYSWORDTEMPA_H
	MOVLW	100
	MOVWF	SYSWORDTEMPB,ACCESS
	CLRF	SYSWORDTEMPB_H,ACCESS
	RCALL	SYSCOMPLESSTHAN16
	COMF	SYSBYTETEMPX,F,ACCESS
	BTFSS	SYSBYTETEMPX,0,ACCESS
	BRA	ENDIF40
GLOBAL	SYSVALHUNDREDS
SYSVALHUNDREDS:
;'SYSSTRDATA = SYSVALTEMP / 100
	MOVFF	SYSVALTEMP,SYSWORDTEMPA
	MOVFF	SYSVALTEMP_H,SYSWORDTEMPA_H
	MOVLW	100
	MOVWF	SYSWORDTEMPB,ACCESS
	CLRF	SYSWORDTEMPB_H,ACCESS
	BANKSEL	0
	RCALL	SYSDIVSUB16
	MOVFF	SYSWORDTEMPA,SYSSTRDATA
;'SYSVALTEMP = SYSCALCTEMPX
	MOVFF	SYSCALCTEMPX,SYSVALTEMP
	MOVFF	SYSCALCTEMPX_H,SYSVALTEMP_H
;'SYSCHARCOUNT += 1
	BANKSEL	SYSCHARCOUNT
	INCF	SYSCHARCOUNT,F,BANKED
;'STR(SYSCHARCOUNT) = SYSSTRDATA + 48
	LFSR	0,STR
	MOVF	SYSCHARCOUNT,W,BANKED
	ADDWF	FSR0,F,ACCESS
	MOVLW	0
	ADDWFC	FSR0H,F,ACCESS
	MOVLW	48
	ADDWF	SYSSTRDATA,W,BANKED
	MOVWF	INDF0,ACCESS
;'GOTO SYSVALTENS
	BRA	SYSVALTENS
;'END IF
GLOBAL	ENDIF40
ENDIF40:
;'TENS
;'IF SYSVALTEMP >= 10 THEN
	MOVFF	SYSVALTEMP,SYSWORDTEMPA
	MOVFF	SYSVALTEMP_H,SYSWORDTEMPA_H
	MOVLW	10
	MOVWF	SYSWORDTEMPB,ACCESS
	CLRF	SYSWORDTEMPB_H,ACCESS
	RCALL	SYSCOMPLESSTHAN16
	COMF	SYSBYTETEMPX,F,ACCESS
	BTFSS	SYSBYTETEMPX,0,ACCESS
	BRA	ENDIF41
GLOBAL	SYSVALTENS
SYSVALTENS:
;'SYSSTRDATA = SYSVALTEMP / 10
	MOVFF	SYSVALTEMP,SYSWORDTEMPA
	MOVFF	SYSVALTEMP_H,SYSWORDTEMPA_H
	MOVLW	10
	MOVWF	SYSWORDTEMPB,ACCESS
	CLRF	SYSWORDTEMPB_H,ACCESS
	BANKSEL	0
	RCALL	SYSDIVSUB16
	MOVFF	SYSWORDTEMPA,SYSSTRDATA
;'SYSVALTEMP = SYSCALCTEMPX
	MOVFF	SYSCALCTEMPX,SYSVALTEMP
	MOVFF	SYSCALCTEMPX_H,SYSVALTEMP_H
;'SYSCHARCOUNT += 1
	BANKSEL	SYSCHARCOUNT
	INCF	SYSCHARCOUNT,F,BANKED
;'STR(SYSCHARCOUNT) = SYSSTRDATA + 48
	LFSR	0,STR
	MOVF	SYSCHARCOUNT,W,BANKED
	ADDWF	FSR0,F,ACCESS
	MOVLW	0
	ADDWFC	FSR0H,F,ACCESS
	MOVLW	48
	ADDWF	SYSSTRDATA,W,BANKED
	MOVWF	INDF0,ACCESS
;'END IF
GLOBAL	ENDIF41
ENDIF41:
;'ONES
;'SYSCHARCOUNT += 1
	BANKSEL	SYSCHARCOUNT
	INCF	SYSCHARCOUNT,F,BANKED
;'STR(SYSCHARCOUNT) = SYSVALTEMP + 48
	LFSR	0,STR
	MOVF	SYSCHARCOUNT,W,BANKED
	ADDWF	FSR0,F,ACCESS
	MOVLW	0
	ADDWFC	FSR0H,F,ACCESS
	MOVLW	48
	ADDWF	SYSVALTEMP,W,BANKED
	MOVWF	INDF0,ACCESS
;'SYSVALTEMP = SYSCALCTEMPX
	MOVFF	SYSCALCTEMPX,SYSVALTEMP
	MOVFF	SYSCALCTEMPX_H,SYSVALTEMP_H
;'STR(0) = SYSCHARCOUNT
	MOVFFL	SYSCHARCOUNT,SYSSTR_0
	BANKSEL	0
	RETURN

;'********************************************************************************

;'SOURCE: SYSTEM.H (3153)
GLOBAL	SYSCOMPEQUAL
SYSCOMPEQUAL:
;'DIM SYSBYTETEMPA, SYSBYTETEMPB, SYSBYTETEMPX AS BYTE
;'SETF SYSBYTETEMPX
	SETF	SYSBYTETEMPX,ACCESS
;'MOVF SYSBYTETEMPB, W
	MOVF	SYSBYTETEMPB, W,ACCESS
;'CPFSEQ SYSBYTETEMPA
	CPFSEQ	SYSBYTETEMPA,ACCESS
;'CLRF SYSBYTETEMPX
	CLRF	SYSBYTETEMPX,ACCESS
	RETURN

;'********************************************************************************

;'SOURCE: SYSTEM.H (3179)
GLOBAL	SYSCOMPEQUAL16
SYSCOMPEQUAL16:
;'DIM SYSWORDTEMPA AS WORD
;'DIM SYSWORDTEMPB AS WORD
;'DIM SYSBYTETEMPX AS BYTE
;'CLRF SYSBYTETEMPX
	CLRF	SYSBYTETEMPX,ACCESS
;'TEST LOW, EXIT IF FALSE
;'MOVF SYSWORDTEMPB, W
	MOVF	SYSWORDTEMPB, W,ACCESS
;'CPFSEQ SYSWORDTEMPA
	CPFSEQ	SYSWORDTEMPA,ACCESS
;'RETURN
	RETURN
;'TEST HIGH, EXIT IF FALSE
;'MOVF SYSWORDTEMPB_H, W
	MOVF	SYSWORDTEMPB_H, W,ACCESS
;'CPFSEQ SYSWORDTEMPA_H
	CPFSEQ	SYSWORDTEMPA_H,ACCESS
;'RETURN
	RETURN
;'SETF SYSBYTETEMPX
	SETF	SYSBYTETEMPX,ACCESS
	RETURN

;'********************************************************************************

;'SOURCE: SYSTEM.H (3233)
GLOBAL	SYSCOMPEQUAL32
SYSCOMPEQUAL32:
;'DIM SYSLONGTEMPA AS LONG
;'DIM SYSLONGTEMPB AS LONG
;'DIM SYSBYTETEMPX AS BYTE
;'CLRF SYSBYTETEMPX
	CLRF	SYSBYTETEMPX,ACCESS
;'TEST LOW, EXIT IF FALSE
;'MOVF SYSLONGTEMPB, W
	MOVF	SYSLONGTEMPB, W,ACCESS
;'CPFSEQ SYSLONGTEMPA
	CPFSEQ	SYSLONGTEMPA,ACCESS
;'RETURN
	RETURN
;'TEST HIGH, EXIT IF FALSE
;'MOVF SYSLONGTEMPB_H, W
	MOVF	SYSLONGTEMPB_H, W,ACCESS
;'CPFSEQ SYSLONGTEMPA_H
	CPFSEQ	SYSLONGTEMPA_H,ACCESS
;'RETURN
	RETURN
;'TEST UPPER, EXIT IF FALSE
;'MOVF SYSLONGTEMPB_U, W
	MOVF	SYSLONGTEMPB_U, W,ACCESS
;'CPFSEQ SYSLONGTEMPA_U
	CPFSEQ	SYSLONGTEMPA_U,ACCESS
;'RETURN
	RETURN
;'TEST EXP, EXIT IF FALSE
;'MOVF SYSLONGTEMPB_E, W
	MOVF	SYSLONGTEMPB_E, W,ACCESS
;'CPFSEQ SYSLONGTEMPA_E
	CPFSEQ	SYSLONGTEMPA_E,ACCESS
;'RETURN
	RETURN
;'SETF SYSBYTETEMPX
	SETF	SYSBYTETEMPX,ACCESS
	RETURN

;'********************************************************************************

;'SOURCE: SYSTEM.H (3458)
GLOBAL	SYSCOMPLESSTHAN
SYSCOMPLESSTHAN:
;'DIM SYSBYTETEMPA, SYSBYTETEMPB, SYSBYTETEMPX AS BYTE
;'SETF SYSBYTETEMPX
	SETF	SYSBYTETEMPX,ACCESS
;'MOVF SYSBYTETEMPB, W
	MOVF	SYSBYTETEMPB, W,ACCESS
;'CPFSLT SYSBYTETEMPA
	CPFSLT	SYSBYTETEMPA,ACCESS
;'CLRF SYSBYTETEMPX
	CLRF	SYSBYTETEMPX,ACCESS
	RETURN

;'********************************************************************************

;'SOURCE: SYSTEM.H (3488)
GLOBAL	SYSCOMPLESSTHAN16
SYSCOMPLESSTHAN16:
;'DIM SYSWORDTEMPA AS WORD
;'DIM SYSWORDTEMPB AS WORD
;'DIM SYSBYTETEMPX AS BYTE
;'CLRF SYSBYTETEMPX
	CLRF	SYSBYTETEMPX,ACCESS
;'TEST HIGH, EXIT IF MORE
;'MOVF SYSWORDTEMPA_H,W
	MOVF	SYSWORDTEMPA_H,W,ACCESS
;'SUBWF SYSWORDTEMPB_H,W
	SUBWF	SYSWORDTEMPB_H,W,ACCESS
	;BTFSS	STATUS,0
	BTFSS	STATUS,0,ACCESS
;'RETURN
	RETURN
;'TEST HIGH, EXIT TRUE IF LESS
;'MOVF SYSWORDTEMPB_H,W
	MOVF	SYSWORDTEMPB_H,W,ACCESS
;'SUBWF SYSWORDTEMPA_H,W
	SUBWF	SYSWORDTEMPA_H,W,ACCESS
;'BNC SCLT16TRUE
	BNC	SCLT16TRUE
;'TEST LOW, EXIT IF MORE OR EQUAL
;'MOVF SYSWORDTEMPB,W
	MOVF	SYSWORDTEMPB,W,ACCESS
;'SUBWF SYSWORDTEMPA,W
	SUBWF	SYSWORDTEMPA,W,ACCESS
	;BTFSC	STATUS,0
	BTFSC	STATUS,0,ACCESS
;'RETURN
	RETURN
GLOBAL	SCLT16TRUE
SCLT16TRUE:
;'COMF SYSBYTETEMPX,F
	COMF	SYSBYTETEMPX,F,ACCESS
	RETURN

;'********************************************************************************

;'SOURCE: SYSTEM.H (3789)
GLOBAL	SYSCOMPLESSTHANINT
SYSCOMPLESSTHANINT:
;'DIM SYSINTEGERTEMPA, SYSINTEGERTEMPB, SYSDIVMULTA AS INTEGER
;'CLEAR RESULT
;'SYSBYTETEMPX = 0
	CLRF	SYSBYTETEMPX,ACCESS
;'COMPARE SIGN BITS
;'-A
;'IF SYSINTEGERTEMPA.15 = ON THEN
	BTFSS	SYSINTEGERTEMPA_H,7,ACCESS
	BRA	ELSE35_1
;'-A, +B, RETURN TRUE
;'IF SYSINTEGERTEMPB.15 = OFF THEN
	BTFSC	SYSINTEGERTEMPB_H,7,ACCESS
	BRA	ENDIF36
;'SET SYSBYTETEMPX TO 255
;'SYSBYTETEMPX = NOT SYSBYTETEMPX
	COMF	SYSBYTETEMPX,F,ACCESS
;'EXIT SUB
	RETURN
;'END IF
GLOBAL	ENDIF36
ENDIF36:
;'-A, -B, NEGATE BOTH AND SWAP
;'SYSDIVMULTA = -SYSINTEGERTEMPA
	COMF	SYSINTEGERTEMPA,W,ACCESS
	MOVWF	SYSDIVMULTA,ACCESS
	COMF	SYSINTEGERTEMPA_H,W,ACCESS
	MOVWF	SYSDIVMULTA_H,ACCESS
	INCF	SYSDIVMULTA,F,ACCESS
	BTFSC	STATUS,2,ACCESS
	INCF	SYSDIVMULTA_H,F,ACCESS
;'SYSINTEGERTEMPA = -SYSINTEGERTEMPB
	COMF	SYSINTEGERTEMPB,W,ACCESS
	MOVWF	SYSINTEGERTEMPA,ACCESS
	COMF	SYSINTEGERTEMPB_H,W,ACCESS
	MOVWF	SYSINTEGERTEMPA_H,ACCESS
	INCF	SYSINTEGERTEMPA,F,ACCESS
	BTFSC	STATUS,2,ACCESS
	INCF	SYSINTEGERTEMPA_H,F,ACCESS
;'SYSINTEGERTEMPB = SYSDIVMULTA
	MOVFF	SYSDIVMULTA,SYSINTEGERTEMPB
	MOVFF	SYSDIVMULTA_H,SYSINTEGERTEMPB_H
;'+A
;'ELSE
	BRA	ENDIF35
GLOBAL	ELSE35_1
ELSE35_1:
;'+A, -B, RETURN FALSE
;'IF SYSINTEGERTEMPB.15 = ON THEN
	BTFSC	SYSINTEGERTEMPB_H,7,ACCESS
;'EXIT SUB
	RETURN
;'END IF
;'END IF
GLOBAL	ENDIF35
ENDIF35:
;'TEST HIGH, EXIT IF MORE
;'MOVF SYSINTEGERTEMPA_H,W
	MOVF	SYSINTEGERTEMPA_H,W,ACCESS
;'SUBWF SYSINTEGERTEMPB_H,W
	SUBWF	SYSINTEGERTEMPB_H,W,ACCESS
	;BTFSS	STATUS,0
	BTFSS	STATUS,0,ACCESS
;'RETURN
	RETURN
;'TEST HIGH, EXIT TRUE IF LESS
;'MOVF SYSINTEGERTEMPB_H,W
	MOVF	SYSINTEGERTEMPB_H,W,ACCESS
;'SUBWF SYSINTEGERTEMPA_H,W
	SUBWF	SYSINTEGERTEMPA_H,W,ACCESS
;'BNC SCLTINTTRUE
	BNC	SCLTINTTRUE
;'TEST LOW, EXIT IF MORE OR EQUAL
;'MOVF SYSINTEGERTEMPB,W
	MOVF	SYSINTEGERTEMPB,W,ACCESS
;'SUBWF SYSINTEGERTEMPA,W
	SUBWF	SYSINTEGERTEMPA,W,ACCESS
	;BTFSC	STATUS,0
	BTFSC	STATUS,0,ACCESS
;'RETURN
	RETURN
GLOBAL	SCLTINTTRUE
SCLTINTTRUE:
;'COMF SYSBYTETEMPX,F
	COMF	SYSBYTETEMPX,F,ACCESS
	RETURN

;'********************************************************************************

;'SOURCE: SYSTEM.H (1449)
GLOBAL	SYSCOPYSTRING
SYSCOPYSTRING:
;'DIM SYSCALCTEMPA AS BYTE
;'DIM SYSSTRINGLENGTH AS BYTE
;'GET AND COPY LENGTH FOR CHIPFAMILY 16 SUPPORT
	;MOVFF	INDF0,SYSCALCTEMPA
	MOVFF	INDF0,SYSCALCTEMPA
	;MOVFF	SYSCALCTEMPA,INDF1
	MOVFF	SYSCALCTEMPA,INDF1
;'GOTO SYSCOPYSTRINGCHECK
	BRA	SYSCOPYSTRINGCHECK
;'WHEN APPENDING, ADD LENGTH TO COUNTER
GLOBAL	SYSCOPYSTRINGPART
SYSCOPYSTRINGPART:
	;MOVF	INDF0,W
	MOVF	INDF0, W,ACCESS
;'MOVWF SYSCALCTEMPA
	MOVWF	SYSCALCTEMPA,ACCESS
;'ADDWF SYSSTRINGLENGTH, F
	ADDWF	SYSSTRINGLENGTH, F,ACCESS
GLOBAL	SYSCOPYSTRINGCHECK
SYSCOPYSTRINGCHECK:
;'EXIT IF LENGTH = 0
;'MOVF SYSCALCTEMPA,F
	MOVF	SYSCALCTEMPA,F,ACCESS
	;BTFSC	STATUS,2
	BTFSC	STATUS,2,ACCESS
;'RETURN
	RETURN
GLOBAL	SYSSTRINGCOPY
SYSSTRINGCOPY:
;'COPY CHARACTER
	;MOVFF	PREINC0,PREINC1
	MOVFF	PREINC0,PREINC1
;'DECFSZ SYSCALCTEMPA, F
	DECFSZ	SYSCALCTEMPA, F,ACCESS
;'GOTO SYSSTRINGCOPY
	BRA	SYSSTRINGCOPY
	RETURN

;'********************************************************************************

;'SOURCE: SYSTEM.H (2936)
GLOBAL	SYSDIVSUB16
SYSDIVSUB16:
;'DIM SYSWORDTEMPA AS WORD
;'DIM SYSWORDTEMPB AS WORD
;'DIM SYSWORDTEMPX AS WORD
;'DIM SYSDIVMULTA AS WORD
;'DIM SYSDIVMULTB AS WORD
;'DIM SYSDIVMULTX AS WORD
;'SYSDIVMULTA = SYSWORDTEMPA
	MOVFF	SYSWORDTEMPA,SYSDIVMULTA
	MOVFF	SYSWORDTEMPA_H,SYSDIVMULTA_H
;'SYSDIVMULTB = SYSWORDTEMPB
	MOVFF	SYSWORDTEMPB,SYSDIVMULTB
	MOVFF	SYSWORDTEMPB_H,SYSDIVMULTB_H
;'SYSDIVMULTX = 0
	CLRF	SYSDIVMULTX,ACCESS
	CLRF	SYSDIVMULTX_H,ACCESS
;'AVOID DIVISION BY ZERO
;'IF SYSDIVMULTB = 0 THEN
	MOVFF	SYSDIVMULTB,SYSWORDTEMPA
	MOVFF	SYSDIVMULTB_H,SYSWORDTEMPA_H
	CLRF	SYSWORDTEMPB,ACCESS
	CLRF	SYSWORDTEMPB_H,ACCESS
	RCALL	SYSCOMPEQUAL16
	BTFSS	SYSBYTETEMPX,0,ACCESS
	BRA	ENDIF67
;'SYSWORDTEMPA = 0
	CLRF	SYSWORDTEMPA,ACCESS
	CLRF	SYSWORDTEMPA_H,ACCESS
;'EXIT SUB
	RETURN
;'END IF
GLOBAL	ENDIF67
ENDIF67:
;'MAIN CALC ROUTINE
;'SYSDIVLOOP = 16
	MOVLW	16
	MOVWF	SYSDIVLOOP,ACCESS
GLOBAL	SYSDIV16START
SYSDIV16START:
;'SET C OFF
	BCF	STATUS,0,ACCESS
;'ROTATE SYSDIVMULTA LEFT
	RLCF	SYSDIVMULTA,F,ACCESS
	RLCF	SYSDIVMULTA_H,F,ACCESS
;'ROTATE SYSDIVMULTX LEFT
	RLCF	SYSDIVMULTX,F,ACCESS
	RLCF	SYSDIVMULTX_H,F,ACCESS
;'SYSDIVMULTX = SYSDIVMULTX - SYSDIVMULTB
	MOVF	SYSDIVMULTB,W,ACCESS
	SUBWF	SYSDIVMULTX,F,ACCESS
	MOVF	SYSDIVMULTB_H,W,ACCESS
	SUBWFB	SYSDIVMULTX_H,F,ACCESS
;'SET SYSDIVMULTA.0 ON
	BSF	SYSDIVMULTA,0,ACCESS
;'IF C OFF THEN
	BTFSC	STATUS,0,ACCESS
	BRA	ENDIF68
;'SET SYSDIVMULTA.0 OFF
	BCF	SYSDIVMULTA,0,ACCESS
;'SYSDIVMULTX = SYSDIVMULTX + SYSDIVMULTB
	MOVF	SYSDIVMULTB,W,ACCESS
	ADDWF	SYSDIVMULTX,F,ACCESS
	MOVF	SYSDIVMULTB_H,W,ACCESS
	ADDWFC	SYSDIVMULTX_H,F,ACCESS
;'END IF
GLOBAL	ENDIF68
ENDIF68:
;'DECFSZ SYSDIVLOOP, F
	DECFSZ	SYSDIVLOOP, F,ACCESS
;'GOTO SYSDIV16START
	BRA	SYSDIV16START
;'SYSWORDTEMPA = SYSDIVMULTA
	MOVFF	SYSDIVMULTA,SYSWORDTEMPA
	MOVFF	SYSDIVMULTA_H,SYSWORDTEMPA_H
;'SYSWORDTEMPX = SYSDIVMULTX
	MOVFF	SYSDIVMULTX,SYSWORDTEMPX
	MOVFF	SYSDIVMULTX_H,SYSWORDTEMPX_H
	RETURN

;'********************************************************************************

;'SOURCE: SYSTEM.H (3012)
GLOBAL	SYSDIVSUB32
SYSDIVSUB32:
;'DIM SYSLONGTEMPA AS LONG
;'DIM SYSLONGTEMPB AS LONG
;'DIM SYSLONGTEMPX AS LONG
;'#IFDEF PIC
;'DIM SYSLONGDIVMULTA AS LONG
;'DIM SYSLONGDIVMULTB AS LONG
;'DIM SYSLONGDIVMULTX AS LONG
;'#ENDIF
;'SYSLONGDIVMULTA = SYSLONGTEMPA
	MOVFF	SYSLONGTEMPA,SYSLONGDIVMULTA
	MOVFF	SYSLONGTEMPA_H,SYSLONGDIVMULTA_H
	MOVFF	SYSLONGTEMPA_U,SYSLONGDIVMULTA_U
	MOVFF	SYSLONGTEMPA_E,SYSLONGDIVMULTA_E
;'SYSLONGDIVMULTB = SYSLONGTEMPB
	MOVFF	SYSLONGTEMPB,SYSLONGDIVMULTB
	MOVFF	SYSLONGTEMPB_H,SYSLONGDIVMULTB_H
	MOVFF	SYSLONGTEMPB_U,SYSLONGDIVMULTB_U
	MOVFF	SYSLONGTEMPB_E,SYSLONGDIVMULTB_E
;'SYSLONGDIVMULTX = 0
	BANKSEL	SYSLONGDIVMULTX
	CLRF	SYSLONGDIVMULTX,BANKED
	CLRF	SYSLONGDIVMULTX_H,BANKED
	CLRF	SYSLONGDIVMULTX_U,BANKED
	CLRF	SYSLONGDIVMULTX_E,BANKED
;'AVOID DIVISION BY ZERO
;'IF SYSLONGDIVMULTB = 0 THEN
	MOVFF	SYSLONGDIVMULTB,SYSLONGTEMPA
	MOVFF	SYSLONGDIVMULTB_H,SYSLONGTEMPA_H
	MOVFF	SYSLONGDIVMULTB_U,SYSLONGTEMPA_U
	MOVFF	SYSLONGDIVMULTB_E,SYSLONGTEMPA_E
	CLRF	SYSLONGTEMPB,ACCESS
	CLRF	SYSLONGTEMPB_H,ACCESS
	CLRF	SYSLONGTEMPB_U,ACCESS
	CLRF	SYSLONGTEMPB_E,ACCESS
	BANKSEL	0
	RCALL	SYSCOMPEQUAL32
	BTFSS	SYSBYTETEMPX,0,ACCESS
	BRA	ENDIF33
;'SYSLONGTEMPA = 0
	CLRF	SYSLONGTEMPA,ACCESS
	CLRF	SYSLONGTEMPA_H,ACCESS
	CLRF	SYSLONGTEMPA_U,ACCESS
	CLRF	SYSLONGTEMPA_E,ACCESS
;'EXIT SUB
	RETURN
;'END IF
GLOBAL	ENDIF33
ENDIF33:
;'MAIN CALC ROUTINE
;'SYSDIVLOOP = 32
	MOVLW	32
	MOVWF	SYSDIVLOOP,ACCESS
GLOBAL	SYSDIV32START
SYSDIV32START:
;'SET C OFF
	BCF	STATUS,0,ACCESS
;'ROTATE SYSLONGDIVMULTA LEFT
	BANKSEL	SYSLONGDIVMULTA
	RLCF	SYSLONGDIVMULTA,F,BANKED
	RLCF	SYSLONGDIVMULTA_H,F,BANKED
	RLCF	SYSLONGDIVMULTA_U,F,BANKED
	RLCF	SYSLONGDIVMULTA_E,F,BANKED
;'ROTATE SYSLONGDIVMULTX LEFT
	RLCF	SYSLONGDIVMULTX,F,BANKED
	RLCF	SYSLONGDIVMULTX_H,F,BANKED
	RLCF	SYSLONGDIVMULTX_U,F,BANKED
	RLCF	SYSLONGDIVMULTX_E,F,BANKED
;'SYSLONGDIVMULTX = SYSLONGDIVMULTX - SYSLONGDIVMULTB
	MOVF	SYSLONGDIVMULTB,W,BANKED
	SUBWF	SYSLONGDIVMULTX,F,BANKED
	MOVF	SYSLONGDIVMULTB_H,W,BANKED
	SUBWFB	SYSLONGDIVMULTX_H,F,BANKED
	MOVF	SYSLONGDIVMULTB_U,W,BANKED
	SUBWFB	SYSLONGDIVMULTX_U,F,BANKED
	MOVF	SYSLONGDIVMULTB_E,W,BANKED
	SUBWFB	SYSLONGDIVMULTX_E,F,BANKED
;'SET SYSLONGDIVMULTA.0 ON
	BSF	SYSLONGDIVMULTA,0,BANKED
;'IF C OFF THEN
	BTFSC	STATUS,0,ACCESS
	BRA	ENDIF34
;'SET SYSLONGDIVMULTA.0 OFF
	BCF	SYSLONGDIVMULTA,0,BANKED
;'SYSLONGDIVMULTX = SYSLONGDIVMULTX + SYSLONGDIVMULTB
	MOVF	SYSLONGDIVMULTB,W,BANKED
	ADDWF	SYSLONGDIVMULTX,F,BANKED
	MOVF	SYSLONGDIVMULTB_H,W,BANKED
	ADDWFC	SYSLONGDIVMULTX_H,F,BANKED
	MOVF	SYSLONGDIVMULTB_U,W,BANKED
	ADDWFC	SYSLONGDIVMULTX_U,F,BANKED
	MOVF	SYSLONGDIVMULTB_E,W,BANKED
	ADDWFC	SYSLONGDIVMULTX_E,F,BANKED
;'END IF
GLOBAL	ENDIF34
ENDIF34:
;'DECFSZ SYSDIVLOOP, F
	DECFSZ	SYSDIVLOOP, F,ACCESS
;'GOTO SYSDIV32START
	BRA	SYSDIV32START
;'SYSLONGTEMPA = SYSLONGDIVMULTA
	MOVFF	SYSLONGDIVMULTA,SYSLONGTEMPA
	MOVFF	SYSLONGDIVMULTA_H,SYSLONGTEMPA_H
	MOVFF	SYSLONGDIVMULTA_U,SYSLONGTEMPA_U
	MOVFF	SYSLONGDIVMULTA_E,SYSLONGTEMPA_E
;'SYSLONGTEMPX = SYSLONGDIVMULTX
	MOVFF	SYSLONGDIVMULTX,SYSLONGTEMPX
	MOVFF	SYSLONGDIVMULTX_H,SYSLONGTEMPX_H
	MOVFF	SYSLONGDIVMULTX_U,SYSLONGTEMPX_U
	MOVFF	SYSLONGDIVMULTX_E,SYSLONGTEMPX_E
	BANKSEL	0
	RETURN

;'********************************************************************************

;'SOURCE: SYSTEM.H (2990)
GLOBAL	SYSDIVSUBINT
SYSDIVSUBINT:
;'DIM SYSINTEGERTEMPA, SYSINTEGERTEMPB, SYSINTEGERTEMPX AS INTEGER
;'DIM SYSSIGNBYTE AS BYTE
;'MAKE BOTH INPUTS POSITIVE, DECIDE OUTPUT TYPE
;'SYSSIGNBYTE = SYSINTEGERTEMPA_H XOR SYSINTEGERTEMPB_H
	MOVF	SYSINTEGERTEMPA_H,W,ACCESS
	XORWF	SYSINTEGERTEMPB_H,W,ACCESS
	MOVWF	SYSSIGNBYTE,ACCESS
;'IF SYSINTEGERTEMPA.15 THEN SYSINTEGERTEMPA = -SYSINTEGERTEMPA
	BTFSS	SYSINTEGERTEMPA_H,7,ACCESS
	BRA	ENDIF30
;'IF SYSINTEGERTEMPA.15 THEN SYSINTEGERTEMPA = -SYSINTEGERTEMPA
	COMF	SYSINTEGERTEMPA,F,ACCESS
	COMF	SYSINTEGERTEMPA_H,F,ACCESS
	INCF	SYSINTEGERTEMPA,F,ACCESS
	BTFSC	STATUS,2,ACCESS
	INCF	SYSINTEGERTEMPA_H,F,ACCESS
;'IF SYSINTEGERTEMPA.15 THEN SYSINTEGERTEMPA = -SYSINTEGERTEMPA
GLOBAL	ENDIF30
ENDIF30:
;'IF SYSINTEGERTEMPB.15 THEN SYSINTEGERTEMPB = -SYSINTEGERTEMPB
	BTFSS	SYSINTEGERTEMPB_H,7,ACCESS
	BRA	ENDIF31
;'IF SYSINTEGERTEMPB.15 THEN SYSINTEGERTEMPB = -SYSINTEGERTEMPB
	COMF	SYSINTEGERTEMPB,F,ACCESS
	COMF	SYSINTEGERTEMPB_H,F,ACCESS
	INCF	SYSINTEGERTEMPB,F,ACCESS
	BTFSC	STATUS,2,ACCESS
	INCF	SYSINTEGERTEMPB_H,F,ACCESS
;'IF SYSINTEGERTEMPB.15 THEN SYSINTEGERTEMPB = -SYSINTEGERTEMPB
GLOBAL	ENDIF31
ENDIF31:
;'CALL WORD DIVIDE ROUTINE
;'SYSDIVSUB16
	RCALL	SYSDIVSUB16
;'NEGATE RESULT IF NECESSARY
;'IF SYSSIGNBYTE.7 THEN
	BTFSS	SYSSIGNBYTE,7,ACCESS
	BRA	ENDIF32
;'SYSINTEGERTEMPA = -SYSINTEGERTEMPA
	COMF	SYSINTEGERTEMPA,F,ACCESS
	COMF	SYSINTEGERTEMPA_H,F,ACCESS
	INCF	SYSINTEGERTEMPA,F,ACCESS
	BTFSC	STATUS,2,ACCESS
	INCF	SYSINTEGERTEMPA_H,F,ACCESS
;'SYSINTEGERTEMPX = -SYSINTEGERTEMPX
	COMF	SYSINTEGERTEMPX,F,ACCESS
	COMF	SYSINTEGERTEMPX_H,F,ACCESS
	INCF	SYSINTEGERTEMPX,F,ACCESS
	BTFSC	STATUS,2,ACCESS
	INCF	SYSINTEGERTEMPX_H,F,ACCESS
;'END IF
GLOBAL	ENDIF32
ENDIF32:
	RETURN

;'********************************************************************************

;'SOURCE: SYSTEM.H (2640)
GLOBAL	SYSMULTSUB16
SYSMULTSUB16:
;'DIM SYSWORDTEMPA AS WORD
;'DIM SYSWORDTEMPB AS WORD
;'DIM SYSWORDTEMPX AS WORD
;'X = LOWA * LOWB
;'MOVF SYSWORDTEMPA, W
	MOVF	SYSWORDTEMPA, W,ACCESS
;'MULWF SYSWORDTEMPB
	MULWF	SYSWORDTEMPB,ACCESS
	;MOVFF	PRODL,SYSWORDTEMPX
	MOVFF	PRODL,SYSWORDTEMPX
	;MOVFF	PRODH,SYSWORDTEMPX_H
	MOVFF	PRODH,SYSWORDTEMPX_H
;'HIGHX += LOWA * HIGHB
;'MOVF SYSWORDTEMPA, W
	MOVF	SYSWORDTEMPA, W,ACCESS
;'MULWF SYSWORDTEMPB_H
	MULWF	SYSWORDTEMPB_H,ACCESS
	;MOVF	PRODL,W
	MOVF	PROD, W,ACCESS
;'ADDWF SYSWORDTEMPX_H, F
	ADDWF	SYSWORDTEMPX_H, F,ACCESS
;'HIGHX += HIGHA * LOWB
;'MOVF SYSWORDTEMPA_H, W
	MOVF	SYSWORDTEMPA_H, W,ACCESS
;'MULWF SYSWORDTEMPB
	MULWF	SYSWORDTEMPB,ACCESS
	;MOVF	PRODL,W
	MOVF	PROD, W,ACCESS
;'ADDWF SYSWORDTEMPX_H, F
	ADDWF	SYSWORDTEMPX_H, F,ACCESS
;'PRODL = HIGHA * HIGHB
;'MOVF SYSWORDTEMPA_H, F
	MOVF	SYSWORDTEMPA_H, F,ACCESS
;'MULWF SYSWORDTEMPB_H
	MULWF	SYSWORDTEMPB_H,ACCESS
	RETURN

;'********************************************************************************

;'SOURCE: SYSTEM.H (2738)
GLOBAL	SYSMULTSUBINT
SYSMULTSUBINT:
;'DIM SYSINTEGERTEMPA, SYSINTEGERTEMPB, SYSINTEGERTEMPX AS INTEGER
;'DIM SYSSIGNBYTE AS BYTE
;'MAKE BOTH INPUTS POSITIVE, DECIDE OUTPUT TYPE
;'SYSSIGNBYTE = SYSINTEGERTEMPA_H XOR SYSINTEGERTEMPB_H
	MOVF	SYSINTEGERTEMPA_H,W,ACCESS
	XORWF	SYSINTEGERTEMPB_H,W,ACCESS
	MOVWF	SYSSIGNBYTE,ACCESS
;'IF SYSINTEGERTEMPA.15 THEN SYSINTEGERTEMPA = -SYSINTEGERTEMPA
	BTFSS	SYSINTEGERTEMPA_H,7,ACCESS
	BRA	ENDIF27
;'IF SYSINTEGERTEMPA.15 THEN SYSINTEGERTEMPA = -SYSINTEGERTEMPA
	COMF	SYSINTEGERTEMPA,F,ACCESS
	COMF	SYSINTEGERTEMPA_H,F,ACCESS
	INCF	SYSINTEGERTEMPA,F,ACCESS
	BTFSC	STATUS,2,ACCESS
	INCF	SYSINTEGERTEMPA_H,F,ACCESS
;'IF SYSINTEGERTEMPA.15 THEN SYSINTEGERTEMPA = -SYSINTEGERTEMPA
GLOBAL	ENDIF27
ENDIF27:
;'IF SYSINTEGERTEMPB.15 THEN SYSINTEGERTEMPB = -SYSINTEGERTEMPB
	BTFSS	SYSINTEGERTEMPB_H,7,ACCESS
	BRA	ENDIF28
;'IF SYSINTEGERTEMPB.15 THEN SYSINTEGERTEMPB = -SYSINTEGERTEMPB
	COMF	SYSINTEGERTEMPB,F,ACCESS
	COMF	SYSINTEGERTEMPB_H,F,ACCESS
	INCF	SYSINTEGERTEMPB,F,ACCESS
	BTFSC	STATUS,2,ACCESS
	INCF	SYSINTEGERTEMPB_H,F,ACCESS
;'IF SYSINTEGERTEMPB.15 THEN SYSINTEGERTEMPB = -SYSINTEGERTEMPB
GLOBAL	ENDIF28
ENDIF28:
;'CALL WORD MULTIPLY ROUTINE
;'SYSMULTSUB16
	RCALL	SYSMULTSUB16
;'NEGATE RESULT IF NECESSARY
;'IF SYSSIGNBYTE.7 THEN SYSINTEGERTEMPX = -SYSINTEGERTEMPX
	BTFSS	SYSSIGNBYTE,7,ACCESS
	BRA	ENDIF29
;'IF SYSSIGNBYTE.7 THEN SYSINTEGERTEMPX = -SYSINTEGERTEMPX
	COMF	SYSINTEGERTEMPX,F,ACCESS
	COMF	SYSINTEGERTEMPX_H,F,ACCESS
	INCF	SYSINTEGERTEMPX,F,ACCESS
	BTFSC	STATUS,2,ACCESS
	INCF	SYSINTEGERTEMPX_H,F,ACCESS
;'IF SYSSIGNBYTE.7 THEN SYSINTEGERTEMPX = -SYSINTEGERTEMPX
GLOBAL	ENDIF29
ENDIF29:
	RETURN

;'********************************************************************************

;'SOURCE: SYSTEM.H (1646)
GLOBAL	SYSREADSTRING
SYSREADSTRING:
;'DIM SYSCALCTEMPA AS BYTE
;'DIM SYSSTRINGLENGTH AS BYTE
;'CHIPFAMILY 16 SUPPORT
;'GET LENGTH
;'TBLRD*+
	TBLRD*+
	;MOVFF	TABLAT,SYSCALCTEMPA
	MOVFF	TABLAT,SYSCALCTEMPA
	;MOVFF	TABLAT,INDF1
	MOVFF	TABLAT,INDF1
;'GOTO SYSSTRINGREADCHECK
	BRA	SYSSTRINGREADCHECK
GLOBAL	SYSREADSTRINGPART
SYSREADSTRINGPART:
;'TBLRD*+
	TBLRD*+
	;MOVF	TABLAT,W
	MOVF	TABLAT, W,ACCESS
;'MOVWF SYSCALCTEMPA
	MOVWF	SYSCALCTEMPA,ACCESS
;'ADDWF SYSSTRINGLENGTH,F
	ADDWF	SYSSTRINGLENGTH,F,ACCESS
;'CHECK LENGTH
GLOBAL	SYSSTRINGREADCHECK
SYSSTRINGREADCHECK:
;'IF LENGTH IS 0, EXIT
;'MOVF SYSCALCTEMPA,F
	MOVF	SYSCALCTEMPA,F,ACCESS
	;BTFSC	STATUS,2
	BTFSC	STATUS,2,ACCESS
;'RETURN
	RETURN
;'COPY
GLOBAL	SYSSTRINGREAD
SYSSTRINGREAD:
;'COPY CHAR
;'TBLRD*+
	TBLRD*+
	;MOVFF	TABLAT,PREINC1
	MOVFF	TABLAT,PREINC1
;'DECFSZ SYSCALCTEMPA, F
	DECFSZ	SYSCALCTEMPA, F,ACCESS
;'GOTO SYSSTRINGREAD
	BRA	SYSSTRINGREAD
	RETURN

;'********************************************************************************

GLOBAL	SYSSTRINGTABLES
SYSSTRINGTABLES:

GLOBAL	STRINGTABLE1
STRINGTABLE1:
	DB	7,71,67,66,65,83,73,67

	ALIGN	2;X3

GLOBAL	STRINGTABLE2
STRINGTABLE2:
	DB	12,65,110,111,98,105,117,109,32,50,48,50,52

	ALIGN	2;X3

GLOBAL	STRINGTABLE3
STRINGTABLE3:
	DB	21,71,76,67,68,32,80,111,114,116,97,98,105,108,105,116,121,32,68,101,109,111

	ALIGN	2;X3

GLOBAL	STRINGTABLE4
STRINGTABLE4:
	DB	9,71,76,67,68,80,114,105,110,116

	ALIGN	2;X3

GLOBAL	STRINGTABLE5
STRINGTABLE5:
	DB	1,64

	ALIGN	2;X3

GLOBAL	STRINGTABLE6
STRINGTABLE6:
	DB	3,77,104,122

	ALIGN	2;X3

GLOBAL	STRINGTABLE7
STRINGTABLE7:
	DB	7,68,114,97,119,83,116,114

	ALIGN	2;X3

GLOBAL	STRINGTABLE8
STRINGTABLE8:
	DB	1,104

	ALIGN	2;X3

GLOBAL	STRINGTABLE52
STRINGTABLE52:
	DB	1,32

	ALIGN	2;X3

GLOBAL	STRINGTABLE81
STRINGTABLE81:
	DB	0

	ALIGN	2;X3

GLOBAL	STRINGTABLE134
STRINGTABLE134:
	DB	8,49,56,70,49,54,81,50,48

	ALIGN	2;X3

;'********************************************************************************

;'SOURCE: GLCD_SSD1306.H (239)
GLOBAL	WRITE_COMMAND_SSD1306
WRITE_COMMAND_SSD1306:
;'HI2CSTART
	RCALL	SI2CSTART
;'HI2CSEND GLCD_I2C_ADDRESS
	MOVLW	120
	MOVWF	I2CBYTE,ACCESS
	RCALL	SI2CSEND
;'HI2CSEND 0X00
	CLRF	I2CBYTE,ACCESS
	RCALL	SI2CSEND
;'HI2CSEND SSD1306SENDBYTE
	MOVFF	SSD1306SENDBYTE,I2CBYTE
	RCALL	SI2CSEND
;'HI2CSTOP
	BRA	SI2CSTOP

;'********************************************************************************

;'SOURCE: GLCD_SSD1306.H (285)
GLOBAL	WRITE_DATA_SSD1306
WRITE_DATA_SSD1306:
;'HI2CSTART
	RCALL	SI2CSTART
;'HI2CSEND GLCD_I2C_ADDRESS
	MOVLW	120
	MOVWF	I2CBYTE,ACCESS
	RCALL	SI2CSEND
;'HI2CSEND 0X40
	MOVLW	64
	MOVWF	I2CBYTE,ACCESS
	RCALL	SI2CSEND
;'HI2CSEND SSD1306SENDBYTE
	MOVFF	SSD1306SENDBYTE,I2CBYTE
	RCALL	SI2CSEND
;'HI2CSTOP
	BRA	SI2CSTOP

;'********************************************************************************

;'SOURCE: PICAS.H (7)
GLOBAL	FN__HEXPICAS
FN__HEXPICAS:
;'_HEXPICAS(0) = 2
	MOVLW	2
	BANKSEL	SYS_HEXPICAS_0
	MOVWF	SYS_HEXPICAS_0,BANKED
;'DIM SYSSTRINGTEMP AS BYTE
;'LOW NIBBLE
;'SYSSTRINGTEMP = SYSVALTEMP AND 0X0F
	MOVLW	15
	BANKSEL	SYSVALTEMP
	ANDWF	SYSVALTEMP,W,BANKED
	MOVWF	SYSSTRINGTEMP,BANKED
;'IF SYSSTRINGTEMP > 9 THEN SYSSTRINGTEMP = SYSSTRINGTEMP + 7
	SUBLW	9
	BTFSC	STATUS,0,ACCESS
	BRA	ENDIF14
;'IF SYSSTRINGTEMP > 9 THEN SYSSTRINGTEMP = SYSSTRINGTEMP + 7
	MOVLW	7
	ADDWF	SYSSTRINGTEMP,F,BANKED
;'IF SYSSTRINGTEMP > 9 THEN SYSSTRINGTEMP = SYSSTRINGTEMP + 7
GLOBAL	ENDIF14
ENDIF14:
;'_HEXPICAS(2) = SYSSTRINGTEMP + 48
	MOVLW	48
	ADDWF	SYSSTRINGTEMP,W,BANKED
	BANKSEL	SYS_HEXPICAS_2
	MOVWF	SYS_HEXPICAS_2,BANKED
;'GET HIGH NIBBLE
;'FOR SYSSTRINGTEMP = 1 TO 4
;'LEGACY METHOD
	BANKSEL	SYSSTRINGTEMP
	CLRF	SYSSTRINGTEMP,BANKED
GLOBAL	SYSFORLOOP7
SYSFORLOOP7:
	INCF	SYSSTRINGTEMP,F,BANKED
;'ROTATE SYSVALTEMP RIGHT
	RRCF	SYSVALTEMP,F,BANKED
;'NEXT
	MOVLW	4
	SUBWF	SYSSTRINGTEMP,W,BANKED
	BTFSS	STATUS,0,ACCESS
	BRA	SYSFORLOOP7
GLOBAL	SYSFORLOOPEND7
SYSFORLOOPEND7:
;'SYSSTRINGTEMP = SYSVALTEMP AND 0X0F
	MOVLW	15
	ANDWF	SYSVALTEMP,W,BANKED
	MOVWF	SYSSTRINGTEMP,BANKED
;'IF SYSSTRINGTEMP > 9 THEN SYSSTRINGTEMP = SYSSTRINGTEMP + 7
	SUBLW	9
	BTFSC	STATUS,0,ACCESS
	BRA	ENDIF16
;'IF SYSSTRINGTEMP > 9 THEN SYSSTRINGTEMP = SYSSTRINGTEMP + 7
	MOVLW	7
	ADDWF	SYSSTRINGTEMP,F,BANKED
;'IF SYSSTRINGTEMP > 9 THEN SYSSTRINGTEMP = SYSSTRINGTEMP + 7
GLOBAL	ENDIF16
ENDIF16:
;'_HEXPICAS(1) = SYSSTRINGTEMP + 48
	MOVLW	48
	ADDWF	SYSSTRINGTEMP,W,BANKED
	BANKSEL	SYS_HEXPICAS_1
	MOVWF	SYS_HEXPICAS_1,BANKED
	BANKSEL	0
	RETURN

;'********************************************************************************

;'OVERLOADED SIGNATURE: WORD:WORD:WORD:WORD:WORD:, SOURCE: PICAS.H (29)
GLOBAL	_LINE69
_LINE69:
;'DIM LINESTEPX AS INTEGER
;'DIM LINESTEPY AS INTEGER
;'DIM LINEDIFFX, LINEDIFFY AS INTEGER
;'DIM LINEDIFFX_X2, LINEDIFFY_X2 AS INTEGER
;'DIM LINEERR AS INTEGER
;'LINEDIFFX = 0
	CLRF	LINEDIFFX,ACCESS
	CLRF	LINEDIFFX_H,ACCESS
;'LINEDIFFY = 0
	CLRF	LINEDIFFY,ACCESS
	CLRF	LINEDIFFY_H,ACCESS
;'LINESTEPX = 0
	CLRF	LINESTEPX,ACCESS
	CLRF	LINESTEPX_H,ACCESS
;'LINESTEPY = 0
	CLRF	LINESTEPY,ACCESS
	CLRF	LINESTEPY_H,ACCESS
;'LINEDIFFX_X2 = 0
	CLRF	LINEDIFFX_X2,ACCESS
	CLRF	LINEDIFFX_X2_H,ACCESS
;'LINEDIFFY_X2 = 0
	CLRF	LINEDIFFY_X2,ACCESS
	CLRF	LINEDIFFY_X2_H,ACCESS
;'LINEERR = 0
	CLRF	LINEERR,ACCESS
	CLRF	LINEERR_H,ACCESS
;'LINEDIFFX =  LINEX2 -   LINEX1
	MOVF	LINEX1,W,ACCESS
	BANKSEL	LINEX2
	SUBWF	LINEX2,W,BANKED
	MOVWF	LINEDIFFX,ACCESS
	MOVF	LINEX1_H,W,ACCESS
	SUBWFB	LINEX2_H,W,BANKED
	MOVWF	LINEDIFFX_H,ACCESS
;'LINEDIFFY =  LINEY2 -   LINEY1
	MOVF	LINEY1,W,BANKED
	SUBWF	LINEY2,W,BANKED
	MOVWF	LINEDIFFY,ACCESS
	MOVF	LINEY1_H,W,BANKED
	SUBWFB	LINEY2_H,W,BANKED
	MOVWF	LINEDIFFY_H,ACCESS
;'IF (LINEDIFFX > 0) THEN
	MOVFF	LINEDIFFX,SYSINTEGERTEMPB
	MOVFF	LINEDIFFX_H,SYSINTEGERTEMPB_H
	CLRF	SYSINTEGERTEMPA,ACCESS
	CLRF	SYSINTEGERTEMPA_H,ACCESS
	BANKSEL	0
	RCALL	SYSCOMPLESSTHANINT
	BTFSS	SYSBYTETEMPX,0,ACCESS
	BRA	ELSE17_1
;'LINESTEPX = 1
	MOVLW	1
	MOVWF	LINESTEPX,ACCESS
	CLRF	LINESTEPX_H,ACCESS
;'ELSE
	BRA	ENDIF17
GLOBAL	ELSE17_1
ELSE17_1:
;'LINESTEPX = -1
	SETF	LINESTEPX,ACCESS
	SETF	LINESTEPX_H,ACCESS
;'END IF
GLOBAL	ENDIF17
ENDIF17:
;'IF (LINEDIFFY > 0) THEN
	MOVFF	LINEDIFFY,SYSINTEGERTEMPB
	MOVFF	LINEDIFFY_H,SYSINTEGERTEMPB_H
	CLRF	SYSINTEGERTEMPA,ACCESS
	CLRF	SYSINTEGERTEMPA_H,ACCESS
	RCALL	SYSCOMPLESSTHANINT
	BTFSS	SYSBYTETEMPX,0,ACCESS
	BRA	ELSE18_1
;'LINESTEPY = 1
	MOVLW	1
	MOVWF	LINESTEPY,ACCESS
	CLRF	LINESTEPY_H,ACCESS
;'ELSE
	BRA	ENDIF18
GLOBAL	ELSE18_1
ELSE18_1:
;'LINESTEPY = -1
	SETF	LINESTEPY,ACCESS
	SETF	LINESTEPY_H,ACCESS
;'END IF
GLOBAL	ENDIF18
ENDIF18:
;'LINEDIFFX = LINESTEPX * LINEDIFFX
	MOVFF	LINESTEPX,SYSINTEGERTEMPA
	MOVFF	LINESTEPX_H,SYSINTEGERTEMPA_H
	MOVFF	LINEDIFFX,SYSINTEGERTEMPB
	MOVFF	LINEDIFFX_H,SYSINTEGERTEMPB_H
	RCALL	SYSMULTSUBINT
	MOVFF	SYSINTEGERTEMPX,LINEDIFFX
	MOVFF	SYSINTEGERTEMPX_H,LINEDIFFX_H
;'LINEDIFFY = LINESTEPY * LINEDIFFY
	MOVFF	LINESTEPY,SYSINTEGERTEMPA
	MOVFF	LINESTEPY_H,SYSINTEGERTEMPA_H
	MOVFF	LINEDIFFY,SYSINTEGERTEMPB
	MOVFF	LINEDIFFY_H,SYSINTEGERTEMPB_H
	RCALL	SYSMULTSUBINT
	MOVFF	SYSINTEGERTEMPX,LINEDIFFY
	MOVFF	SYSINTEGERTEMPX_H,LINEDIFFY_H
;'LINEDIFFX_X2 = LINEDIFFX*2
	MOVFF	LINEDIFFX,SYSINTEGERTEMPA
	MOVFF	LINEDIFFX_H,SYSINTEGERTEMPA_H
	MOVLW	2
	MOVWF	SYSINTEGERTEMPB,ACCESS
	CLRF	SYSINTEGERTEMPB_H,ACCESS
	RCALL	SYSMULTSUBINT
	MOVFF	SYSINTEGERTEMPX,LINEDIFFX_X2
	MOVFF	SYSINTEGERTEMPX_H,LINEDIFFX_X2_H
;'LINEDIFFY_X2 = LINEDIFFY*2
	MOVFF	LINEDIFFY,SYSINTEGERTEMPA
	MOVFF	LINEDIFFY_H,SYSINTEGERTEMPA_H
	MOVLW	2
	MOVWF	SYSINTEGERTEMPB,ACCESS
	CLRF	SYSINTEGERTEMPB_H,ACCESS
	RCALL	SYSMULTSUBINT
	MOVFF	SYSINTEGERTEMPX,LINEDIFFY_X2
	MOVFF	SYSINTEGERTEMPX_H,LINEDIFFY_X2_H
;'IF ( LINEDIFFX >= LINEDIFFY) THEN
	MOVFF	LINEDIFFX,SYSINTEGERTEMPA
	MOVFF	LINEDIFFX_H,SYSINTEGERTEMPA_H
	MOVFF	LINEDIFFY,SYSINTEGERTEMPB
	MOVFF	LINEDIFFY_H,SYSINTEGERTEMPB_H
	RCALL	SYSCOMPLESSTHANINT
	COMF	SYSBYTETEMPX,F,ACCESS
	BTFSS	SYSBYTETEMPX,0,ACCESS
	BRA	ELSE19_1
;'LINEERR = LINEDIFFY_X2 - LINEDIFFX
	MOVF	LINEDIFFX,W,ACCESS
	SUBWF	LINEDIFFY_X2,W,ACCESS
	MOVWF	LINEERR,ACCESS
	MOVF	LINEDIFFX_H,W,ACCESS
	SUBWFB	LINEDIFFY_X2_H,W,ACCESS
	MOVWF	LINEERR_H,ACCESS
;'DO WHILE (   LINEX1 <>  LINEX2 )
GLOBAL	SYSDOLOOP_S5
SYSDOLOOP_S5:
	MOVFF	LINEX1,SYSWORDTEMPA
	MOVFF	LINEX1_H,SYSWORDTEMPA_H
	MOVFF	LINEX2,SYSWORDTEMPB
	MOVFF	LINEX2_H,SYSWORDTEMPB_H
	BANKSEL	0
	RCALL	SYSCOMPEQUAL16
	COMF	SYSBYTETEMPX,F,ACCESS
	BTFSS	SYSBYTETEMPX,0,ACCESS
	BRA	SYSDOLOOP_E5
;'PSET (   LINEX1,   LINEY1, LINECOLOUR )
	MOVFF	LINEX1,GLCDX
	MOVFF	LINEY1,GLCDY
	MOVFF	LINECOLOUR,GLCDCOLOUR
	MOVFF	LINECOLOUR_H,GLCDCOLOUR_H
	CALL	PSET_SSD1306
;'LINEX1 += LINESTEPX
	MOVF	LINESTEPX,W,ACCESS
	ADDWF	LINEX1,F,ACCESS
	MOVF	LINESTEPX_H,W,ACCESS
	ADDWFC	LINEX1_H,F,ACCESS
;'IF ( LINEERR < 0) THEN
	MOVFF	LINEERR,SYSINTEGERTEMPA
	MOVFF	LINEERR_H,SYSINTEGERTEMPA_H
	CLRF	SYSINTEGERTEMPB,ACCESS
	CLRF	SYSINTEGERTEMPB_H,ACCESS
	RCALL	SYSCOMPLESSTHANINT
	BTFSS	SYSBYTETEMPX,0,ACCESS
	BRA	ELSE20_1
;'LINEERR += LINEDIFFY_X2
	MOVF	LINEDIFFY_X2,W,ACCESS
	ADDWF	LINEERR,F,ACCESS
	MOVF	LINEDIFFY_X2_H,W,ACCESS
	ADDWFC	LINEERR_H,F,ACCESS
;'ELSE
	BRA	ENDIF20
GLOBAL	ELSE20_1
ELSE20_1:
;'LINEERR += ( LINEDIFFY_X2 - LINEDIFFX_X2 )
	MOVF	LINEDIFFX_X2,W,ACCESS
	SUBWF	LINEDIFFY_X2,W,ACCESS
	BANKSEL	SYSTEMP2
	MOVWF	SYSTEMP2,BANKED
	MOVF	LINEDIFFX_X2_H,W,ACCESS
	SUBWFB	LINEDIFFY_X2_H,W,ACCESS
	MOVWF	SYSTEMP2_H,BANKED
	MOVF	SYSTEMP2,W,BANKED
	ADDWF	LINEERR,F,ACCESS
	MOVF	SYSTEMP2_H,W,BANKED
	ADDWFC	LINEERR_H,F,ACCESS
;'LINEY1 += LINESTEPY
	MOVF	LINESTEPY,W,ACCESS
	ADDWF	LINEY1,F,BANKED
	MOVF	LINESTEPY_H,W,ACCESS
	ADDWFC	LINEY1_H,F,BANKED
;'END IF
GLOBAL	ENDIF20
ENDIF20:
;'LOOP
	BRA	SYSDOLOOP_S5
GLOBAL	SYSDOLOOP_E5
SYSDOLOOP_E5:
;'PSET (   LINEX1,   LINEY1, LINECOLOUR )
	MOVFF	LINEX1,GLCDX
	MOVFF	LINEY1,GLCDY
	MOVFF	LINECOLOUR,GLCDCOLOUR
	MOVFF	LINECOLOUR_H,GLCDCOLOUR_H
	CALL	PSET_SSD1306
;'ELSE
	BRA	ENDIF19
GLOBAL	ELSE19_1
ELSE19_1:
;'LINEERR = LINEDIFFX_X2 - LINEDIFFY
	MOVF	LINEDIFFY,W,ACCESS
	SUBWF	LINEDIFFX_X2,W,ACCESS
	MOVWF	LINEERR,ACCESS
	MOVF	LINEDIFFY_H,W,ACCESS
	SUBWFB	LINEDIFFX_X2_H,W,ACCESS
	MOVWF	LINEERR_H,ACCESS
;'DO WHILE (   LINEY1 <>  LINEY2)
GLOBAL	SYSDOLOOP_S6
SYSDOLOOP_S6:
	MOVFF	LINEY1,SYSWORDTEMPA
	MOVFF	LINEY1_H,SYSWORDTEMPA_H
	MOVFF	LINEY2,SYSWORDTEMPB
	MOVFF	LINEY2_H,SYSWORDTEMPB_H
	BANKSEL	0
	RCALL	SYSCOMPEQUAL16
	COMF	SYSBYTETEMPX,F,ACCESS
	BTFSS	SYSBYTETEMPX,0,ACCESS
	BRA	SYSDOLOOP_E6
;'PSET (   LINEX1,   LINEY1, LINECOLOUR )
	MOVFF	LINEX1,GLCDX
	MOVFF	LINEY1,GLCDY
	MOVFF	LINECOLOUR,GLCDCOLOUR
	MOVFF	LINECOLOUR_H,GLCDCOLOUR_H
	CALL	PSET_SSD1306
;'LINEY1 += LINESTEPY
	MOVF	LINESTEPY,W,ACCESS
	BANKSEL	LINEY1
	ADDWF	LINEY1,F,BANKED
	MOVF	LINESTEPY_H,W,ACCESS
	ADDWFC	LINEY1_H,F,BANKED
;'IF ( LINEERR < 0) THEN
	MOVFF	LINEERR,SYSINTEGERTEMPA
	MOVFF	LINEERR_H,SYSINTEGERTEMPA_H
	CLRF	SYSINTEGERTEMPB,ACCESS
	CLRF	SYSINTEGERTEMPB_H,ACCESS
	BANKSEL	0
	RCALL	SYSCOMPLESSTHANINT
	BTFSS	SYSBYTETEMPX,0,ACCESS
	BRA	ELSE21_1
;'LINEERR += LINEDIFFX_X2
	MOVF	LINEDIFFX_X2,W,ACCESS
	ADDWF	LINEERR,F,ACCESS
	MOVF	LINEDIFFX_X2_H,W,ACCESS
	ADDWFC	LINEERR_H,F,ACCESS
;'ELSE
	BRA	ENDIF21
GLOBAL	ELSE21_1
ELSE21_1:
;'LINEERR += ( LINEDIFFX_X2 - LINEDIFFY_X2 )
	MOVF	LINEDIFFY_X2,W,ACCESS
	SUBWF	LINEDIFFX_X2,W,ACCESS
	BANKSEL	SYSTEMP2
	MOVWF	SYSTEMP2,BANKED
	MOVF	LINEDIFFY_X2_H,W,ACCESS
	SUBWFB	LINEDIFFX_X2_H,W,ACCESS
	MOVWF	SYSTEMP2_H,BANKED
	MOVF	SYSTEMP2,W,BANKED
	ADDWF	LINEERR,F,ACCESS
	MOVF	SYSTEMP2_H,W,BANKED
	ADDWFC	LINEERR_H,F,ACCESS
;'LINEX1 += LINESTEPX
	MOVF	LINESTEPX,W,ACCESS
	ADDWF	LINEX1,F,ACCESS
	MOVF	LINESTEPX_H,W,ACCESS
	ADDWFC	LINEX1_H,F,ACCESS
;'END IF
GLOBAL	ENDIF21
ENDIF21:
;'LOOP
	BRA	SYSDOLOOP_S6
GLOBAL	SYSDOLOOP_E6
SYSDOLOOP_E6:
;'PSET (   LINEX1,   LINEY1, LINECOLOUR )
	MOVFF	LINEX1,GLCDX
	MOVFF	LINEY1,GLCDY
	MOVFF	LINECOLOUR,GLCDCOLOUR
	MOVFF	LINECOLOUR_H,GLCDCOLOUR_H
	CALL	PSET_SSD1306
;'END IF
GLOBAL	ENDIF19
ENDIF19:
	RETURN

;'********************************************************************************

;'OVERLOADED SIGNATURE: WORD:WORD:WORD:WORD:LONG:, SOURCE: PICAS.H (107)
GLOBAL	_LINE70
_LINE70:
;'DIM LINESTEPX AS INTEGER
;'DIM LINESTEPY AS INTEGER
;'DIM LINEDIFFX, LINEDIFFY AS INTEGER
;'DIM LINEDIFFX_X2, LINEDIFFY_X2 AS INTEGER
;'DIM LINEERR AS INTEGER
;'LINEDIFFX = 0
	CLRF	LINEDIFFX,ACCESS
	CLRF	LINEDIFFX_H,ACCESS
;'LINEDIFFY = 0
	CLRF	LINEDIFFY,ACCESS
	CLRF	LINEDIFFY_H,ACCESS
;'LINESTEPX = 0
	CLRF	LINESTEPX,ACCESS
	CLRF	LINESTEPX_H,ACCESS
;'LINESTEPY = 0
	CLRF	LINESTEPY,ACCESS
	CLRF	LINESTEPY_H,ACCESS
;'LINEDIFFX_X2 = 0
	CLRF	LINEDIFFX_X2,ACCESS
	CLRF	LINEDIFFX_X2_H,ACCESS
;'LINEDIFFY_X2 = 0
	CLRF	LINEDIFFY_X2,ACCESS
	CLRF	LINEDIFFY_X2_H,ACCESS
;'LINEERR = 0
	CLRF	LINEERR,ACCESS
	CLRF	LINEERR_H,ACCESS
;'LINEDIFFX =  LINEX2 -   LINEX1
	MOVF	LINEX1,W,ACCESS
	BANKSEL	LINEX2
	SUBWF	LINEX2,W,BANKED
	MOVWF	LINEDIFFX,ACCESS
	MOVF	LINEX1_H,W,ACCESS
	SUBWFB	LINEX2_H,W,BANKED
	MOVWF	LINEDIFFX_H,ACCESS
;'LINEDIFFY =  LINEY2 -   LINEY1
	MOVF	LINEY1,W,BANKED
	SUBWF	LINEY2,W,BANKED
	MOVWF	LINEDIFFY,ACCESS
	MOVF	LINEY1_H,W,BANKED
	SUBWFB	LINEY2_H,W,BANKED
	MOVWF	LINEDIFFY_H,ACCESS
;'IF (LINEDIFFX > 0) THEN
	MOVFF	LINEDIFFX,SYSINTEGERTEMPB
	MOVFF	LINEDIFFX_H,SYSINTEGERTEMPB_H
	CLRF	SYSINTEGERTEMPA,ACCESS
	CLRF	SYSINTEGERTEMPA_H,ACCESS
	BANKSEL	0
	RCALL	SYSCOMPLESSTHANINT
	BTFSS	SYSBYTETEMPX,0,ACCESS
	BRA	ELSE22_1
;'LINESTEPX = 1
	MOVLW	1
	MOVWF	LINESTEPX,ACCESS
	CLRF	LINESTEPX_H,ACCESS
;'ELSE
	BRA	ENDIF22
GLOBAL	ELSE22_1
ELSE22_1:
;'LINESTEPX = -1
	SETF	LINESTEPX,ACCESS
	SETF	LINESTEPX_H,ACCESS
;'END IF
GLOBAL	ENDIF22
ENDIF22:
;'IF (LINEDIFFY > 0) THEN
	MOVFF	LINEDIFFY,SYSINTEGERTEMPB
	MOVFF	LINEDIFFY_H,SYSINTEGERTEMPB_H
	CLRF	SYSINTEGERTEMPA,ACCESS
	CLRF	SYSINTEGERTEMPA_H,ACCESS
	RCALL	SYSCOMPLESSTHANINT
	BTFSS	SYSBYTETEMPX,0,ACCESS
	BRA	ELSE23_1
;'LINESTEPY = 1
	MOVLW	1
	MOVWF	LINESTEPY,ACCESS
	CLRF	LINESTEPY_H,ACCESS
;'ELSE
	BRA	ENDIF23
GLOBAL	ELSE23_1
ELSE23_1:
;'LINESTEPY = -1
	SETF	LINESTEPY,ACCESS
	SETF	LINESTEPY_H,ACCESS
;'END IF
GLOBAL	ENDIF23
ENDIF23:
;'LINEDIFFX = LINESTEPX * LINEDIFFX
	MOVFF	LINESTEPX,SYSINTEGERTEMPA
	MOVFF	LINESTEPX_H,SYSINTEGERTEMPA_H
	MOVFF	LINEDIFFX,SYSINTEGERTEMPB
	MOVFF	LINEDIFFX_H,SYSINTEGERTEMPB_H
	RCALL	SYSMULTSUBINT
	MOVFF	SYSINTEGERTEMPX,LINEDIFFX
	MOVFF	SYSINTEGERTEMPX_H,LINEDIFFX_H
;'LINEDIFFY = LINESTEPY * LINEDIFFY
	MOVFF	LINESTEPY,SYSINTEGERTEMPA
	MOVFF	LINESTEPY_H,SYSINTEGERTEMPA_H
	MOVFF	LINEDIFFY,SYSINTEGERTEMPB
	MOVFF	LINEDIFFY_H,SYSINTEGERTEMPB_H
	RCALL	SYSMULTSUBINT
	MOVFF	SYSINTEGERTEMPX,LINEDIFFY
	MOVFF	SYSINTEGERTEMPX_H,LINEDIFFY_H
;'LINEDIFFX_X2 = LINEDIFFX*2
	MOVFF	LINEDIFFX,SYSINTEGERTEMPA
	MOVFF	LINEDIFFX_H,SYSINTEGERTEMPA_H
	MOVLW	2
	MOVWF	SYSINTEGERTEMPB,ACCESS
	CLRF	SYSINTEGERTEMPB_H,ACCESS
	RCALL	SYSMULTSUBINT
	MOVFF	SYSINTEGERTEMPX,LINEDIFFX_X2
	MOVFF	SYSINTEGERTEMPX_H,LINEDIFFX_X2_H
;'LINEDIFFY_X2 = LINEDIFFY*2
	MOVFF	LINEDIFFY,SYSINTEGERTEMPA
	MOVFF	LINEDIFFY_H,SYSINTEGERTEMPA_H
	MOVLW	2
	MOVWF	SYSINTEGERTEMPB,ACCESS
	CLRF	SYSINTEGERTEMPB_H,ACCESS
	RCALL	SYSMULTSUBINT
	MOVFF	SYSINTEGERTEMPX,LINEDIFFY_X2
	MOVFF	SYSINTEGERTEMPX_H,LINEDIFFY_X2_H
;'IF ( LINEDIFFX >= LINEDIFFY) THEN
	MOVFF	LINEDIFFX,SYSINTEGERTEMPA
	MOVFF	LINEDIFFX_H,SYSINTEGERTEMPA_H
	MOVFF	LINEDIFFY,SYSINTEGERTEMPB
	MOVFF	LINEDIFFY_H,SYSINTEGERTEMPB_H
	RCALL	SYSCOMPLESSTHANINT
	COMF	SYSBYTETEMPX,F,ACCESS
	BTFSS	SYSBYTETEMPX,0,ACCESS
	BRA	ELSE24_1
;'LINEERR = LINEDIFFY_X2 - LINEDIFFX
	MOVF	LINEDIFFX,W,ACCESS
	SUBWF	LINEDIFFY_X2,W,ACCESS
	MOVWF	LINEERR,ACCESS
	MOVF	LINEDIFFX_H,W,ACCESS
	SUBWFB	LINEDIFFY_X2_H,W,ACCESS
	MOVWF	LINEERR_H,ACCESS
;'DO WHILE (   LINEX1 <>  LINEX2 )
GLOBAL	SYSDOLOOP_S7
SYSDOLOOP_S7:
	MOVFF	LINEX1,SYSWORDTEMPA
	MOVFF	LINEX1_H,SYSWORDTEMPA_H
	MOVFF	LINEX2,SYSWORDTEMPB
	MOVFF	LINEX2_H,SYSWORDTEMPB_H
	BANKSEL	0
	RCALL	SYSCOMPEQUAL16
	COMF	SYSBYTETEMPX,F,ACCESS
	BTFSS	SYSBYTETEMPX,0,ACCESS
	BRA	SYSDOLOOP_E7
;'PSET (   LINEX1,   LINEY1, LINECOLOUR )
	MOVFF	LINEX1,GLCDX
	MOVFF	LINEY1,GLCDY
	MOVFF	LINECOLOUR,GLCDCOLOUR
	MOVFF	LINECOLOUR_H,GLCDCOLOUR_H
	CALL	PSET_SSD1306
;'LINEX1 += LINESTEPX
	MOVF	LINESTEPX,W,ACCESS
	ADDWF	LINEX1,F,ACCESS
	MOVF	LINESTEPX_H,W,ACCESS
	ADDWFC	LINEX1_H,F,ACCESS
;'IF ( LINEERR < 0) THEN
	MOVFF	LINEERR,SYSINTEGERTEMPA
	MOVFF	LINEERR_H,SYSINTEGERTEMPA_H
	CLRF	SYSINTEGERTEMPB,ACCESS
	CLRF	SYSINTEGERTEMPB_H,ACCESS
	RCALL	SYSCOMPLESSTHANINT
	BTFSS	SYSBYTETEMPX,0,ACCESS
	BRA	ELSE25_1
;'LINEERR += LINEDIFFY_X2
	MOVF	LINEDIFFY_X2,W,ACCESS
	ADDWF	LINEERR,F,ACCESS
	MOVF	LINEDIFFY_X2_H,W,ACCESS
	ADDWFC	LINEERR_H,F,ACCESS
;'ELSE
	BRA	ENDIF25
GLOBAL	ELSE25_1
ELSE25_1:
;'LINEERR += ( LINEDIFFY_X2 - LINEDIFFX_X2 )
	MOVF	LINEDIFFX_X2,W,ACCESS
	SUBWF	LINEDIFFY_X2,W,ACCESS
	BANKSEL	SYSTEMP2
	MOVWF	SYSTEMP2,BANKED
	MOVF	LINEDIFFX_X2_H,W,ACCESS
	SUBWFB	LINEDIFFY_X2_H,W,ACCESS
	MOVWF	SYSTEMP2_H,BANKED
	MOVF	SYSTEMP2,W,BANKED
	ADDWF	LINEERR,F,ACCESS
	MOVF	SYSTEMP2_H,W,BANKED
	ADDWFC	LINEERR_H,F,ACCESS
;'LINEY1 += LINESTEPY
	MOVF	LINESTEPY,W,ACCESS
	ADDWF	LINEY1,F,BANKED
	MOVF	LINESTEPY_H,W,ACCESS
	ADDWFC	LINEY1_H,F,BANKED
;'END IF
GLOBAL	ENDIF25
ENDIF25:
;'LOOP
	BRA	SYSDOLOOP_S7
GLOBAL	SYSDOLOOP_E7
SYSDOLOOP_E7:
;'PSET (   LINEX1,   LINEY1, LINECOLOUR )
	MOVFF	LINEX1,GLCDX
	MOVFF	LINEY1,GLCDY
	MOVFF	LINECOLOUR,GLCDCOLOUR
	MOVFF	LINECOLOUR_H,GLCDCOLOUR_H
	CALL	PSET_SSD1306
;'ELSE
	BRA	ENDIF24
GLOBAL	ELSE24_1
ELSE24_1:
;'LINEERR = LINEDIFFX_X2 - LINEDIFFY
	MOVF	LINEDIFFY,W,ACCESS
	SUBWF	LINEDIFFX_X2,W,ACCESS
	MOVWF	LINEERR,ACCESS
	MOVF	LINEDIFFY_H,W,ACCESS
	SUBWFB	LINEDIFFX_X2_H,W,ACCESS
	MOVWF	LINEERR_H,ACCESS
;'DO WHILE (   LINEY1 <>  LINEY2)
GLOBAL	SYSDOLOOP_S8
SYSDOLOOP_S8:
	MOVFF	LINEY1,SYSWORDTEMPA
	MOVFF	LINEY1_H,SYSWORDTEMPA_H
	MOVFF	LINEY2,SYSWORDTEMPB
	MOVFF	LINEY2_H,SYSWORDTEMPB_H
	BANKSEL	0
	RCALL	SYSCOMPEQUAL16
	COMF	SYSBYTETEMPX,F,ACCESS
	BTFSS	SYSBYTETEMPX,0,ACCESS
	BRA	SYSDOLOOP_E8
;'PSET (   LINEX1,   LINEY1, LINECOLOUR )
	MOVFF	LINEX1,GLCDX
	MOVFF	LINEY1,GLCDY
	MOVFF	LINECOLOUR,GLCDCOLOUR
	MOVFF	LINECOLOUR_H,GLCDCOLOUR_H
	CALL	PSET_SSD1306
;'LINEY1 += LINESTEPY
	MOVF	LINESTEPY,W,ACCESS
	BANKSEL	LINEY1
	ADDWF	LINEY1,F,BANKED
	MOVF	LINESTEPY_H,W,ACCESS
	ADDWFC	LINEY1_H,F,BANKED
;'IF ( LINEERR < 0) THEN
	MOVFF	LINEERR,SYSINTEGERTEMPA
	MOVFF	LINEERR_H,SYSINTEGERTEMPA_H
	CLRF	SYSINTEGERTEMPB,ACCESS
	CLRF	SYSINTEGERTEMPB_H,ACCESS
	BANKSEL	0
	RCALL	SYSCOMPLESSTHANINT
	BTFSS	SYSBYTETEMPX,0,ACCESS
	BRA	ELSE26_1
;'LINEERR += LINEDIFFX_X2
	MOVF	LINEDIFFX_X2,W,ACCESS
	ADDWF	LINEERR,F,ACCESS
	MOVF	LINEDIFFX_X2_H,W,ACCESS
	ADDWFC	LINEERR_H,F,ACCESS
;'ELSE
	BRA	ENDIF26
GLOBAL	ELSE26_1
ELSE26_1:
;'LINEERR += ( LINEDIFFX_X2 - LINEDIFFY_X2 )
	MOVF	LINEDIFFY_X2,W,ACCESS
	SUBWF	LINEDIFFX_X2,W,ACCESS
	BANKSEL	SYSTEMP2
	MOVWF	SYSTEMP2,BANKED
	MOVF	LINEDIFFY_X2_H,W,ACCESS
	SUBWFB	LINEDIFFX_X2_H,W,ACCESS
	MOVWF	SYSTEMP2_H,BANKED
	MOVF	SYSTEMP2,W,BANKED
	ADDWF	LINEERR,F,ACCESS
	MOVF	SYSTEMP2_H,W,BANKED
	ADDWFC	LINEERR_H,F,ACCESS
;'LINEX1 += LINESTEPX
	MOVF	LINESTEPX,W,ACCESS
	ADDWF	LINEX1,F,ACCESS
	MOVF	LINESTEPX_H,W,ACCESS
	ADDWFC	LINEX1_H,F,ACCESS
;'END IF
GLOBAL	ENDIF26
ENDIF26:
;'LOOP
	BRA	SYSDOLOOP_S8
GLOBAL	SYSDOLOOP_E8
SYSDOLOOP_E8:
;'PSET (   LINEX1,   LINEY1, LINECOLOUR )
	MOVFF	LINEX1,GLCDX
	MOVFF	LINEY1,GLCDY
	MOVFF	LINECOLOUR,GLCDCOLOUR
	MOVFF	LINECOLOUR_H,GLCDCOLOUR_H
	CALL	PSET_SSD1306
;'END IF
GLOBAL	ENDIF24
ENDIF24:
	RETURN

;'********************************************************************************

	ALIGN	2;X2
;'
;' Declare Power-On-Reset entry point
;'
 END     RESETVEC
