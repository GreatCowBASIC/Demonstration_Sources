;Program compiled by GCBASIC (1.00.00 Release Candidate 2022-09-11 (Windows 64 bit) : Build 1168x) for Microchip PIC-AS
;  See the GCBASIC forums at http://sourceforge.net/projects/gcbasic/forums,
;  Check the documentation and Help at http://gcbasic.sourceforge.net/help/,
;or, email:
;   evanvennn at users dot sourceforge dot net

;********************************************************************************


;Set up the assembler options (Chip type, clock source, other bits and pieces)
;PROCESSOR   16F18075
 PAGEWIDTH   180
 RADIX       DEC
 TITLE       "d:\GreatCowBASICGits\Demonstration_Sources.git\trunk\Vendor_Boards\Great_Cow_Basic_Demo_Board\16f18075_chiprange_demonstrations\260_spi_glcd_using_ili9341.s"
 SUBTITLE    "09-11-2022"

; Reverse lookup file(s)
; C:\Program Files\Microchip\xc8\v2.40\pic\include\proc\pic16f18075.inc
; C:\Program Files\Microchip\xc8\v2.40\pic\dat\cfgmap\16f18075.cfgmap
; Alternative CONFIG file is to be found at C:\Program Files\Microchip\xc8\vX.YY\pic\dat\cfgdata as per Microchip support ticket #00730936 

;********************************************************************************

;********************************************************************************
;Explicit CONFIG
 CONFIG CLKOUTEN=OFF                             ;C1 Reverselookup CLKOUTEN = OFF
 CONFIG RSTOSC=HFINTOSC_32MHz                    ;C1 Reverselookup RSTOSC = HFINTOSC_32MHZ
 CONFIG FEXTOSC=OFF                              ;C1 Reverselookup FEXTOSC = OFF
 CONFIG WDTE=OFF                                 ;C1 Reverselookup WDTE = OFF
 CONFIG MCLRE=INTMCLR                            ;C1 Reverselookup MCLRE = INTMCLR
 CONFIG LVP=OFF                                  ;C1 Reverselookup LVP = OFF
 CONFIG WRTSAF=OFF                               ;C1 Reverselookup WRTSAF = OFF
 CONFIG WRTD=OFF                                 ;C1 Reverselookup WRTD = OFF
 CONFIG WRTB=OFF                                 ;C1 Reverselookup WRTB = OFF
 CONFIG CPD=OFF                                  ;C1 Reverselookup CPD = OFF
 CONFIG CP=OFF                                   ;C1 Reverselookup CP = OFF
;Inferred CONFIG


;********************************************************************************
; The XC8 xc.inc include file.  This MUST be placed after the CONFIG statements.

 #include <xc.inc>

;********************************************************************************

;Set aside RAM memory locations for variables. All variables are global.
GLOBAL	BYTENUMBER
 BYTENUMBER                       EQU 32          ; 0X20
GLOBAL	CCOUNT
 CCOUNT                           EQU 33          ; 0X21
GLOBAL	CHARCODE
 CHARCODE                         EQU 34          ; 0X22
GLOBAL	CHARCOL
 CHARCOL                          EQU 35          ; 0X23
GLOBAL	CHARCOLS
 CHARCOLS                         EQU 37          ; 0X25
GLOBAL	CHARCOL_H
 CHARCOL_H                        EQU 36          ; 0X24
GLOBAL	CHARLOCX
 CHARLOCX                         EQU 38          ; 0X26
GLOBAL	CHARLOCX_H
 CHARLOCX_H                       EQU 39          ; 0X27
GLOBAL	CHARLOCY
 CHARLOCY                         EQU 40          ; 0X28
GLOBAL	CHARLOCY_H
 CHARLOCY_H                       EQU 41          ; 0X29
GLOBAL	CHARROW
 CHARROW                          EQU 42          ; 0X2A
GLOBAL	CHARROWS
 CHARROWS                         EQU 44          ; 0X2C
GLOBAL	CHARROW_H
 CHARROW_H                        EQU 43          ; 0X2B
GLOBAL	COL
 COL                              EQU 45          ; 0X2D
GLOBAL	CURRCHARCOL
 CURRCHARCOL                      EQU 46          ; 0X2E
GLOBAL	CURRCHARROW
 CURRCHARROW                      EQU 47          ; 0X2F
GLOBAL	CURRCHARVAL
 CURRCHARVAL                      EQU 48          ; 0X30
GLOBAL	DELAYTEMP
 DELAYTEMP                        EQU 112          ; 0X70
GLOBAL	DELAYTEMP2
 DELAYTEMP2                       EQU 113          ; 0X71
GLOBAL	GLCDBACKGROUND
 GLCDBACKGROUND                   EQU 49          ; 0X31
GLOBAL	GLCDBACKGROUND_H
 GLCDBACKGROUND_H                 EQU 50          ; 0X32
GLOBAL	GLCDCOLOUR
 GLCDCOLOUR                       EQU 51          ; 0X33
GLOBAL	GLCDCOLOUR_H
 GLCDCOLOUR_H                     EQU 52          ; 0X34
GLOBAL	GLCDDEVICEHEIGHT
 GLCDDEVICEHEIGHT                 EQU 53          ; 0X35
GLOBAL	GLCDDEVICEHEIGHT_H
 GLCDDEVICEHEIGHT_H               EQU 54          ; 0X36
GLOBAL	GLCDDEVICEWIDTH
 GLCDDEVICEWIDTH                  EQU 55          ; 0X37
GLOBAL	GLCDDEVICEWIDTH_H
 GLCDDEVICEWIDTH_H                EQU 56          ; 0X38
GLOBAL	GLCDFNTDEFAULT
 GLCDFNTDEFAULT                   EQU 57          ; 0X39
GLOBAL	GLCDFNTDEFAULTHEIGHT
 GLCDFNTDEFAULTHEIGHT             EQU 58          ; 0X3A
GLOBAL	GLCDFNTDEFAULTSIZE
 GLCDFNTDEFAULTSIZE               EQU 59          ; 0X3B
GLOBAL	GLCDFONTWIDTH
 GLCDFONTWIDTH                    EQU 60          ; 0X3C
GLOBAL	GLCDFOREGROUND
 GLCDFOREGROUND                   EQU 61          ; 0X3D
GLOBAL	GLCDFOREGROUND_H
 GLCDFOREGROUND_H                 EQU 62          ; 0X3E
GLOBAL	GLCDPRINTLEN
 GLCDPRINTLEN                     EQU 63          ; 0X3F
GLOBAL	GLCDPRINTLOC
 GLCDPRINTLOC                     EQU 64          ; 0X40
GLOBAL	GLCDPRINTLOC_H
 GLCDPRINTLOC_H                   EQU 65          ; 0X41
GLOBAL	GLCDPRINT_STRING_COUNTER
 GLCDPRINT_STRING_COUNTER         EQU 66          ; 0X42
GLOBAL	GLCDROTATESTATE
 GLCDROTATESTATE                  EQU 67          ; 0X43
GLOBAL	GLCDX
 GLCDX                            EQU 68          ; 0X44
GLOBAL	GLCDX_H
 GLCDX_H                          EQU 69          ; 0X45
GLOBAL	GLCDY
 GLCDY                            EQU 70          ; 0X46
GLOBAL	GLCDY_H
 GLCDY_H                          EQU 71          ; 0X47
GLOBAL	GLCD_YORDINATE
 GLCD_YORDINATE                   EQU 72          ; 0X48
GLOBAL	GLCD_YORDINATE_H
 GLCD_YORDINATE_H                 EQU 73          ; 0X49
GLOBAL	ILI9341SENDBYTE
 ILI9341SENDBYTE                  EQU 74          ; 0X4A
GLOBAL	ILI9341SENDWORD
 ILI9341SENDWORD                  EQU 75          ; 0X4B
GLOBAL	ILI9341SENDWORD_H
 ILI9341SENDWORD_H                EQU 76          ; 0X4C
GLOBAL	ILI9341TEMPOUT
 ILI9341TEMPOUT                   EQU 77          ; 0X4D
GLOBAL	LCDVALUE
 LCDVALUE                         EQU 78          ; 0X4E
GLOBAL	LCDVALUE_E
 LCDVALUE_E                       EQU 81          ; 0X51
GLOBAL	LCDVALUE_H
 LCDVALUE_H                       EQU 79          ; 0X4F
GLOBAL	LCDVALUE_U
 LCDVALUE_U                       EQU 80          ; 0X50
GLOBAL	LINECOLOUR
 LINECOLOUR                       EQU 82          ; 0X52
GLOBAL	LINECOLOUR_H
 LINECOLOUR_H                     EQU 83          ; 0X53
GLOBAL	LONGNUMBER
 LONGNUMBER                       EQU 84          ; 0X54
GLOBAL	LONGNUMBER_E
 LONGNUMBER_E                     EQU 87          ; 0X57
GLOBAL	LONGNUMBER_H
 LONGNUMBER_H                     EQU 85          ; 0X55
GLOBAL	LONGNUMBER_U
 LONGNUMBER_U                     EQU 86          ; 0X56
GLOBAL	PRINTLOCX
 PRINTLOCX                        EQU 88          ; 0X58
GLOBAL	PRINTLOCX_H
 PRINTLOCX_H                      EQU 89          ; 0X59
GLOBAL	PRINTLOCY
 PRINTLOCY                        EQU 90          ; 0X5A
GLOBAL	PRINTLOCY_H
 PRINTLOCY_H                      EQU 91          ; 0X5B
GLOBAL	ROW
 ROW                              EQU 92          ; 0X5C
GLOBAL	SPICLOCKMODE
 SPICLOCKMODE                     EQU 93          ; 0X5D
GLOBAL	SPICURRENTMODE
 SPICURRENTMODE                   EQU 94          ; 0X5E
GLOBAL	SPIRXDATA
 SPIRXDATA                        EQU 95          ; 0X5F
GLOBAL	SPITXDATA
 SPITXDATA                        EQU 96          ; 0X60
GLOBAL	STRINGPOINTER
 STRINGPOINTER                    EQU 97          ; 0X61
GLOBAL	SYSBYTETEMPA
 SYSBYTETEMPA                     EQU 117          ; 0X75
GLOBAL	SYSBYTETEMPB
 SYSBYTETEMPB                     EQU 121          ; 0X79
GLOBAL	SYSBYTETEMPX
 SYSBYTETEMPX                     EQU 112          ; 0X70
GLOBAL	SYSCALCTEMPA
 SYSCALCTEMPA                     EQU 117          ; 0X75
GLOBAL	SYSCALCTEMPA_E
 SYSCALCTEMPA_E                   EQU 120          ; 0X78
GLOBAL	SYSCALCTEMPA_H
 SYSCALCTEMPA_H                   EQU 118          ; 0X76
GLOBAL	SYSCALCTEMPA_U
 SYSCALCTEMPA_U                   EQU 119          ; 0X77
GLOBAL	SYSDIVLOOP
 SYSDIVLOOP                       EQU 116          ; 0X74
GLOBAL	SYSDIVMULTA
 SYSDIVMULTA                      EQU 119          ; 0X77
GLOBAL	SYSDIVMULTA_H
 SYSDIVMULTA_H                    EQU 120          ; 0X78
GLOBAL	SYSFORLOOPSTEP1
 SYSFORLOOPSTEP1                  EQU 98          ; 0X62
GLOBAL	SYSFORLOOPSTEP1_H
 SYSFORLOOPSTEP1_H                EQU 99          ; 0X63
GLOBAL	SYSINTEGERTEMPA
 SYSINTEGERTEMPA                  EQU 117          ; 0X75
GLOBAL	SYSINTEGERTEMPA_H
 SYSINTEGERTEMPA_H                EQU 118          ; 0X76
GLOBAL	SYSINTEGERTEMPB
 SYSINTEGERTEMPB                  EQU 121          ; 0X79
GLOBAL	SYSINTEGERTEMPB_H
 SYSINTEGERTEMPB_H                EQU 122          ; 0X7A
GLOBAL	SYSLCDPRINTDATAHANDLER
 SYSLCDPRINTDATAHANDLER           EQU 100          ; 0X64
GLOBAL	SYSLCDPRINTDATAHANDLER_H
 SYSLCDPRINTDATAHANDLER_H         EQU 101          ; 0X65
GLOBAL	SYSLONGDIVMULTA
 SYSLONGDIVMULTA                  EQU 102          ; 0X66
GLOBAL	SYSLONGDIVMULTA_E
 SYSLONGDIVMULTA_E                EQU 105          ; 0X69
GLOBAL	SYSLONGDIVMULTA_H
 SYSLONGDIVMULTA_H                EQU 103          ; 0X67
GLOBAL	SYSLONGDIVMULTA_U
 SYSLONGDIVMULTA_U                EQU 104          ; 0X68
GLOBAL	SYSLONGDIVMULTB
 SYSLONGDIVMULTB                  EQU 106          ; 0X6A
GLOBAL	SYSLONGDIVMULTB_E
 SYSLONGDIVMULTB_E                EQU 109          ; 0X6D
GLOBAL	SYSLONGDIVMULTB_H
 SYSLONGDIVMULTB_H                EQU 107          ; 0X6B
GLOBAL	SYSLONGDIVMULTB_U
 SYSLONGDIVMULTB_U                EQU 108          ; 0X6C
GLOBAL	SYSLONGDIVMULTX
 SYSLONGDIVMULTX                  EQU 160          ; 0XA0
GLOBAL	SYSLONGDIVMULTX_E
 SYSLONGDIVMULTX_E                EQU 163          ; 0XA3
GLOBAL	SYSLONGDIVMULTX_H
 SYSLONGDIVMULTX_H                EQU 161          ; 0XA1
GLOBAL	SYSLONGDIVMULTX_U
 SYSLONGDIVMULTX_U                EQU 162          ; 0XA2
GLOBAL	SYSLONGTEMPA
 SYSLONGTEMPA                     EQU 117          ; 0X75
GLOBAL	SYSLONGTEMPA_E
 SYSLONGTEMPA_E                   EQU 120          ; 0X78
GLOBAL	SYSLONGTEMPA_H
 SYSLONGTEMPA_H                   EQU 118          ; 0X76
GLOBAL	SYSLONGTEMPA_U
 SYSLONGTEMPA_U                   EQU 119          ; 0X77
GLOBAL	SYSLONGTEMPB
 SYSLONGTEMPB                     EQU 121          ; 0X79
GLOBAL	SYSLONGTEMPB_E
 SYSLONGTEMPB_E                   EQU 124          ; 0X7C
GLOBAL	SYSLONGTEMPB_H
 SYSLONGTEMPB_H                   EQU 122          ; 0X7A
GLOBAL	SYSLONGTEMPB_U
 SYSLONGTEMPB_U                   EQU 123          ; 0X7B
GLOBAL	SYSLONGTEMPX
 SYSLONGTEMPX                     EQU 112          ; 0X70
GLOBAL	SYSLONGTEMPX_E
 SYSLONGTEMPX_E                   EQU 115          ; 0X73
GLOBAL	SYSLONGTEMPX_H
 SYSLONGTEMPX_H                   EQU 113          ; 0X71
GLOBAL	SYSLONGTEMPX_U
 SYSLONGTEMPX_U                   EQU 114          ; 0X72
GLOBAL	SYSPRINTBUFFER
 SYSPRINTBUFFER                   EQU 9189          ; 0X23E5
GLOBAL	SYSPRINTBUFFLEN
 SYSPRINTBUFFLEN                  EQU 110          ; 0X6E
GLOBAL	SYSREPEATTEMP1
 SYSREPEATTEMP1                   EQU 111          ; 0X6F
GLOBAL	SYSREPEATTEMP2
 SYSREPEATTEMP2                   EQU 164          ; 0XA4
GLOBAL	SYSREPEATTEMP3
 SYSREPEATTEMP3                   EQU 165          ; 0XA5
GLOBAL	SYSREPEATTEMP3_H
 SYSREPEATTEMP3_H                 EQU 166          ; 0XA6
GLOBAL	SYSSTRINGA
 SYSSTRINGA                       EQU 119          ; 0X77
GLOBAL	SYSSTRINGA_H
 SYSSTRINGA_H                     EQU 120          ; 0X78
GLOBAL	SYSTEMP1
 SYSTEMP1                         EQU 167          ; 0XA7
GLOBAL	SYSTEMP1_E
 SYSTEMP1_E                       EQU 170          ; 0XAA
GLOBAL	SYSTEMP1_H
 SYSTEMP1_H                       EQU 168          ; 0XA8
GLOBAL	SYSTEMP1_U
 SYSTEMP1_U                       EQU 169          ; 0XA9
GLOBAL	SYSTEMP2
 SYSTEMP2                         EQU 171          ; 0XAB
GLOBAL	SYSTEMP2_H
 SYSTEMP2_H                       EQU 172          ; 0XAC
GLOBAL	SYSTEMP3
 SYSTEMP3                         EQU 173          ; 0XAD
GLOBAL	SYSWAITTEMPMS
 SYSWAITTEMPMS                    EQU 114          ; 0X72
GLOBAL	SYSWAITTEMPMS_H
 SYSWAITTEMPMS_H                  EQU 115          ; 0X73
GLOBAL	SYSWAITTEMPS
 SYSWAITTEMPS                     EQU 116          ; 0X74
GLOBAL	SYSWAITTEMPUS
 SYSWAITTEMPUS                    EQU 117          ; 0X75
GLOBAL	SYSWAITTEMPUS_H
 SYSWAITTEMPUS_H                  EQU 118          ; 0X76
GLOBAL	WORDNUMBER
 WORDNUMBER                       EQU 174          ; 0XAE
GLOBAL	WORDNUMBER_H
 WORDNUMBER_H                     EQU 175          ; 0XAF
GLOBAL	_X1
 _X1                              EQU 176          ; 0XB0
GLOBAL	_X1_H
 _X1_H                            EQU 177          ; 0XB1
GLOBAL	_X2
 _X2                              EQU 178          ; 0XB2
GLOBAL	_X2_H
 _X2_H                            EQU 179          ; 0XB3
GLOBAL	_Y1
 _Y1                              EQU 180          ; 0XB4
GLOBAL	_Y1_H
 _Y1_H                            EQU 181          ; 0XB5
GLOBAL	_Y2
 _Y2                              EQU 182          ; 0XB6
GLOBAL	_Y2_H
 _Y2_H                            EQU 183          ; 0XB7

;********************************************************************************

;ALIAS VARIABLES
GLOBAL	AFSR0
 AFSR0                            EQU 4
GLOBAL	AFSR0_H
 AFSR0_H                          EQU 5

;********************************************************************************

 PSECT   PROGMEM0,delta=2, abs
 RESETVEC:
;VECTORS
	ORG	0
	PAGESEL	BASPROGRAMSTART
	GOTO	BASPROGRAMSTART
	ORG	4
	RETFIE

;********************************************************************************

;START OF PROGRAM MEMORY PAGE 0
	ORG	5
GLOBAL	BASPROGRAMSTART
BASPROGRAMSTART:
;CALL INITIALISATION ROUTINES
	CALL	INITSYS
	CALL	INITPPS
	CALL	INITGLCD_ILI9341

;START OF THE MAIN PROGRAM
;''A demonstration program for GCBASIC.
;''--------------------------------------------------------------------------------------------------------------------------------
;''This program is a simple GLCD demonstration of the ILI9341 GLCD capabilities.
;''It is a nice graphical LCD, suitable for a lot of various projects.
;''This program draws lines, boxes, circles and prints strings and numbers.
;''The GLCD is connected to the microprocessor as shown in the hardware section of this code.
;'':
;''This has been tested using the hardware and software SPI option.  If you change from harware SPI when using PPS, you will need to power cycle the chip.
;'':
;'':
;''@author  EvanV
;''@licence GPL
;''@version 1.0
;''@date    15/09/2022
;''********************************************************************************
;Chip Settings
;Generated by PIC PPS Tool for GCBASIC
;PPS Tool version: 0.0.6.1
;PinManager data: v1.79.0
;Generated for 16F18075
;
;Template comment at the start of the config file
;
;Template comment at the end of the config file
;Pin mappings for ILI9341
;This is a PPS chip, so, needs to make the PPS match these assignments
;The following example is commented out intentionally
;#define GLCD_DI portc.4
;Comment out the next line... disable the PPS!!!
;********************** DEMO REALLY STARTS HERE ************************************************
;GLCDfntDefaultSize = 1
	MOVLW	1
	MOVWF	GLCDFNTDEFAULTSIZE
;GLCDCLS  supports GLCDBackground as default
;GLCDCLS  also support passing color parameter.
;GLCDCLS [color]
;optionally you can rotate the screen.
;GLCDRotate ( Landscape_Rev )
	MOVLW	3
	MOVWF	GLCDROTATESTATE
	FCALL	GLCDROTATE_ILI9341
;Available colors
;ILI9341_BLACK
;ILI9341_RED
;ILI9341_GREEN
;ILI9341_BLUE
;ILI9341_WHITE
;ILI9341_PURPLE
;ILI9341_YELLOW
;ILI9341_CYAN
;ILI9341_D_GRAY
;ILI9341_L_GRAY
;ILI9341_SILVER
;ILI9341_MAROON
;ILI9341_OLIVE
;ILI9341_LIME
;ILI9341_AQUA
;ILI9341_TEAL
;ILI9341_NAVY
;ILI9341_FUCHSIA
;Dim CCOUNT, BYTENUMBER, OLDFONT, OLDFONT As Byte
;CCount = 31
	MOVLW	31
	MOVWF	CCOUNT
;Dim longNumber As Long
;max value = 4294967290
;longNumber = 0
	CLRF	LONGNUMBER
	CLRF	LONGNUMBER_H
	CLRF	LONGNUMBER_U
	CLRF	LONGNUMBER_E
;Dim wordNumber As Word
;wordNumber = 0
	BANKSEL	WORDNUMBER
	CLRF	WORDNUMBER
	CLRF	WORDNUMBER_H
;byteNumber = 0
	BANKSEL	BYTENUMBER
	CLRF	BYTENUMBER
;Repeat 2
	MOVLW	2
	MOVWF	SYSREPEATTEMP1
GLOBAL	SYSREPEATLOOP1
SYSREPEATLOOP1:
;GLCDRotate ( Landscape_Rev )
	MOVLW	3
	MOVWF	GLCDROTATESTATE
	FCALL	GLCDROTATE_ILI9341
;GLCDCLS ILI9341_BLUE
	MOVLW	31
	MOVWF	GLCDBACKGROUND
	CLRF	GLCDBACKGROUND_H
	CALL	GLCDCLS_ILI9341
;Wait 2 s
	MOVLW	2
	MOVWF	SYSWAITTEMPS
	FCALL	DELAY_S
;GLCDForeground = ILI9341_YELLOW
	MOVLW	224
	MOVWF	GLCDFOREGROUND
	MOVLW	255
	MOVWF	GLCDFOREGROUND_H
;GLCDfntDefaultSize = 3
	MOVLW	3
	MOVWF	GLCDFNTDEFAULTSIZE
;GLCDPrint ( 2,30, "GLCDPrint String" )
	MOVLW	2
	MOVWF	PRINTLOCX
	CLRF	PRINTLOCX_H
	MOVLW	30
	MOVWF	PRINTLOCY
	CLRF	PRINTLOCY_H
	MOVLW	LOW STRINGTABLE1
	MOVWF	SYSLCDPRINTDATAHANDLER
	MOVLW	(HIGH STRINGTABLE1) | 128
	MOVWF	SYSLCDPRINTDATAHANDLER_H
	CALL	GLCDPRINT5
;longNumber = 0xFFFFFFFF
	MOVLW	255
	MOVWF	LONGNUMBER
	MOVWF	LONGNUMBER_H
	MOVWF	LONGNUMBER_U
	MOVWF	LONGNUMBER_E
;wordNumber = 0xFFFF
	MOVLW	255
	BANKSEL	WORDNUMBER
	MOVWF	WORDNUMBER
	MOVWF	WORDNUMBER_H
;byteNumber = 0xFF
	MOVLW	255
	BANKSEL	BYTENUMBER
	MOVWF	BYTENUMBER
;GLCDRotate ( Portrait )
	MOVLW	4
	MOVWF	GLCDROTATESTATE
	FCALL	GLCDROTATE_ILI9341
;GLCDCLS ILI9341_WHITE
	MOVLW	255
	MOVWF	GLCDBACKGROUND
	MOVWF	GLCDBACKGROUND_H
	CALL	GLCDCLS_ILI9341
;GLCDForeground = ILI9341_MAROON
	CLRF	GLCDFOREGROUND
	MOVLW	128
	MOVWF	GLCDFOREGROUND_H
;GLCDfntDefaultSize = 1
	MOVLW	1
	MOVWF	GLCDFNTDEFAULTSIZE
;GLCDPrint ( 2, 2, bytenumber )
	MOVLW	2
	MOVWF	PRINTLOCX
	CLRF	PRINTLOCX_H
	MOVLW	2
	MOVWF	PRINTLOCY
	CLRF	PRINTLOCY_H
	MOVF	BYTENUMBER,W
	MOVWF	LCDVALUE
	CLRF	LCDVALUE_H
	CLRF	LCDVALUE_U
	CLRF	LCDVALUE_E
	CALL	GLCDPRINT8
;GLCDForeground = ILI9341_BLACK
	CLRF	GLCDFOREGROUND
	CLRF	GLCDFOREGROUND_H
;GLCDfntDefaultSize = 2
	MOVLW	2
	MOVWF	GLCDFNTDEFAULTSIZE
;GLCDPrint ( 2, 12, wordNumber )
	MOVLW	2
	MOVWF	PRINTLOCX
	CLRF	PRINTLOCX_H
	MOVLW	12
	MOVWF	PRINTLOCY
	CLRF	PRINTLOCY_H
	BANKSEL	WORDNUMBER
	MOVF	WORDNUMBER,W
	BANKSEL	LCDVALUE
	MOVWF	LCDVALUE
	BANKSEL	WORDNUMBER_H
	MOVF	WORDNUMBER_H,W
	BANKSEL	LCDVALUE_H
	MOVWF	LCDVALUE_H
	CLRF	LCDVALUE_U
	CLRF	LCDVALUE_E
	CALL	GLCDPRINT8
;GLCDForeground = ILI9341_CYAN
	MOVLW	255
	MOVWF	GLCDFOREGROUND
	MOVLW	7
	MOVWF	GLCDFOREGROUND_H
;GLCDfntDefaultSize = 3
	MOVLW	3
	MOVWF	GLCDFNTDEFAULTSIZE
;GLCDPrint ( 2,30, longnumber )
	MOVLW	2
	MOVWF	PRINTLOCX
	CLRF	PRINTLOCX_H
	MOVLW	30
	MOVWF	PRINTLOCY
	CLRF	PRINTLOCY_H
	MOVF	LONGNUMBER,W
	MOVWF	LCDVALUE
	MOVF	LONGNUMBER_H,W
	MOVWF	LCDVALUE_H
	MOVF	LONGNUMBER_U,W
	MOVWF	LCDVALUE_U
	MOVF	LONGNUMBER_E,W
	MOVWF	LCDVALUE_E
	CALL	GLCDPRINT8
;Wait 2 s
	MOVLW	2
	MOVWF	SYSWAITTEMPS
	FCALL	DELAY_S
;End Repeat
	DECFSZ	SYSREPEATTEMP1,F
	GOTO	SYSREPEATLOOP1
GLOBAL	SYSREPEATLOOPEND1
SYSREPEATLOOPEND1:
;GLCDCLS ILI9341_BLUE
	MOVLW	31
	MOVWF	GLCDBACKGROUND
	CLRF	GLCDBACKGROUND_H
	CALL	GLCDCLS_ILI9341
;GLCDfntDefaultSize = 1
	MOVLW	1
	MOVWF	GLCDFNTDEFAULTSIZE
;ShowCase
	FCALL	SHOWCASE
;End
	GOTO	BASPROGRAMEND
;Use a sub to fix the large program into a page
GLOBAL	BASPROGRAMEND
BASPROGRAMEND:
	SLEEP
	GOTO	BASPROGRAMEND

;********************************************************************************

GLOBAL	DELAY_MS
DELAY_MS:
	INCF	SYSWAITTEMPMS_H, F
GLOBAL	DMS_START
DMS_START:
	MOVLW	14
	MOVWF	DELAYTEMP2
GLOBAL	DMS_OUTER
DMS_OUTER:
	MOVLW	189
	MOVWF	DELAYTEMP
GLOBAL	DMS_INNER
DMS_INNER:
	DECFSZ	DELAYTEMP, F
	GOTO	DMS_INNER
	DECFSZ	DELAYTEMP2, F
	GOTO	DMS_OUTER
	DECFSZ	SYSWAITTEMPMS, F
	GOTO	DMS_START
	DECFSZ	SYSWAITTEMPMS_H, F
	GOTO	DMS_START
	RETURN

;********************************************************************************

GLOBAL	GLCDCHARCOL3
GLCDCHARCOL3:
	MOVLW	113
	SUBWF	SYSSTRINGA, W
	BTFSC	STATUS,0
	RETLW	0
	MOVF	SYSSTRINGA, W
	ADDLW	LOW TABLEGLCDCHARCOL3
	MOVWF	SYSSTRINGA
	MOVLW	(HIGH TABLEGLCDCHARCOL3) & 127
	BTFSC	STATUS,0
	ADDLW	1
	MOVWF	PCLATH
	MOVF	SYSSTRINGA, W
	MOVWF	PCL
GLOBAL	TABLEGLCDCHARCOL3
TABLEGLCDCHARCOL3:
	RETLW	112
	RETLW	0
	RETLW	16
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	RETLW	120

;********************************************************************************

GLOBAL	GLCDCHARCOL4
GLCDCHARCOL4:
	MOVLW	113
	SUBWF	SYSSTRINGA, W
	BTFSC	STATUS,0
	RETLW	0
	MOVF	SYSSTRINGA, W
	ADDLW	LOW TABLEGLCDCHARCOL4
	MOVWF	SYSSTRINGA
	MOVLW	(HIGH TABLEGLCDCHARCOL4) & 127
	BTFSC	STATUS,0
	ADDLW	1
	MOVWF	PCLATH
	MOVF	SYSSTRINGA, W
	MOVWF	PCL
GLOBAL	TABLEGLCDCHARCOL4
TABLEGLCDCHARCOL4:
	RETLW	112
	RETLW	254
	RETLW	56
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	RETLW	68

;********************************************************************************

GLOBAL	GLCDCHARCOL5
GLCDCHARCOL5:
	MOVLW	113
	SUBWF	SYSSTRINGA, W
	BTFSC	STATUS,0
	RETLW	0
	MOVF	SYSSTRINGA, W
	ADDLW	LOW TABLEGLCDCHARCOL5
	MOVWF	SYSSTRINGA
	MOVLW	(HIGH TABLEGLCDCHARCOL5) & 127
	BTFSC	STATUS,0
	ADDLW	1
	MOVWF	PCLATH
	MOVF	SYSSTRINGA, W
	MOVWF	PCL
GLOBAL	TABLEGLCDCHARCOL5
TABLEGLCDCHARCOL5:
	RETLW	112
	RETLW	124
	RETLW	124
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	RETLW	66

;********************************************************************************

GLOBAL	GLCDCHARCOL6
GLCDCHARCOL6:
	MOVLW	113
	SUBWF	SYSSTRINGA, W
	BTFSC	STATUS,0
	RETLW	0
	MOVF	SYSSTRINGA, W
	ADDLW	LOW TABLEGLCDCHARCOL6
	MOVWF	SYSSTRINGA
	MOVLW	(HIGH TABLEGLCDCHARCOL6) & 127
	BTFSC	STATUS,0
	ADDLW	1
	MOVWF	PCLATH
	MOVF	SYSSTRINGA, W
	MOVWF	PCL
GLOBAL	TABLEGLCDCHARCOL6
TABLEGLCDCHARCOL6:
	RETLW	112
	RETLW	56
	RETLW	254
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	RETLW	68

;********************************************************************************

GLOBAL	GLCDCHARCOL7
GLCDCHARCOL7:
	MOVLW	113
	SUBWF	SYSSTRINGA, W
	BTFSC	STATUS,0
	RETLW	0
	MOVF	SYSSTRINGA, W
	ADDLW	LOW TABLEGLCDCHARCOL7
	MOVWF	SYSSTRINGA
	MOVLW	(HIGH TABLEGLCDCHARCOL7) & 127
	BTFSC	STATUS,0
	ADDLW	1
	MOVWF	PCLATH
	MOVF	SYSSTRINGA, W
	MOVWF	PCL
GLOBAL	TABLEGLCDCHARCOL7
TABLEGLCDCHARCOL7:
	RETLW	112
	RETLW	16
	RETLW	0
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	RETLW	120

;********************************************************************************

;SOURCE: GLCD_ILI9341.H (635)
GLOBAL	GLCDCLS_ILI9341
GLCDCLS_ILI9341:
;dim ILI9341SendWord as word
;initialise global variable. Required variable for Circle in all DEVICE DRIVERS- DO NOT DELETE
;GLCD_yordinate = 0
	CLRF	GLCD_YORDINATE
	CLRF	GLCD_YORDINATE_H
;SetAddressWindow_ILI9341 ( 0, 0, ILI9341_GLCD_WIDTH -1 , ILI9341_GLCD_HEIGHT-1 )
	BANKSEL	_X1
	CLRF	_X1
	CLRF	_X1_H
	CLRF	_Y1
	CLRF	_Y1_H
	MOVLW	1
	BANKSEL	GLCDDEVICEWIDTH
	SUBWF	GLCDDEVICEWIDTH,W
	BANKSEL	_X2
	MOVWF	_X2
	MOVLW	0
	BANKSEL	GLCDDEVICEWIDTH_H
	SUBWFB	GLCDDEVICEWIDTH_H,W
	BANKSEL	_X2_H
	MOVWF	_X2_H
	MOVLW	1
	BANKSEL	GLCDDEVICEHEIGHT
	SUBWF	GLCDDEVICEHEIGHT,W
	BANKSEL	_Y2
	MOVWF	_Y2
	MOVLW	0
	BANKSEL	GLCDDEVICEHEIGHT_H
	SUBWFB	GLCDDEVICEHEIGHT_H,W
	BANKSEL	_Y2_H
	MOVWF	_Y2_H
	BANKSEL	STATUS
	FCALL	SETADDRESSWINDOW_ILI9341
;ILI9341SendWord = GLCDBACKGROUND
	MOVF	GLCDBACKGROUND,W
	MOVWF	ILI9341SENDWORD
	MOVF	GLCDBACKGROUND_H,W
	MOVWF	ILI9341SENDWORD_H
;ILI9341_CS = 0
	BCF	LATA,2
;SPI mode
;set ILI9341_DC ON
	BSF	LATA,1
;repeat 320*240 times... this is faster!
;repeat 2 ' ILI9341_GLCD_WIDTH
	MOVLW	2
	BANKSEL	SYSREPEATTEMP2
	MOVWF	SYSREPEATTEMP2
GLOBAL	SYSREPEATLOOP2
SYSREPEATLOOP2:
;repeat 38400  'ILI9341_GLCD_HEIGHT
	CLRF	SYSREPEATTEMP3
	MOVLW	150
	MOVWF	SYSREPEATTEMP3_H
GLOBAL	SYSREPEATLOOP3
SYSREPEATLOOP3:
;SPI handler
;Clear WCOL
;Set SSPCON1.WCOL Off
	BANKSEL	SSP1CON1
	BCF	SSP1CON1,7
;Put byte to send into buffer
;Will start transfer
;SSPBUF = ILI9341SendWord_h
	BANKSEL	ILI9341SENDWORD_H
	MOVF	ILI9341SENDWORD_H,W
	BANKSEL	SSP1BUF
	MOVWF	SSP1BUF
;Wait While SSPSTAT.BF = Off
GLOBAL	SYSWAITLOOP1
SYSWAITLOOP1:
	BTFSS	SSP1STAT,0
	GOTO	SYSWAITLOOP1
;Set SSPSTAT.BF Off
	BCF	SSP1STAT,0
;ILI9341TempOut = SSPBUF
	MOVF	SSP1BUF,W
	BANKSEL	ILI9341TEMPOUT
	MOVWF	ILI9341TEMPOUT
;Clear WCOL
;Set SSPCON1.WCOL Off
	BANKSEL	SSP1CON1
	BCF	SSP1CON1,7
;Put byte to send into buffer
;Will start transfer
;SSPBUF = ILI9341SendWord
	BANKSEL	ILI9341SENDWORD
	MOVF	ILI9341SENDWORD,W
	BANKSEL	SSP1BUF
	MOVWF	SSP1BUF
;Wait While SSPSTAT.BF = Off
GLOBAL	SYSWAITLOOP2
SYSWAITLOOP2:
	BTFSS	SSP1STAT,0
	GOTO	SYSWAITLOOP2
;Set SSPSTAT.BF Off
	BCF	SSP1STAT,0
;ILI9341TempOut = SSPBUF
	MOVF	SSP1BUF,W
	BANKSEL	ILI9341TEMPOUT
	MOVWF	ILI9341TEMPOUT
;end of SPI
;end repeat
	BANKSEL	SYSREPEATTEMP3
	DECFSZ	SYSREPEATTEMP3,F
	GOTO	SYSREPEATLOOP3
	DECFSZ	SYSREPEATTEMP3_H,F
	GOTO	SYSREPEATLOOP3
GLOBAL	SYSREPEATLOOPEND3
SYSREPEATLOOPEND3:
;end repeat
	DECFSZ	SYSREPEATTEMP2,F
	GOTO	SYSREPEATLOOP2
GLOBAL	SYSREPEATLOOPEND2
SYSREPEATLOOPEND2:
;ILI9341_CS = 1
	BANKSEL	LATA
	BSF	LATA,2
	RETURN

;********************************************************************************

;SOURCE: GLCD_ILI9341.H (802)
GLOBAL	GLCDDRAWCHAR_ILI9341
GLCDDRAWCHAR_ILI9341:
;This has got a tad complex
;We have three major pieces
;1 The preamble - this just adjusted color and the input character
;2 The code that deals with GCB fontset
;3 The code that deals with OLED fontset
;
;You can make independent change to section 2 and 3 but they are mutual exclusive with many common pieces
;dim CharCol, CharRow, GLCDTemp as word
;CharCode -= 15
	MOVLW	15
	SUBWF	CHARCODE,F
;CharCol=0
	CLRF	CHARCOL
	CLRF	CHARCOL_H
;if CharCode>=178 and CharCode<=202 then
	MOVF	CHARCODE,W
	MOVWF	SYSBYTETEMPA
	MOVLW	178
	MOVWF	SYSBYTETEMPB
	FCALL	SYSCOMPLESSTHAN
	COMF	SYSBYTETEMPX,F
	MOVF	SYSBYTETEMPX,W
	BANKSEL	SYSTEMP3
	MOVWF	SYSTEMP3
	BANKSEL	CHARCODE
	MOVF	CHARCODE,W
	MOVWF	SYSBYTETEMPB
	MOVLW	202
	MOVWF	SYSBYTETEMPA
	FCALL	SYSCOMPLESSTHAN
	COMF	SYSBYTETEMPX,F
	BANKSEL	SYSTEMP3
	MOVF	SYSTEMP3,W
	ANDWF	SYSBYTETEMPX,W
	MOVWF	SYSTEMP1
	BTFSS	SYSTEMP1,0
	GOTO	ENDIF6
;CharLocY=CharLocY-1
	MOVLW	1
	BANKSEL	CHARLOCY
	SUBWF	CHARLOCY,F
	MOVLW	0
	SUBWFB	CHARLOCY_H,F
;end if
GLOBAL	ENDIF6
ENDIF6:
;For CurrCharCol = 1 to 5
;LEGACY METHOD
	BANKSEL	CURRCHARCOL
	CLRF	CURRCHARCOL
GLOBAL	SYSFORLOOP3
SYSFORLOOP3:
	INCF	CURRCHARCOL,F
;Select Case CurrCharCol
;Case 1: ReadTable GLCDCharCol3, CharCode, CurrCharVal
GLOBAL	SYSSELECT1CASE1
SYSSELECT1CASE1:
	DECF	CURRCHARCOL,W
	BTFSS	STATUS,2
	GOTO	SYSSELECT1CASE2
;Case 1: ReadTable GLCDCharCol3, CharCode, CurrCharVal
	MOVF	CHARCODE,W
	MOVWF	SYSSTRINGA
	CALL	GLCDCHARCOL3
	MOVWF	CURRCHARVAL
;Case 2: ReadTable GLCDCharCol4, CharCode, CurrCharVal
	GOTO	SYSSELECTEND1
GLOBAL	SYSSELECT1CASE2
SYSSELECT1CASE2:
	MOVLW	2
	SUBWF	CURRCHARCOL,W
	BTFSS	STATUS,2
	GOTO	SYSSELECT1CASE3
;Case 2: ReadTable GLCDCharCol4, CharCode, CurrCharVal
	MOVF	CHARCODE,W
	MOVWF	SYSSTRINGA
	CALL	GLCDCHARCOL4
	MOVWF	CURRCHARVAL
;Case 3: ReadTable GLCDCharCol5, CharCode, CurrCharVal
	GOTO	SYSSELECTEND1
GLOBAL	SYSSELECT1CASE3
SYSSELECT1CASE3:
	MOVLW	3
	SUBWF	CURRCHARCOL,W
	BTFSS	STATUS,2
	GOTO	SYSSELECT1CASE4
;Case 3: ReadTable GLCDCharCol5, CharCode, CurrCharVal
	MOVF	CHARCODE,W
	MOVWF	SYSSTRINGA
	CALL	GLCDCHARCOL5
	MOVWF	CURRCHARVAL
;Case 4: ReadTable GLCDCharCol6, CharCode, CurrCharVal
	GOTO	SYSSELECTEND1
GLOBAL	SYSSELECT1CASE4
SYSSELECT1CASE4:
	MOVLW	4
	SUBWF	CURRCHARCOL,W
	BTFSS	STATUS,2
	GOTO	SYSSELECT1CASE5
;Case 4: ReadTable GLCDCharCol6, CharCode, CurrCharVal
	MOVF	CHARCODE,W
	MOVWF	SYSSTRINGA
	CALL	GLCDCHARCOL6
	MOVWF	CURRCHARVAL
;Case 5: ReadTable GLCDCharCol7, CharCode, CurrCharVal
	GOTO	SYSSELECTEND1
GLOBAL	SYSSELECT1CASE5
SYSSELECT1CASE5:
	MOVLW	5
	SUBWF	CURRCHARCOL,W
	BTFSS	STATUS,2
	GOTO	SYSSELECTEND1
;Case 5: ReadTable GLCDCharCol7, CharCode, CurrCharVal
	MOVF	CHARCODE,W
	MOVWF	SYSSTRINGA
	CALL	GLCDCHARCOL7
	MOVWF	CURRCHARVAL
;End Select
GLOBAL	SYSSELECTEND1
SYSSELECTEND1:
;CharRow=0
	CLRF	CHARROW
	CLRF	CHARROW_H
;For CurrCharRow = 1 to 8
;LEGACY METHOD
	CLRF	CURRCHARROW
GLOBAL	SYSFORLOOP4
SYSFORLOOP4:
	INCF	CURRCHARROW,F
;CharColS=0
	CLRF	CHARCOLS
;For Col=1 to GLCDfntDefaultsize
	MOVLW	1
	MOVWF	COL
GLOBAL	SYSFORLOOP5
SYSFORLOOP5:
;CharColS +=1
	INCF	CHARCOLS,F
;CharRowS=0
	CLRF	CHARROWS
;For Row=1 to GLCDfntDefaultsize
	MOVLW	1
	MOVWF	ROW
GLOBAL	SYSFORLOOP6
SYSFORLOOP6:
;CharRowS +=1
	INCF	CHARROWS,F
;if CurrCharVal.0=1 then
	BTFSS	CURRCHARVAL,0
	GOTO	ELSE7_1
;PSet [word]CharLocX + CharCol+ CharColS, [word]CharLocY + CharRow+CharRowS, LineColour
	MOVF	CHARCOL,W
	ADDWF	CHARLOCX,W
	BANKSEL	SYSTEMP1
	MOVWF	SYSTEMP1
	BANKSEL	CHARCOL_H
	MOVF	CHARCOL_H,W
	ADDWFC	CHARLOCX_H,W
	BANKSEL	SYSTEMP1_H
	MOVWF	SYSTEMP1_H
	BANKSEL	CHARCOLS
	MOVF	CHARCOLS,W
	BANKSEL	SYSTEMP1
	ADDWF	SYSTEMP1,W
	BANKSEL	GLCDX
	MOVWF	GLCDX
	MOVLW	0
	BANKSEL	SYSTEMP1_H
	ADDWFC	SYSTEMP1_H,W
	BANKSEL	GLCDX_H
	MOVWF	GLCDX_H
	MOVF	CHARROW,W
	ADDWF	CHARLOCY,W
	BANKSEL	SYSTEMP1
	MOVWF	SYSTEMP1
	BANKSEL	CHARROW_H
	MOVF	CHARROW_H,W
	ADDWFC	CHARLOCY_H,W
	BANKSEL	SYSTEMP1_H
	MOVWF	SYSTEMP1_H
	BANKSEL	CHARROWS
	MOVF	CHARROWS,W
	BANKSEL	SYSTEMP1
	ADDWF	SYSTEMP1,W
	BANKSEL	GLCDY
	MOVWF	GLCDY
	MOVLW	0
	BANKSEL	SYSTEMP1_H
	ADDWFC	SYSTEMP1_H,W
	BANKSEL	GLCDY_H
	MOVWF	GLCDY_H
	MOVF	LINECOLOUR,W
	MOVWF	GLCDCOLOUR
	MOVF	LINECOLOUR_H,W
	MOVWF	GLCDCOLOUR_H
	FCALL	PSET_ILI9341
;Else
	GOTO	ENDIF7
GLOBAL	ELSE7_1
ELSE7_1:
;PSet [word]CharLocX + CharCol+ CharColS, [word]CharLocY + CharRow+CharRowS, GLCDBACKGROUND
	MOVF	CHARCOL,W
	ADDWF	CHARLOCX,W
	BANKSEL	SYSTEMP1
	MOVWF	SYSTEMP1
	BANKSEL	CHARCOL_H
	MOVF	CHARCOL_H,W
	ADDWFC	CHARLOCX_H,W
	BANKSEL	SYSTEMP1_H
	MOVWF	SYSTEMP1_H
	BANKSEL	CHARCOLS
	MOVF	CHARCOLS,W
	BANKSEL	SYSTEMP1
	ADDWF	SYSTEMP1,W
	BANKSEL	GLCDX
	MOVWF	GLCDX
	MOVLW	0
	BANKSEL	SYSTEMP1_H
	ADDWFC	SYSTEMP1_H,W
	BANKSEL	GLCDX_H
	MOVWF	GLCDX_H
	MOVF	CHARROW,W
	ADDWF	CHARLOCY,W
	BANKSEL	SYSTEMP1
	MOVWF	SYSTEMP1
	BANKSEL	CHARROW_H
	MOVF	CHARROW_H,W
	ADDWFC	CHARLOCY_H,W
	BANKSEL	SYSTEMP1_H
	MOVWF	SYSTEMP1_H
	BANKSEL	CHARROWS
	MOVF	CHARROWS,W
	BANKSEL	SYSTEMP1
	ADDWF	SYSTEMP1,W
	BANKSEL	GLCDY
	MOVWF	GLCDY
	MOVLW	0
	BANKSEL	SYSTEMP1_H
	ADDWFC	SYSTEMP1_H,W
	BANKSEL	GLCDY_H
	MOVWF	GLCDY_H
	MOVF	GLCDBACKGROUND,W
	MOVWF	GLCDCOLOUR
	MOVF	GLCDBACKGROUND_H,W
	MOVWF	GLCDCOLOUR_H
	FCALL	PSET_ILI9341
;End if
GLOBAL	ENDIF7
ENDIF7:
;Next Row
;POSITIVE VALUE STEP HANDLER IN FOR-NEXT STATEMENT :#4P 
	MOVF	ROW,W
	SUBWF	GLCDFNTDEFAULTSIZE,W
	BANKSEL	SYSTEMP3
	MOVWF	SYSTEMP3
	MOVWF	SYSBYTETEMPA
	CLRF	SYSBYTETEMPB
	BANKSEL	STATUS
	FCALL	SYSCOMPEQUAL
	COMF	SYSBYTETEMPX,F
	BTFSS	SYSBYTETEMPX,0
	GOTO	ENDIF8
;SET LOOPVAR TO LOOPVAR + STEPVALUE WHERE STEPVALUE IS A POSITIVE VALUE
	INCF	ROW,F
	GOTO	SYSFORLOOP6
;END IF
GLOBAL	ENDIF8
ENDIF8:
GLOBAL	SYSFORLOOPEND6
SYSFORLOOPEND6:
;Next Col
;POSITIVE VALUE STEP HANDLER IN FOR-NEXT STATEMENT :#4P 
	MOVF	COL,W
	SUBWF	GLCDFNTDEFAULTSIZE,W
	BANKSEL	SYSTEMP3
	MOVWF	SYSTEMP3
	MOVWF	SYSBYTETEMPA
	CLRF	SYSBYTETEMPB
	BANKSEL	STATUS
	FCALL	SYSCOMPEQUAL
	COMF	SYSBYTETEMPX,F
	BTFSS	SYSBYTETEMPX,0
	GOTO	ENDIF9
;SET LOOPVAR TO LOOPVAR + STEPVALUE WHERE STEPVALUE IS A POSITIVE VALUE
	INCF	COL,F
	GOTO	SYSFORLOOP5
;END IF
GLOBAL	ENDIF9
ENDIF9:
GLOBAL	SYSFORLOOPEND5
SYSFORLOOPEND5:
;Rotate CurrCharVal Right
	RRF	CURRCHARVAL,F
;CharRow +=GLCDfntDefaultsize
	MOVF	GLCDFNTDEFAULTSIZE,W
	ADDWF	CHARROW,F
	MOVLW	0
	ADDWFC	CHARROW_H,F
;Next
	MOVLW	8
	SUBWF	CURRCHARROW,W
	BTFSS	STATUS,0
	GOTO	SYSFORLOOP4
GLOBAL	SYSFORLOOPEND4
SYSFORLOOPEND4:
;CharCol +=GLCDfntDefaultsize
	MOVF	GLCDFNTDEFAULTSIZE,W
	ADDWF	CHARCOL,F
	MOVLW	0
	ADDWFC	CHARCOL_H,F
;Next
	MOVLW	5
	SUBWF	CURRCHARCOL,W
	BTFSS	STATUS,0
	GOTO	SYSFORLOOP3
GLOBAL	SYSFORLOOPEND3
SYSFORLOOPEND3:
	RETURN

;********************************************************************************

;OVERLOADED SIGNATURE: WORD:WORD:STRING:, SOURCE: GLCD.H (981)
GLOBAL	GLCDPRINT5
GLCDPRINT5:
;GLCD.h Sub GLCDPrint
;Dim GLCDPrintLoc  as word
;Dim GLCDPrint_String_Counter, GLCDPrintLen as byte
;GLCDPrintLen = LCDPrintData(0)
	MOVF	SYSLCDPRINTDATAHANDLER,W
	MOVWF	FSR0L
	MOVF	SYSLCDPRINTDATAHANDLER_H,W
	MOVWF	FSR0H
	MOVF	INDF0,W
	MOVWF	GLCDPRINTLEN
;If GLCDPrintLen = 0 Then Exit Sub
	MOVF	GLCDPRINTLEN,F
	BTFSC	STATUS,2
;If GLCDPrintLen = 0 Then Exit Sub
	RETURN
;If GLCDPrintLen = 0 Then Exit Sub
;GLCDPrintLoc = PrintLocX
	MOVF	PRINTLOCX,W
	MOVWF	GLCDPRINTLOC
	MOVF	PRINTLOCX_H,W
	MOVWF	GLCDPRINTLOC_H
;Write Data
;For GLCDPrint_String_Counter = 1 To GLCDPrintLen
	MOVLW	1
	MOVWF	GLCDPRINT_STRING_COUNTER
GLOBAL	SYSFORLOOP1
SYSFORLOOP1:
;GLCDDrawChar  GLCDPrintLoc, PrintLocY, LCDPrintData(GLCDPrint_String_Counter)
	MOVF	GLCDPRINTLOC,W
	MOVWF	CHARLOCX
	MOVF	GLCDPRINTLOC_H,W
	MOVWF	CHARLOCX_H
	MOVF	PRINTLOCY,W
	MOVWF	CHARLOCY
	MOVF	PRINTLOCY_H,W
	MOVWF	CHARLOCY_H
	MOVF	GLCDPRINT_STRING_COUNTER,W
	ADDWF	SYSLCDPRINTDATAHANDLER,W
	MOVWF	FSR0L
	MOVLW	0
	ADDWFC	SYSLCDPRINTDATAHANDLER_H,W
	MOVWF	FSR0H
	MOVF	INDF0,W
	MOVWF	CHARCODE
	MOVF	GLCDFOREGROUND,W
	MOVWF	LINECOLOUR
	MOVF	GLCDFOREGROUND_H,W
	MOVWF	LINECOLOUR_H
	CALL	GLCDDRAWCHAR_ILI9341
;GLCDPrintIncrementPixelPositionMacro
;Macro Source: glcd.h (1219)
;GLCDPrintLoc = GLCDPrintLoc + ( GLCDFontWidth * GLCDfntDefaultsize )+1
	MOVF	GLCDFONTWIDTH,W
	MOVWF	SYSBYTETEMPA
	MOVF	GLCDFNTDEFAULTSIZE,W
	MOVWF	SYSBYTETEMPB
	FCALL	SYSMULTSUB
	MOVF	SYSBYTETEMPX,W
	BANKSEL	SYSTEMP1
	MOVWF	SYSTEMP1
	BANKSEL	GLCDPRINTLOC
	ADDWF	GLCDPRINTLOC,W
	BANKSEL	SYSTEMP2
	MOVWF	SYSTEMP2
	MOVLW	0
	BANKSEL	GLCDPRINTLOC_H
	ADDWFC	GLCDPRINTLOC_H,W
	BANKSEL	SYSTEMP2_H
	MOVWF	SYSTEMP2_H
	MOVLW	1
	ADDWF	SYSTEMP2,W
	BANKSEL	GLCDPRINTLOC
	MOVWF	GLCDPRINTLOC
	MOVLW	0
	BANKSEL	SYSTEMP2_H
	ADDWFC	SYSTEMP2_H,W
	BANKSEL	GLCDPRINTLOC_H
	MOVWF	GLCDPRINTLOC_H
;Next
;POSITIVE VALUE STEP HANDLER IN FOR-NEXT STATEMENT :#4P 
	MOVF	GLCDPRINT_STRING_COUNTER,W
	SUBWF	GLCDPRINTLEN,W
	BANKSEL	SYSTEMP1
	MOVWF	SYSTEMP1
	MOVWF	SYSBYTETEMPA
	CLRF	SYSBYTETEMPB
	BANKSEL	STATUS
	FCALL	SYSCOMPEQUAL
	COMF	SYSBYTETEMPX,F
	BTFSS	SYSBYTETEMPX,0
	GOTO	ENDIF2
;SET LOOPVAR TO LOOPVAR + STEPVALUE WHERE STEPVALUE IS A POSITIVE VALUE
	INCF	GLCDPRINT_STRING_COUNTER,F
	GOTO	SYSFORLOOP1
;END IF
GLOBAL	ENDIF2
ENDIF2:
GLOBAL	SYSFORLOOPEND1
SYSFORLOOPEND1:
;Update the current X position for GLCDPrintString
;PrintLocX = GLCDPrintLoc
	MOVF	GLCDPRINTLOC,W
	MOVWF	PRINTLOCX
	MOVF	GLCDPRINTLOC_H,W
	MOVWF	PRINTLOCX_H
	RETURN

;********************************************************************************

;OVERLOADED SIGNATURE: WORD:WORD:LONG:, SOURCE: GLCD.H (1094)
GLOBAL	GLCDPRINT8
GLCDPRINT8:
;Dim SysCalcTempA As Long
;Dim GLCDPrintLoc as word
;Dim SysPrintBuffer(10)
;SysPrintBuffLen = 0
	CLRF	SYSPRINTBUFFLEN
;Do
GLOBAL	SYSDOLOOP_S1
SYSDOLOOP_S1:
;Divide number by 10, remainder into buffer
;SysPrintBuffLen += 1
	INCF	SYSPRINTBUFFLEN,F
;SysPrintBuffer(SysPrintBuffLen) = LCDValue % 10
	MOVLW	LOW(SYSPRINTBUFFER)
	ADDWF	SYSPRINTBUFFLEN,W
	MOVWF	FSR0L
	MOVLW	0
	BANKSEL	SYSTEMP1
	MOVWF	SYSTEMP1
	MOVLW	HIGH(SYSPRINTBUFFER)
	ADDWFC	SYSTEMP1,W
	MOVWF	FSR0H
	BANKSEL	LCDVALUE
	MOVF	LCDVALUE,W
	MOVWF	SYSLONGTEMPA
	MOVF	LCDVALUE_H,W
	MOVWF	SYSLONGTEMPA_H
	MOVF	LCDVALUE_U,W
	MOVWF	SYSLONGTEMPA_U
	MOVF	LCDVALUE_E,W
	MOVWF	SYSLONGTEMPA_E
	MOVLW	10
	MOVWF	SYSLONGTEMPB
	CLRF	SYSLONGTEMPB_H
	CLRF	SYSLONGTEMPB_U
	CLRF	SYSLONGTEMPB_E
	CALL	SYSDIVSUB32
	MOVF	SYSLONGTEMPX,W
	MOVWF	INDF0
;LCDValue = SysCalcTempA
	MOVF	SYSCALCTEMPA,W
	MOVWF	LCDVALUE
	MOVF	SYSCALCTEMPA_H,W
	MOVWF	LCDVALUE_H
	MOVF	SYSCALCTEMPA_U,W
	MOVWF	LCDVALUE_U
	MOVF	SYSCALCTEMPA_E,W
	MOVWF	LCDVALUE_E
;Loop While LCDValue <> 0
	MOVF	LCDVALUE,W
	MOVWF	SYSLONGTEMPA
	MOVF	LCDVALUE_H,W
	MOVWF	SYSLONGTEMPA_H
	MOVF	LCDVALUE_U,W
	MOVWF	SYSLONGTEMPA_U
	MOVF	LCDVALUE_E,W
	MOVWF	SYSLONGTEMPA_E
	CLRF	SYSLONGTEMPB
	CLRF	SYSLONGTEMPB_H
	CLRF	SYSLONGTEMPB_U
	CLRF	SYSLONGTEMPB_E
	FCALL	SYSCOMPEQUAL32
	COMF	SYSBYTETEMPX,F
	BTFSC	SYSBYTETEMPX,0
	GOTO	SYSDOLOOP_S1
GLOBAL	SYSDOLOOP_E1
SYSDOLOOP_E1:
;Display
;GLCDPrintLoc = PrintLocX
	MOVF	PRINTLOCX,W
	MOVWF	GLCDPRINTLOC
	MOVF	PRINTLOCX_H,W
	MOVWF	GLCDPRINTLOC_H
;For GLCDPrint_String_Counter = SysPrintBuffLen To 1 Step -1
	MOVF	SYSPRINTBUFFLEN,W
	MOVWF	GLCDPRINT_STRING_COUNTER
GLOBAL	SYSFORLOOP2
SYSFORLOOP2:
;INIT SYSFORLOOPSTEP1 :#0
	MOVLW	255
	MOVWF	SYSFORLOOPSTEP1
	MOVWF	SYSFORLOOPSTEP1_H
;GLCDDrawChar GLCDPrintLoc, PrintLocY, SysPrintBuffer(GLCDPrint_String_Counter) + 48
	MOVF	GLCDPRINTLOC,W
	MOVWF	CHARLOCX
	MOVF	GLCDPRINTLOC_H,W
	MOVWF	CHARLOCX_H
	MOVF	PRINTLOCY,W
	MOVWF	CHARLOCY
	MOVF	PRINTLOCY_H,W
	MOVWF	CHARLOCY_H
	MOVLW	LOW(SYSPRINTBUFFER)
	ADDWF	GLCDPRINT_STRING_COUNTER,W
	MOVWF	FSR0L
	MOVLW	0
	BANKSEL	SYSTEMP3
	MOVWF	SYSTEMP3
	MOVLW	HIGH(SYSPRINTBUFFER)
	ADDWFC	SYSTEMP3,W
	MOVWF	FSR0H
	MOVLW	48
	ADDWF	INDF0,W
	BANKSEL	CHARCODE
	MOVWF	CHARCODE
	MOVF	GLCDFOREGROUND,W
	MOVWF	LINECOLOUR
	MOVF	GLCDFOREGROUND_H,W
	MOVWF	LINECOLOUR_H
	CALL	GLCDDRAWCHAR_ILI9341
;GLCDPrintIncrementPixelPositionMacro
;Macro Source: glcd.h (1219)
;GLCDPrintLoc = GLCDPrintLoc + ( GLCDFontWidth * GLCDfntDefaultsize )+1
	MOVF	GLCDFONTWIDTH,W
	MOVWF	SYSBYTETEMPA
	MOVF	GLCDFNTDEFAULTSIZE,W
	MOVWF	SYSBYTETEMPB
	FCALL	SYSMULTSUB
	MOVF	SYSBYTETEMPX,W
	BANKSEL	SYSTEMP3
	MOVWF	SYSTEMP3
	BANKSEL	GLCDPRINTLOC
	ADDWF	GLCDPRINTLOC,W
	BANKSEL	SYSTEMP1
	MOVWF	SYSTEMP1
	MOVLW	0
	BANKSEL	GLCDPRINTLOC_H
	ADDWFC	GLCDPRINTLOC_H,W
	BANKSEL	SYSTEMP1_H
	MOVWF	SYSTEMP1_H
	MOVLW	1
	ADDWF	SYSTEMP1,W
	BANKSEL	GLCDPRINTLOC
	MOVWF	GLCDPRINTLOC
	MOVLW	0
	BANKSEL	SYSTEMP1_H
	ADDWFC	SYSTEMP1_H,W
	BANKSEL	GLCDPRINTLOC_H
	MOVWF	GLCDPRINTLOC_H
;Next
;INTEGER NEGATIVE STEP HANDLER IN FOR-NEXT STATEMENT
	BTFSS	SYSFORLOOPSTEP1_H,7
	GOTO	ELSE3_1
;IF ( GLCDPRINT_STRING_COUNTER - 1) } -SYSFORLOOPSTEP1 THEN :#3N
	DECF	GLCDPRINT_STRING_COUNTER,W
	BANKSEL	SYSTEMP1
	MOVWF	SYSTEMP1
	BANKSEL	SYSFORLOOPSTEP1
	COMF	SYSFORLOOPSTEP1,W
	BANKSEL	SYSTEMP2
	MOVWF	SYSTEMP2
	BANKSEL	SYSFORLOOPSTEP1_H
	COMF	SYSFORLOOPSTEP1_H,W
	BANKSEL	SYSTEMP2_H
	MOVWF	SYSTEMP2_H
	INCF	SYSTEMP2,F
	BTFSC	STATUS,2
	INCF	SYSTEMP2_H,F
	MOVF	SYSTEMP1,W
	MOVWF	SYSINTEGERTEMPA
	CLRF	SYSINTEGERTEMPA_H
	MOVF	SYSTEMP2,W
	MOVWF	SYSINTEGERTEMPB
	MOVF	SYSTEMP2_H,W
	MOVWF	SYSINTEGERTEMPB_H
	BANKSEL	STATUS
	FCALL	SYSCOMPLESSTHANINT
	COMF	SYSBYTETEMPX,F
	BTFSS	SYSBYTETEMPX,0
	GOTO	ENDIF4
;SET LOOPVAR TO LOOPVAR + STEPVALUE WHERE STEPVALUE IS A NEGATIVE VALUE
	MOVF	SYSFORLOOPSTEP1,W
	ADDWF	GLCDPRINT_STRING_COUNTER,F
	GOTO	SYSFORLOOP2
;END IF
GLOBAL	ENDIF4
ENDIF4:
	GOTO	ENDIF3
GLOBAL	ELSE3_1
ELSE3_1:
;INTEGER POSITIVE STEP HANDLER IN FOR-NEXT STATEMENT
;IF (1 - GLCDPRINT_STRING_COUNTER) } SYSFORLOOPSTEP1 THEN :#3P
	MOVF	GLCDPRINT_STRING_COUNTER,W
	SUBLW	1
	BANKSEL	SYSTEMP1
	MOVWF	SYSTEMP1
	MOVWF	SYSINTEGERTEMPA
	CLRF	SYSINTEGERTEMPA_H
	BANKSEL	SYSFORLOOPSTEP1
	MOVF	SYSFORLOOPSTEP1,W
	MOVWF	SYSINTEGERTEMPB
	MOVF	SYSFORLOOPSTEP1_H,W
	MOVWF	SYSINTEGERTEMPB_H
	FCALL	SYSCOMPLESSTHANINT
	COMF	SYSBYTETEMPX,F
	BTFSS	SYSBYTETEMPX,0
	GOTO	ENDIF5
;SET LOOPVAR TO LOOPVAR + STEPVALUE WHERE STEPVALUE IS A POSITIVE VALUE
	MOVF	SYSFORLOOPSTEP1,W
	ADDWF	GLCDPRINT_STRING_COUNTER,F
	GOTO	SYSFORLOOP2
;END IF
GLOBAL	ENDIF5
ENDIF5:
;END IF
GLOBAL	ENDIF3
ENDIF3:
GLOBAL	SYSFORLOOPEND2
SYSFORLOOPEND2:
;Update the current X position for GLCDPrintString
;PrintLocX = GLCDPrintLoc
	MOVF	GLCDPRINTLOC,W
	MOVWF	PRINTLOCX
	MOVF	GLCDPRINTLOC_H,W
	MOVWF	PRINTLOCX_H
	RETURN

;********************************************************************************

;SOURCE: GLCD_ILI9341.H (214)
GLOBAL	INITGLCD_ILI9341
INITGLCD_ILI9341:
;Mapped to global variables to same RAM
;dim ILI9341_GLCD_HEIGHT, ILI9341_GLCD_WIDTH as word
;Setup code for ILI9341 controllers
;asm showdebug  SPI
;asm showdebug  ILI9341_SPI_MODE_SCRIPT
;asm showdebug  8BIT mode
;asm showdebug  ILI9341_8BIT_MODE_SCRIPT
;SPI mode!!!
;Pin directions
;Dir ILI9341_CS Out
	BCF	TRISA,2
;Dir ILI9341_DC Out
	BCF	TRISA,1
;Dir ILI9341_RST Out
	BCF	TRISA,3
;Dir ILI9341_DO Out
	BCF	TRISC,5
;Dir ILI9341_SCK Out
	BCF	TRISC,3
;harware SPI mode
;asm showdebug SPI constant used equates to HWSPIMODESCRIPT
;SPIMode HWSPIMODESCRIPT, 0
	MOVLW	13
	MOVWF	SPICURRENTMODE
	CLRF	SPICLOCKMODE
	FCALL	SPIMODE706
;Set ILI9341_CS On
	BSF	LATA,2
;Set ILI9341_DC On
	BSF	LATA,1
;Reset display
;Wait 50 ms
	MOVLW	50
	MOVWF	SYSWAITTEMPMS
	CLRF	SYSWAITTEMPMS_H
	FCALL	DELAY_MS
;Set ILI9341_RST On
	BSF	LATA,3
;Wait 15 ms
	MOVLW	15
	MOVWF	SYSWAITTEMPMS
	CLRF	SYSWAITTEMPMS_H
	FCALL	DELAY_MS
;Reset sequence (lower line for at least 10 us)
;Set ILI9341_RST Off
	BCF	LATA,3
;Wait 15 us
	MOVLW	40
	MOVWF	DELAYTEMP
GLOBAL	DELAYUS1
DELAYUS1:
	DECFSZ	DELAYTEMP,F
	GOTO	DELAYUS1
;Set ILI9341_RST On
	BSF	LATA,3
;Wait 15 ms
	MOVLW	15
	MOVWF	SYSWAITTEMPMS
	CLRF	SYSWAITTEMPMS_H
	FCALL	DELAY_MS
;SendCommand_ILI9341(0xEF)
	MOVLW	239
	MOVWF	ILI9341SENDBYTE
	FCALL	SENDCOMMAND_ILI9341
;SendData_ILI9341(0x03)
	MOVLW	3
	MOVWF	ILI9341SENDBYTE
	FCALL	SENDDATA_ILI9341
;SendData_ILI9341(0x80)
	MOVLW	128
	MOVWF	ILI9341SENDBYTE
	FCALL	SENDDATA_ILI9341
;SendData_ILI9341(0x02)
	MOVLW	2
	MOVWF	ILI9341SENDBYTE
	FCALL	SENDDATA_ILI9341
;SendCommand_ILI9341(0xCF)
	MOVLW	207
	MOVWF	ILI9341SENDBYTE
	FCALL	SENDCOMMAND_ILI9341
;SendData_ILI9341(0x00)
	CLRF	ILI9341SENDBYTE
	FCALL	SENDDATA_ILI9341
;SendData_ILI9341(0XC1)
	MOVLW	193
	MOVWF	ILI9341SENDBYTE
	FCALL	SENDDATA_ILI9341
;SendData_ILI9341(0X30)
	MOVLW	48
	MOVWF	ILI9341SENDBYTE
	FCALL	SENDDATA_ILI9341
;SendCommand_ILI9341(0xED)
	MOVLW	237
	MOVWF	ILI9341SENDBYTE
	FCALL	SENDCOMMAND_ILI9341
;SendData_ILI9341(0x64)
	MOVLW	100
	MOVWF	ILI9341SENDBYTE
	FCALL	SENDDATA_ILI9341
;SendData_ILI9341(0x03)
	MOVLW	3
	MOVWF	ILI9341SENDBYTE
	FCALL	SENDDATA_ILI9341
;SendData_ILI9341(0X12)
	MOVLW	18
	MOVWF	ILI9341SENDBYTE
	FCALL	SENDDATA_ILI9341
;SendData_ILI9341(0X81)
	MOVLW	129
	MOVWF	ILI9341SENDBYTE
	FCALL	SENDDATA_ILI9341
;SendCommand_ILI9341(0xE8)
	MOVLW	232
	MOVWF	ILI9341SENDBYTE
	FCALL	SENDCOMMAND_ILI9341
;SendData_ILI9341(0x85)
	MOVLW	133
	MOVWF	ILI9341SENDBYTE
	FCALL	SENDDATA_ILI9341
;SendData_ILI9341(0x00)
	CLRF	ILI9341SENDBYTE
	FCALL	SENDDATA_ILI9341
;SendData_ILI9341(0x78)
	MOVLW	120
	MOVWF	ILI9341SENDBYTE
	FCALL	SENDDATA_ILI9341
;SendCommand_ILI9341(0xCB)
	MOVLW	203
	MOVWF	ILI9341SENDBYTE
	FCALL	SENDCOMMAND_ILI9341
;SendData_ILI9341(0x39)
	MOVLW	57
	MOVWF	ILI9341SENDBYTE
	FCALL	SENDDATA_ILI9341
;SendData_ILI9341(0x2C)
	MOVLW	44
	MOVWF	ILI9341SENDBYTE
	FCALL	SENDDATA_ILI9341
;SendData_ILI9341(0x00)
	CLRF	ILI9341SENDBYTE
	FCALL	SENDDATA_ILI9341
;SendData_ILI9341(0x34)
	MOVLW	52
	MOVWF	ILI9341SENDBYTE
	FCALL	SENDDATA_ILI9341
;SendData_ILI9341(0x02)
	MOVLW	2
	MOVWF	ILI9341SENDBYTE
	FCALL	SENDDATA_ILI9341
;SendCommand_ILI9341(0xF7)
	MOVLW	247
	MOVWF	ILI9341SENDBYTE
	FCALL	SENDCOMMAND_ILI9341
;SendData_ILI9341(0x20)
	MOVLW	32
	MOVWF	ILI9341SENDBYTE
	FCALL	SENDDATA_ILI9341
;SendCommand_ILI9341(0xEA)
	MOVLW	234
	MOVWF	ILI9341SENDBYTE
	FCALL	SENDCOMMAND_ILI9341
;SendData_ILI9341(0x00)
	CLRF	ILI9341SENDBYTE
	FCALL	SENDDATA_ILI9341
;SendData_ILI9341(0x00)
	CLRF	ILI9341SENDBYTE
	FCALL	SENDDATA_ILI9341
;SendCommand_ILI9341(ILI9341_PWCTR1)    'Power control
	MOVLW	192
	MOVWF	ILI9341SENDBYTE
	FCALL	SENDCOMMAND_ILI9341
;SendData_ILI9341(0x2B)   'VRH[5:0]
	MOVLW	43
	MOVWF	ILI9341SENDBYTE
	FCALL	SENDDATA_ILI9341
;SendCommand_ILI9341(ILI9341_PWCTR2)    'Power control
	MOVLW	193
	MOVWF	ILI9341SENDBYTE
	FCALL	SENDCOMMAND_ILI9341
;SendData_ILI9341(0x10)   'SAP[2:0];BT[3:0]
	MOVLW	16
	MOVWF	ILI9341SENDBYTE
	FCALL	SENDDATA_ILI9341
;SendCommand_ILI9341(ILI9341_VMCTR1)    'VCM control
	MOVLW	197
	MOVWF	ILI9341SENDBYTE
	FCALL	SENDCOMMAND_ILI9341
;SendData_ILI9341(0x3e) '???????
	MOVLW	62
	MOVWF	ILI9341SENDBYTE
	FCALL	SENDDATA_ILI9341
;SendData_ILI9341(0x28)
	MOVLW	40
	MOVWF	ILI9341SENDBYTE
	FCALL	SENDDATA_ILI9341
;SendCommand_ILI9341(ILI9341_VMCTR2)    'VCM control2
	MOVLW	199
	MOVWF	ILI9341SENDBYTE
	FCALL	SENDCOMMAND_ILI9341
;SendData_ILI9341(0x86)  '--
	MOVLW	134
	MOVWF	ILI9341SENDBYTE
	FCALL	SENDDATA_ILI9341
;SendCommand_ILI9341(ILI9341_MADCTL)    ' Memory Access Control
	MOVLW	54
	MOVWF	ILI9341SENDBYTE
	FCALL	SENDCOMMAND_ILI9341
;SendData_ILI9341(ILI9341_MADCTL_MX | ILI9341_MADCTL_BGR)
	MOVLW	72
	MOVWF	ILI9341SENDBYTE
	FCALL	SENDDATA_ILI9341
;SendCommand_ILI9341(ILI9341_PIXFMT)
	MOVLW	58
	MOVWF	ILI9341SENDBYTE
	FCALL	SENDCOMMAND_ILI9341
;SendData_ILI9341(0x55)
	MOVLW	85
	MOVWF	ILI9341SENDBYTE
	FCALL	SENDDATA_ILI9341
;SendCommand_ILI9341(ILI9341_FRMCTR1)
	MOVLW	177
	MOVWF	ILI9341SENDBYTE
	FCALL	SENDCOMMAND_ILI9341
;SendData_ILI9341(0x00)
	CLRF	ILI9341SENDBYTE
	FCALL	SENDDATA_ILI9341
;SendData_ILI9341(0x18)
	MOVLW	24
	MOVWF	ILI9341SENDBYTE
	FCALL	SENDDATA_ILI9341
;SendCommand_ILI9341(ILI9341_DFUNCTR)    ' Display Function Control
	MOVLW	182
	MOVWF	ILI9341SENDBYTE
	FCALL	SENDCOMMAND_ILI9341
;SendData_ILI9341(0x08)
	MOVLW	8
	MOVWF	ILI9341SENDBYTE
	FCALL	SENDDATA_ILI9341
;SendData_ILI9341(0x82)
	MOVLW	130
	MOVWF	ILI9341SENDBYTE
	FCALL	SENDDATA_ILI9341
;SendData_ILI9341(0x27)
	MOVLW	39
	MOVWF	ILI9341SENDBYTE
	FCALL	SENDDATA_ILI9341
;SendCommand_ILI9341(0xF2)    ' 3Gamma Function Disable
	MOVLW	242
	MOVWF	ILI9341SENDBYTE
	FCALL	SENDCOMMAND_ILI9341
;SendData_ILI9341(0x00)
	CLRF	ILI9341SENDBYTE
	FCALL	SENDDATA_ILI9341
;SendCommand_ILI9341(ILI9341_GAMMASET)    'Gamma curve selected
	MOVLW	38
	MOVWF	ILI9341SENDBYTE
	FCALL	SENDCOMMAND_ILI9341
;SendData_ILI9341(0x01)
	MOVLW	1
	MOVWF	ILI9341SENDBYTE
	FCALL	SENDDATA_ILI9341
;SendCommand_ILI9341(ILI9341_GMCTRP1)    'Set Gamma
	MOVLW	224
	MOVWF	ILI9341SENDBYTE
	FCALL	SENDCOMMAND_ILI9341
;SendData_ILI9341(0x0F)
	MOVLW	15
	MOVWF	ILI9341SENDBYTE
	FCALL	SENDDATA_ILI9341
;SendData_ILI9341(0x31)
	MOVLW	49
	MOVWF	ILI9341SENDBYTE
	FCALL	SENDDATA_ILI9341
;SendData_ILI9341(0x2B)
	MOVLW	43
	MOVWF	ILI9341SENDBYTE
	FCALL	SENDDATA_ILI9341
;SendData_ILI9341(0x0C)
	MOVLW	12
	MOVWF	ILI9341SENDBYTE
	FCALL	SENDDATA_ILI9341
;SendData_ILI9341(0x0E)
	MOVLW	14
	MOVWF	ILI9341SENDBYTE
	FCALL	SENDDATA_ILI9341
;SendData_ILI9341(0x08)
	MOVLW	8
	MOVWF	ILI9341SENDBYTE
	FCALL	SENDDATA_ILI9341
;SendData_ILI9341(0x4E)
	MOVLW	78
	MOVWF	ILI9341SENDBYTE
	FCALL	SENDDATA_ILI9341
;SendData_ILI9341(0xF1)
	MOVLW	241
	MOVWF	ILI9341SENDBYTE
	FCALL	SENDDATA_ILI9341
;SendData_ILI9341(0x37)
	MOVLW	55
	MOVWF	ILI9341SENDBYTE
	FCALL	SENDDATA_ILI9341
;SendData_ILI9341(0x07)
	MOVLW	7
	MOVWF	ILI9341SENDBYTE
	FCALL	SENDDATA_ILI9341
;SendData_ILI9341(0x10)
	MOVLW	16
	MOVWF	ILI9341SENDBYTE
	FCALL	SENDDATA_ILI9341
;SendData_ILI9341(0x03)
	MOVLW	3
	MOVWF	ILI9341SENDBYTE
	FCALL	SENDDATA_ILI9341
;SendData_ILI9341(0x0E)
	MOVLW	14
	MOVWF	ILI9341SENDBYTE
	FCALL	SENDDATA_ILI9341
;SendData_ILI9341(0x09)
	MOVLW	9
	MOVWF	ILI9341SENDBYTE
	FCALL	SENDDATA_ILI9341
;SendData_ILI9341(0x00)
	CLRF	ILI9341SENDBYTE
	FCALL	SENDDATA_ILI9341
;SendCommand_ILI9341(ILI9341_GMCTRN1)    'Set Gamma
	MOVLW	225
	MOVWF	ILI9341SENDBYTE
	FCALL	SENDCOMMAND_ILI9341
;SendData_ILI9341(0x00)
	CLRF	ILI9341SENDBYTE
	FCALL	SENDDATA_ILI9341
;SendData_ILI9341(0x0E)
	MOVLW	14
	MOVWF	ILI9341SENDBYTE
	FCALL	SENDDATA_ILI9341
;SendData_ILI9341(0x14)
	MOVLW	20
	MOVWF	ILI9341SENDBYTE
	FCALL	SENDDATA_ILI9341
;SendData_ILI9341(0x03)
	MOVLW	3
	MOVWF	ILI9341SENDBYTE
	FCALL	SENDDATA_ILI9341
;SendData_ILI9341(0x11)
	MOVLW	17
	MOVWF	ILI9341SENDBYTE
	FCALL	SENDDATA_ILI9341
;SendData_ILI9341(0x07)
	MOVLW	7
	MOVWF	ILI9341SENDBYTE
	FCALL	SENDDATA_ILI9341
;SendData_ILI9341(0x31)
	MOVLW	49
	MOVWF	ILI9341SENDBYTE
	FCALL	SENDDATA_ILI9341
;SendData_ILI9341(0xC1)
	MOVLW	193
	MOVWF	ILI9341SENDBYTE
	FCALL	SENDDATA_ILI9341
;SendData_ILI9341(0x48)
	MOVLW	72
	MOVWF	ILI9341SENDBYTE
	FCALL	SENDDATA_ILI9341
;SendData_ILI9341(0x08)
	MOVLW	8
	MOVWF	ILI9341SENDBYTE
	FCALL	SENDDATA_ILI9341
;SendData_ILI9341(0x0F)
	MOVLW	15
	MOVWF	ILI9341SENDBYTE
	FCALL	SENDDATA_ILI9341
;SendData_ILI9341(0x0C)
	MOVLW	12
	MOVWF	ILI9341SENDBYTE
	FCALL	SENDDATA_ILI9341
;SendData_ILI9341(0x31)
	MOVLW	49
	MOVWF	ILI9341SENDBYTE
	FCALL	SENDDATA_ILI9341
;SendData_ILI9341(0x36)
	MOVLW	54
	MOVWF	ILI9341SENDBYTE
	FCALL	SENDDATA_ILI9341
;SendData_ILI9341(0x0F)
	MOVLW	15
	MOVWF	ILI9341SENDBYTE
	FCALL	SENDDATA_ILI9341
;SendCommand_ILI9341(ILI9341_SLPOUT)    'Exit Sleep
	MOVLW	17
	MOVWF	ILI9341SENDBYTE
	FCALL	SENDCOMMAND_ILI9341
;wait 150 ms
	MOVLW	150
	MOVWF	SYSWAITTEMPMS
	CLRF	SYSWAITTEMPMS_H
	FCALL	DELAY_MS
;SendCommand_ILI9341(ILI9341_DISPON)    'Display on
	MOVLW	41
	MOVWF	ILI9341SENDBYTE
	FCALL	SENDCOMMAND_ILI9341
;Default Colours
;GLCDBACKGROUND = ILI9341_BLACK
	CLRF	GLCDBACKGROUND
	CLRF	GLCDBACKGROUND_H
;GLCDForeground = ILI9341_WHITE
	MOVLW	255
	MOVWF	GLCDFOREGROUND
	MOVWF	GLCDFOREGROUND_H
;Variables required for device
;ILI9341_GLCD_WIDTH = GLCD_WIDTH
	MOVLW	240
	MOVWF	GLCDDEVICEWIDTH
	CLRF	GLCDDEVICEWIDTH_H
;ILI9341_GLCD_HEIGHT = GLCD_HEIGHT
	MOVLW	64
	MOVWF	GLCDDEVICEHEIGHT
	MOVLW	1
	MOVWF	GLCDDEVICEHEIGHT_H
;GLCDFontWidth = 6
	MOVLW	6
	MOVWF	GLCDFONTWIDTH
;GLCDfntDefault = 0
	CLRF	GLCDFNTDEFAULT
;GLCDfntDefaultsize = 1
	MOVLW	1
	MOVWF	GLCDFNTDEFAULTSIZE
;GLCDfntDefaultHeight = 7  'used by GLCDPrintString and GLCDPrintStringLn
	MOVLW	7
	MOVWF	GLCDFNTDEFAULTHEIGHT
;GLCDRotateState = Portrait
	MOVLW	4
	MOVWF	GLCDROTATESTATE
;Clear screen
;GLCDCLS
	GOTO	GLCDCLS_ILI9341

;********************************************************************************

;SOURCE: 260_SPI_GLCD_USING_ILI9341.GCB (36)
GLOBAL	INITPPS
INITPPS:
;'This #ifdef support the SPI hardware!!
;#ifdef ILI9341_hardwarespi
;'Module: SPI1
;RC5PPS = 0x16       //RC5->MSSP1:SDO1;
;RC3PPS = 0x15       //SCK1 > RC3
;SSP1CLKPPS = 0x13 //RC3 > SCK1 (bi-directional)
;#endif
	RETURN

;********************************************************************************

;SOURCE: SYSTEM.H (159)
GLOBAL	INITSYS
INITSYS:
;asm showdebug This code block sets the internal oscillator to ChipMHz
;OSCCON2 = 0
	BANKSEL	OSCCON2
	CLRF	OSCCON2
;OSCCON3 = 0
	CLRF	OSCCON3
;Set OSCFRQ values for MCUs with OSCSTAT... the 16F180xx MCU family 32 mhz
;OSCFRQ = 0b00000101
	MOVLW	5
	MOVWF	OSCFRQ
;asm showdebug _Complete_the_chip_setup_of_BSR,ADCs,ANSEL_and_other_key_setup_registers_or_register_bits
;Ensure all ports are set for digital I/O and, turn off A/D
;SET ADFM OFF
	BANKSEL	ADCON0
	BCF	ADCON0,2
;Switch off A/D Var(ADCON0)
;SET ADCON0.ADON OFF
	BCF	ADCON0,7
;ANSELA = 0
	BANKSEL	ANSELA
	CLRF	ANSELA
;ANSELB = 0
	CLRF	ANSELB
;ANSELC = 0
	CLRF	ANSELC
;ANSELD = 0
	CLRF	ANSELD
;ANSELE = 0
	CLRF	ANSELE
;Set comparator register bits for many MCUs with register CM2CON0
;C1EN = 0
	BANKSEL	CM1CON0
	BCF	CM1CON0,7
;
;'Turn off all ports
;PORTA = 0
	BANKSEL	PORTA
	CLRF	PORTA
;PORTB = 0
	CLRF	PORTB
;PORTC = 0
	CLRF	PORTC
;PORTD = 0
	CLRF	PORTD
;PORTE = 0
	CLRF	PORTE
	RETURN

;********************************************************************************

;SOURCE: 260_SPI_GLCD_USING_ILI9341.GCB (150)
GLOBAL	SHOWCASE
SHOWCASE:
;GLCDRotate ( Portrait )
;GLCDDrawString (2, 1, "GCB", ILI9341_WHITE )
;GLCDDrawString (50,1,"v.1.00", ILI9341_YELLOW )
;GLCDDrawString (2, 16, "DrawStr", ILI9341_WHITE )
;GLCDDrawString ( 60, 31, "Long Number" )
;GLCDDrawString ( 60, 39, "Word Number" )
;GLCDDrawString ( 60, 47, "Byte Number" )
;GLCDDrawString ( 74, 16, "Asc:" )
;Box 0,0,ILI9341_GLCD_WIDTH-1, ILI9341_GLCD_HEIGHT-1, ILI9341_YELLOW
;Box ILI9341_GLCD_WIDTH-5, ILI9341_GLCD_HEIGHT-5,ILI9341_GLCD_WIDTH-1, ILI9341_GLCD_HEIGHT-1, ILI9341_WHITE
;'center
;Circle( ILI9341_GLCD_WIDTH/2, ILI9341_GLCD_HEIGHT/2, 50, ILI9341_SILVER )
;FilledCircle( ILI9341_GLCD_WIDTH/2, ILI9341_GLCD_HEIGHT/2, 25, ILI9341_D_GRAY  )
;Line 0,  ILI9341_GLCD_HEIGHT-1 , ILI9341_GLCD_WIDTH/2 +100,  (ILI9341_GLCD_HEIGHT /2) - 50, ILI9341_CYAN
;Line  0, (ILI9341_GLCD_HEIGHT /2) - 50, ILI9341_GLCD_WIDTH/2 +100, (ILI9341_GLCD_HEIGHT /2) - 50, ILI9341_CYAN
;FilledBox 2,ILI9341_GLCD_HEIGHT/2+10,42,ILI9341_GLCD_HEIGHT/2+50, ILI9341_RED
;oldfont = GLCDfntDefaultSize
;GLCDfntDefaultSize = 2
;GLCDDrawString ( 42, ILI9341_GLCD_HEIGHT - 30 , "ILI9341 Driver" , ILI9341_WHITE )
;GLCDfntDefaultSize = 1
;GLCDDrawString ( ILI9341_GLCD_WIDTH - 57, 2 , "Sep 2022" , ILI9341_WHITE )
;#IFDEF ILI9341_HardwareSPI
;GLCDDrawString ( ILI9341_GLCD_WIDTH - 42, 10 , "HW SPI" , ILI9341_WHITE )
;#ENDIF
;#IFNDEF ILI9341_HardwareSPI
;GLCDDrawString ( ILI9341_GLCD_WIDTH - 42, 10 , "SW SPI" , ILI9341_WHITE )
;#ENDIF
;'Revert the font size
;GLCDfntDefaultSize = oldfont
;GLCDForeground = ILI9341_WHITE
;Do Forever
;GLCDPrint ( 144 , 31, longNumber)
;GLCDPrint ( 144 , 39, Pad( Str(wordnumber),5))
;GLCDPrint ( 144 , 47, Pad( Str(bytenumber),3))
;GLCDDrawChar(54, 16, CCount )
;'Draw a box around the Char below
;Box 52,15,62,26, ILI9341_WHITE
;GLCDDrawString ( 100, 16 , Pad( Str(CCount),3) )
;CCount++
;If CCount = 0 Then CCount = 31
;If CCount = 128 Then CCount = 192
;longNumber = longNumber + 7
;wordNumber = wordNumber + 3
;byteNumber++
;Loop
	RETURN

;********************************************************************************

;SOURCE: SYSTEM.H (3714)
GLOBAL	SYSCOMPLESSTHANINT
SYSCOMPLESSTHANINT:
;Dim SysIntegerTempA, SysIntegerTempB, SysDivMultA as Integer
;Clear result
;SysByteTempX = 0
	CLRF	SYSBYTETEMPX
;Compare sign bits
;-A
;If SysIntegerTempA.15 = On Then
	BTFSS	SYSINTEGERTEMPA_H,7
	GOTO	ELSE14_1
;-A, +B, return true
;If SysIntegerTempB.15 = Off Then
	BTFSC	SYSINTEGERTEMPB_H,7
	GOTO	ENDIF15
;Set SysByteTempX to 255
;SysByteTempX = Not SysByteTempX
	COMF	SYSBYTETEMPX,F
;Exit Sub
	RETURN
;End If
GLOBAL	ENDIF15
ENDIF15:
;-A, -B, negate both and swap
;SysDivMultA = -SysIntegerTempA
	COMF	SYSINTEGERTEMPA,W
	MOVWF	SYSDIVMULTA
	COMF	SYSINTEGERTEMPA_H,W
	MOVWF	SYSDIVMULTA_H
	INCF	SYSDIVMULTA,F
	BTFSC	STATUS,2
	INCF	SYSDIVMULTA_H,F
;SysIntegerTempA = -SysIntegerTempB
	COMF	SYSINTEGERTEMPB,W
	MOVWF	SYSINTEGERTEMPA
	COMF	SYSINTEGERTEMPB_H,W
	MOVWF	SYSINTEGERTEMPA_H
	INCF	SYSINTEGERTEMPA,F
	BTFSC	STATUS,2
	INCF	SYSINTEGERTEMPA_H,F
;SysIntegerTempB = SysDivMultA
	MOVF	SYSDIVMULTA,W
	MOVWF	SYSINTEGERTEMPB
	MOVF	SYSDIVMULTA_H,W
	MOVWF	SYSINTEGERTEMPB_H
;+A
;Else
	GOTO	ENDIF14
GLOBAL	ELSE14_1
ELSE14_1:
;+A, -B, return false
;If SysIntegerTempB.15 = On Then
	BTFSC	SYSINTEGERTEMPB_H,7
;Exit Sub
	RETURN
;End If
;End If
GLOBAL	ENDIF14
ENDIF14:
;Test High, exit if more
;movf SysIntegerTempA_H,W
	MOVF	SYSINTEGERTEMPA_H,W
;subwf SysIntegerTempB_H,W
	SUBWF	SYSINTEGERTEMPB_H,W
;btfss STATUS,C
	BTFSS	STATUS,0
;return
	RETURN
;Test high, exit true if less
;movf SysIntegerTempB_H,W
	MOVF	SYSINTEGERTEMPB_H,W
;subwf SysIntegerTempA_H,W
	SUBWF	SYSINTEGERTEMPA_H,W
;btfss STATUS,C
	BTFSS	STATUS,0
;goto SCLTIntTrue
	GOTO	SCLTINTTRUE
;Test Low, exit if more or equal
;movf SysIntegerTempB,W
	MOVF	SYSINTEGERTEMPB,W
;subwf SysIntegerTempA,W
	SUBWF	SYSINTEGERTEMPA,W
;btfsc STATUS,C
	BTFSC	STATUS,0
;return
	RETURN
GLOBAL	SCLTINTTRUE
SCLTINTTRUE:
;comf SysByteTempX,F
	COMF	SYSBYTETEMPX,F
	RETURN

;********************************************************************************

;SOURCE: SYSTEM.H (2937)
GLOBAL	SYSDIVSUB32
SYSDIVSUB32:
;dim SysLongTempA as long
;dim SysLongTempB as long
;dim SysLongTempX as long
;#ifdef PIC
;dim SysLongDivMultA as long
;dim SysLongDivMultB as long
;dim SysLongDivMultX as long
;#endif
;SysLongDivMultA = SysLongTempA
	MOVF	SYSLONGTEMPA,W
	MOVWF	SYSLONGDIVMULTA
	MOVF	SYSLONGTEMPA_H,W
	MOVWF	SYSLONGDIVMULTA_H
	MOVF	SYSLONGTEMPA_U,W
	MOVWF	SYSLONGDIVMULTA_U
	MOVF	SYSLONGTEMPA_E,W
	MOVWF	SYSLONGDIVMULTA_E
;SysLongDivMultB = SysLongTempB
	MOVF	SYSLONGTEMPB,W
	MOVWF	SYSLONGDIVMULTB
	MOVF	SYSLONGTEMPB_H,W
	MOVWF	SYSLONGDIVMULTB_H
	MOVF	SYSLONGTEMPB_U,W
	MOVWF	SYSLONGDIVMULTB_U
	MOVF	SYSLONGTEMPB_E,W
	MOVWF	SYSLONGDIVMULTB_E
;SysLongDivMultX = 0
	BANKSEL	SYSLONGDIVMULTX
	CLRF	SYSLONGDIVMULTX
	CLRF	SYSLONGDIVMULTX_H
	CLRF	SYSLONGDIVMULTX_U
	CLRF	SYSLONGDIVMULTX_E
;Avoid division by zero
;if SysLongDivMultB = 0 then
	BANKSEL	SYSLONGDIVMULTB
	MOVF	SYSLONGDIVMULTB,W
	MOVWF	SYSLONGTEMPA
	MOVF	SYSLONGDIVMULTB_H,W
	MOVWF	SYSLONGTEMPA_H
	MOVF	SYSLONGDIVMULTB_U,W
	MOVWF	SYSLONGTEMPA_U
	MOVF	SYSLONGDIVMULTB_E,W
	MOVWF	SYSLONGTEMPA_E
	CLRF	SYSLONGTEMPB
	CLRF	SYSLONGTEMPB_H
	CLRF	SYSLONGTEMPB_U
	CLRF	SYSLONGTEMPB_E
	FCALL	SYSCOMPEQUAL32
	BTFSS	SYSBYTETEMPX,0
	GOTO	ENDIF12
;SysLongTempA = 0
	CLRF	SYSLONGTEMPA
	CLRF	SYSLONGTEMPA_H
	CLRF	SYSLONGTEMPA_U
	CLRF	SYSLONGTEMPA_E
;exit sub
	RETURN
;end if
GLOBAL	ENDIF12
ENDIF12:
;Main calc routine
;SysDivLoop = 32
	MOVLW	32
	MOVWF	SYSDIVLOOP
GLOBAL	SYSDIV32START
SYSDIV32START:
;set C off
	BCF	STATUS,0
;Rotate SysLongDivMultA Left
	BANKSEL	SYSLONGDIVMULTA
	RLF	SYSLONGDIVMULTA,F
	RLF	SYSLONGDIVMULTA_H,F
	RLF	SYSLONGDIVMULTA_U,F
	RLF	SYSLONGDIVMULTA_E,F
;Rotate SysLongDivMultX Left
	BANKSEL	SYSLONGDIVMULTX
	RLF	SYSLONGDIVMULTX,F
	RLF	SYSLONGDIVMULTX_H,F
	RLF	SYSLONGDIVMULTX_U,F
	RLF	SYSLONGDIVMULTX_E,F
;SysLongDivMultX = SysLongDivMultX - SysLongDivMultB
	BANKSEL	SYSLONGDIVMULTB
	MOVF	SYSLONGDIVMULTB,W
	BANKSEL	SYSLONGDIVMULTX
	SUBWF	SYSLONGDIVMULTX,F
	BANKSEL	SYSLONGDIVMULTB_H
	MOVF	SYSLONGDIVMULTB_H,W
	BANKSEL	SYSLONGDIVMULTX_H
	SUBWFB	SYSLONGDIVMULTX_H,F
	BANKSEL	SYSLONGDIVMULTB_U
	MOVF	SYSLONGDIVMULTB_U,W
	BANKSEL	SYSLONGDIVMULTX_U
	SUBWFB	SYSLONGDIVMULTX_U,F
	BANKSEL	SYSLONGDIVMULTB_E
	MOVF	SYSLONGDIVMULTB_E,W
	BANKSEL	SYSLONGDIVMULTX_E
	SUBWFB	SYSLONGDIVMULTX_E,F
;Set SysLongDivMultA.0 On
	BANKSEL	SYSLONGDIVMULTA
	BSF	SYSLONGDIVMULTA,0
;If C Off Then
	BTFSC	STATUS,0
	GOTO	ENDIF13
;Set SysLongDivMultA.0 Off
	BCF	SYSLONGDIVMULTA,0
;SysLongDivMultX = SysLongDivMultX + SysLongDivMultB
	MOVF	SYSLONGDIVMULTB,W
	BANKSEL	SYSLONGDIVMULTX
	ADDWF	SYSLONGDIVMULTX,F
	BANKSEL	SYSLONGDIVMULTB_H
	MOVF	SYSLONGDIVMULTB_H,W
	BANKSEL	SYSLONGDIVMULTX_H
	ADDWFC	SYSLONGDIVMULTX_H,F
	BANKSEL	SYSLONGDIVMULTB_U
	MOVF	SYSLONGDIVMULTB_U,W
	BANKSEL	SYSLONGDIVMULTX_U
	ADDWFC	SYSLONGDIVMULTX_U,F
	BANKSEL	SYSLONGDIVMULTB_E
	MOVF	SYSLONGDIVMULTB_E,W
	BANKSEL	SYSLONGDIVMULTX_E
	ADDWFC	SYSLONGDIVMULTX_E,F
;End If
GLOBAL	ENDIF13
ENDIF13:
;decfsz SysDivLoop, F
	DECFSZ	SYSDIVLOOP, F
;goto SysDiv32Start
	GOTO	SYSDIV32START
;SysLongTempA = SysLongDivMultA
	BANKSEL	SYSLONGDIVMULTA
	MOVF	SYSLONGDIVMULTA,W
	MOVWF	SYSLONGTEMPA
	MOVF	SYSLONGDIVMULTA_H,W
	MOVWF	SYSLONGTEMPA_H
	MOVF	SYSLONGDIVMULTA_U,W
	MOVWF	SYSLONGTEMPA_U
	MOVF	SYSLONGDIVMULTA_E,W
	MOVWF	SYSLONGTEMPA_E
;SysLongTempX = SysLongDivMultX
	BANKSEL	SYSLONGDIVMULTX
	MOVF	SYSLONGDIVMULTX,W
	MOVWF	SYSLONGTEMPX
	MOVF	SYSLONGDIVMULTX_H,W
	MOVWF	SYSLONGTEMPX_H
	MOVF	SYSLONGDIVMULTX_U,W
	MOVWF	SYSLONGTEMPX_U
	MOVF	SYSLONGDIVMULTX_E,W
	MOVWF	SYSLONGTEMPX_E
	BANKSEL	STATUS
	RETURN

;********************************************************************************

;START OF PROGRAM MEMORY PAGE 1
	PSECT	PROGMEM1,CLASS=CODE,SPACE=SPACE_CODE,DELTA=2, ABS, OVRLD 
	ORG	2048
GLOBAL	DELAY_S
DELAY_S:
GLOBAL	DS_START
DS_START:
	MOVLW	232
	MOVWF	SYSWAITTEMPMS
	MOVLW	3
	MOVWF	SYSWAITTEMPMS_H
	FCALL	DELAY_MS
	DECFSZ	SYSWAITTEMPS, F
	GOTO	DS_START
	RETURN

;********************************************************************************

;SOURCE: GLCD_ILI9341.H (1207)
GLOBAL	GLCDROTATE_ILI9341
GLCDROTATE_ILI9341:
;#define ILI9341_MADCTL_MY  0x80
;#define ILI9341_MADCTL_MX  0x40
;#define ILI9341_MADCTL_MV  0x20
;#define ILI9341_MADCTL_ML  0x10
;#define ILI9341_MADCTL_RGB 0x00
;#define ILI9341_MADCTL_BGR 0x08
;#define ILI9341_MADCTL_MH  0x04
;SendCommand_ILI9341 ( ILI9341_MADCTL )
	MOVLW	54
	MOVWF	ILI9341SENDBYTE
	FCALL	SENDCOMMAND_ILI9341
;select case GLCDRotateState
;case PORTRAIT
GLOBAL	SYSSELECT2CASE1
SYSSELECT2CASE1:
	MOVLW	4
	SUBWF	GLCDROTATESTATE,W
	BTFSS	STATUS,2
	GOTO	SYSSELECT2CASE2
;ILI9341_GLCD_WIDTH = GLCD_WIDTH
	MOVLW	240
	MOVWF	GLCDDEVICEWIDTH
	CLRF	GLCDDEVICEWIDTH_H
;ILI9341_GLCD_HEIGHT = GLCD_HEIGHT
	MOVLW	64
	MOVWF	GLCDDEVICEHEIGHT
	MOVLW	1
	MOVWF	GLCDDEVICEHEIGHT_H
;SendData_ILI9341( ILI9341_MADCTL_MX | ILI9341_MADCTL_BGR)
	MOVLW	72
	MOVWF	ILI9341SENDBYTE
	FCALL	SENDDATA_ILI9341
;case LANDSCAPE
	GOTO	SYSSELECTEND2
GLOBAL	SYSSELECT2CASE2
SYSSELECT2CASE2:
	DECF	GLCDROTATESTATE,W
	BTFSS	STATUS,2
	GOTO	SYSSELECT2CASE3
;ILI9341_GLCD_WIDTH = GLCD_HEIGHT
	MOVLW	64
	MOVWF	GLCDDEVICEWIDTH
	MOVLW	1
	MOVWF	GLCDDEVICEWIDTH_H
;ILI9341_GLCD_HEIGHT = GLCD_WIDTH
	MOVLW	240
	MOVWF	GLCDDEVICEHEIGHT
	CLRF	GLCDDEVICEHEIGHT_H
;SendData_ILI9341( ILI9341_MADCTL_MV | ILI9341_MADCTL_BGR )
	MOVLW	40
	MOVWF	ILI9341SENDBYTE
	FCALL	SENDDATA_ILI9341
;case PORTRAIT_REV
	GOTO	SYSSELECTEND2
GLOBAL	SYSSELECT2CASE3
SYSSELECT2CASE3:
	MOVLW	2
	SUBWF	GLCDROTATESTATE,W
	BTFSS	STATUS,2
	GOTO	SYSSELECT2CASE4
;ILI9341_GLCD_WIDTH = GLCD_WIDTH
	MOVLW	240
	MOVWF	GLCDDEVICEWIDTH
	CLRF	GLCDDEVICEWIDTH_H
;ILI9341_GLCD_HEIGHT = GLCD_HEIGHT
	MOVLW	64
	MOVWF	GLCDDEVICEHEIGHT
	MOVLW	1
	MOVWF	GLCDDEVICEHEIGHT_H
;SendData_ILI9341( ILI9341_MADCTL_MY | ILI9341_MADCTL_BGR)
	MOVLW	136
	MOVWF	ILI9341SENDBYTE
	FCALL	SENDDATA_ILI9341
;case LANDSCAPE_REV
	GOTO	SYSSELECTEND2
GLOBAL	SYSSELECT2CASE4
SYSSELECT2CASE4:
	MOVLW	3
	SUBWF	GLCDROTATESTATE,W
	BTFSS	STATUS,2
	GOTO	SYSSELECT2CASE5
;ILI9341_GLCD_WIDTH = GLCD_HEIGHT
	MOVLW	64
	MOVWF	GLCDDEVICEWIDTH
	MOVLW	1
	MOVWF	GLCDDEVICEWIDTH_H
;ILI9341_GLCD_HEIGHT = GLCD_WIDTH
	MOVLW	240
	MOVWF	GLCDDEVICEHEIGHT
	CLRF	GLCDDEVICEHEIGHT_H
;SendData_ILI9341(  ILI9341_MADCTL_MV | ILI9341_MADCTL_MY | ILI9341_MADCTL_MX | ILI9341_MADCTL_BGR )
	MOVLW	232
	MOVWF	ILI9341SENDBYTE
	FCALL	SENDDATA_ILI9341
;case else
	GOTO	SYSSELECTEND2
GLOBAL	SYSSELECT2CASE5
SYSSELECT2CASE5:
;ILI9341_GLCD_WIDTH = GLCD_WIDTH
	MOVLW	240
	MOVWF	GLCDDEVICEWIDTH
	CLRF	GLCDDEVICEWIDTH_H
;ILI9341_GLCD_HEIGHT = GLCD_HEIGHT
	MOVLW	64
	MOVWF	GLCDDEVICEHEIGHT
	MOVLW	1
	MOVWF	GLCDDEVICEHEIGHT_H
;SendData_ILI9341( ILI9341_MADCTL_MX | ILI9341_MADCTL_BGR )
	MOVLW	72
	MOVWF	ILI9341SENDBYTE
	FCALL	SENDDATA_ILI9341
;end select
GLOBAL	SYSSELECTEND2
SYSSELECTEND2:
	RETURN

;********************************************************************************

;SOURCE: HWSPI.H (624)
GLOBAL	HWSPITRANSFER
HWSPITRANSFER:
;Master mode
;If SPICurrentMode > 10 Then
	MOVF	SPICURRENTMODE,W
	SUBLW	10
	BTFSC	STATUS,0
	GOTO	ELSE19_1
;Clear WCOL
;Set SSPCON1.WCOL Off
	BANKSEL	SSP1CON1
	BCF	SSP1CON1,7
;Put byte to send into buffer
;Will start transfer
;SSPBUF = SPITxData
	BANKSEL	SPITXDATA
	MOVF	SPITXDATA,W
	BANKSEL	SSP1BUF
	MOVWF	SSP1BUF
;Slave mode
;Else
	GOTO	ENDIF19
GLOBAL	ELSE19_1
ELSE19_1:
;Retry until send succeeds
;Do
GLOBAL	SYSDOLOOP_S2
SYSDOLOOP_S2:
;SET SSPCON1.WCOL OFF
	BANKSEL	SSP1CON1
	BCF	SSP1CON1,7
;SSPBUF = SPITxData
	BANKSEL	SPITXDATA
	MOVF	SPITXDATA,W
	BANKSEL	SSP1BUF
	MOVWF	SSP1BUF
;Loop While SSPCON1.WCOL = On
	BTFSC	SSP1CON1,7
	GOTO	SYSDOLOOP_S2
GLOBAL	SYSDOLOOP_E2
SYSDOLOOP_E2:
;End If
GLOBAL	ENDIF19
ENDIF19:
;Read buffer
;Same for master and slave
;Wait While SSPSTAT.BF = Off
GLOBAL	SYSWAITLOOP3
SYSWAITLOOP3:
	BTFSS	SSP1STAT,0
	GOTO	SYSWAITLOOP3
;SPIRxData = SSPBUF
	MOVF	SSP1BUF,W
	BANKSEL	SPIRXDATA
	MOVWF	SPIRXDATA
;Set SSPSTAT.BF Off
	BANKSEL	SSP1STAT
	BCF	SSP1STAT,0
	BANKSEL	STATUS
	RETURN

;********************************************************************************

;SOURCE: GLCD_ILI9341.H (985)
GLOBAL	PSET_ILI9341
PSET_ILI9341:
;SetAddressWindow_ILI9341 ( GLCDX, GLCDY, GLCDX, GLCDY )
	MOVF	GLCDX,W
	BANKSEL	_X1
	MOVWF	_X1
	BANKSEL	GLCDX_H
	MOVF	GLCDX_H,W
	BANKSEL	_X1_H
	MOVWF	_X1_H
	BANKSEL	GLCDY
	MOVF	GLCDY,W
	BANKSEL	_Y1
	MOVWF	_Y1
	BANKSEL	GLCDY_H
	MOVF	GLCDY_H,W
	BANKSEL	_Y1_H
	MOVWF	_Y1_H
	BANKSEL	GLCDX
	MOVF	GLCDX,W
	BANKSEL	_X2
	MOVWF	_X2
	BANKSEL	GLCDX_H
	MOVF	GLCDX_H,W
	BANKSEL	_X2_H
	MOVWF	_X2_H
	BANKSEL	GLCDY
	MOVF	GLCDY,W
	BANKSEL	_Y2
	MOVWF	_Y2
	BANKSEL	GLCDY_H
	MOVF	GLCDY_H,W
	BANKSEL	_Y2_H
	MOVWF	_Y2_H
	BANKSEL	STATUS
	CALL	SETADDRESSWINDOW_ILI9341
;SendWord_ILI9341 GLCDColour
	MOVF	GLCDCOLOUR,W
	MOVWF	ILI9341SENDWORD
	MOVF	GLCDCOLOUR_H,W
	MOVWF	ILI9341SENDWORD_H
	LJMP	SENDWORD_ILI9341

;********************************************************************************

;SOURCE: GLCD_ILI9341.H (997)
GLOBAL	SENDCOMMAND_ILI9341
SENDCOMMAND_ILI9341:
;SPI mode
;set ILI9341_CS OFF;
	BCF	LATA,2
;set ILI9341_DC OFF;
	BCF	LATA,1
;SPITransfer  ILI9341SendByte,  ILI9341TempOut
	MOVF	ILI9341SENDBYTE,W
	MOVWF	SPITXDATA
	CALL	HWSPITRANSFER
	MOVF	SPIRXDATA,W
	MOVWF	ILI9341TEMPOUT
;set ILI9341_CS ON;
	BSF	LATA,2
;exit sub
	RETURN
	RETURN

;********************************************************************************

;SOURCE: GLCD_ILI9341.H (1050)
GLOBAL	SENDDATA_ILI9341
SENDDATA_ILI9341:
;SPI mode
;set ILI9341_CS OFF;
	BCF	LATA,2
;set ILI9341_DC ON;
	BSF	LATA,1
;SPITransfer  ILI9341SendByte,  ILI9341TempOut
	MOVF	ILI9341SENDBYTE,W
	MOVWF	SPITXDATA
	CALL	HWSPITRANSFER
	MOVF	SPIRXDATA,W
	MOVWF	ILI9341TEMPOUT
;set ILI9341_CS ON;
	BSF	LATA,2
;exit sub
	RETURN
	RETURN

;********************************************************************************

;SOURCE: GLCD_ILI9341.H (1103)
GLOBAL	SENDWORD_ILI9341
SENDWORD_ILI9341:
;dim ILI9341SendWord as word
;SPI mode
;set ILI9341_CS OFF;
	BCF	LATA,2
;set ILI9341_DC ON;
	BSF	LATA,1
;SPITransfer  ILI9341SendWord_H,  ILI9341TempOut
	MOVF	ILI9341SENDWORD_H,W
	MOVWF	SPITXDATA
	FCALL	HWSPITRANSFER
	MOVF	SPIRXDATA,W
	MOVWF	ILI9341TEMPOUT
;SPITransfer  ILI9341SendWord,  ILI9341TempOut
	MOVF	ILI9341SENDWORD,W
	MOVWF	SPITXDATA
	FCALL	HWSPITRANSFER
	MOVF	SPIRXDATA,W
	MOVWF	ILI9341TEMPOUT
;set ILI9341_CS ON;
	BSF	LATA,2
;exit sub
	RETURN
	RETURN

;********************************************************************************

;SOURCE: GLCD_ILI9341.H (1170)
GLOBAL	SETADDRESSWINDOW_ILI9341
SETADDRESSWINDOW_ILI9341:
;SendCommand_ILI9341(ILI9341_CASET); // Column addr set
	MOVLW	42
	MOVWF	ILI9341SENDBYTE
	FCALL	SENDCOMMAND_ILI9341
;SendData_ILI9341 _x1_H
	BANKSEL	_X1_H
	MOVF	_X1_H,W
	BANKSEL	ILI9341SENDBYTE
	MOVWF	ILI9341SENDBYTE
	FCALL	SENDDATA_ILI9341
;SendData_ILI9341 _x1
	BANKSEL	_X1
	MOVF	_X1,W
	BANKSEL	ILI9341SENDBYTE
	MOVWF	ILI9341SENDBYTE
	FCALL	SENDDATA_ILI9341
;SendData_ILI9341 _x2_H
	BANKSEL	_X2_H
	MOVF	_X2_H,W
	BANKSEL	ILI9341SENDBYTE
	MOVWF	ILI9341SENDBYTE
	FCALL	SENDDATA_ILI9341
;SendData_ILI9341 _x2
	BANKSEL	_X2
	MOVF	_X2,W
	BANKSEL	ILI9341SENDBYTE
	MOVWF	ILI9341SENDBYTE
	FCALL	SENDDATA_ILI9341
;SendCommand_ILI9341(ILI9341_PASET); // Row addr set
	MOVLW	43
	MOVWF	ILI9341SENDBYTE
	FCALL	SENDCOMMAND_ILI9341
;SendData_ILI9341 _y1_H
	BANKSEL	_Y1_H
	MOVF	_Y1_H,W
	BANKSEL	ILI9341SENDBYTE
	MOVWF	ILI9341SENDBYTE
	FCALL	SENDDATA_ILI9341
;SendData_ILI9341 _y1
	BANKSEL	_Y1
	MOVF	_Y1,W
	BANKSEL	ILI9341SENDBYTE
	MOVWF	ILI9341SENDBYTE
	FCALL	SENDDATA_ILI9341
;SendData_ILI9341 _y2_H
	BANKSEL	_Y2_H
	MOVF	_Y2_H,W
	BANKSEL	ILI9341SENDBYTE
	MOVWF	ILI9341SENDBYTE
	FCALL	SENDDATA_ILI9341
;SendData_ILI9341 _y2
	BANKSEL	_Y2
	MOVF	_Y2,W
	BANKSEL	ILI9341SENDBYTE
	MOVWF	ILI9341SENDBYTE
	FCALL	SENDDATA_ILI9341
;SendCommand_ILI9341(ILI9341_RAMWR); // write to RAM
	MOVLW	44
	MOVWF	ILI9341SENDBYTE
	LJMP	SENDCOMMAND_ILI9341

;********************************************************************************

;OVERLOADED SIGNATURE: BYTE:BYTE:, SOURCE: HWSPI.H (382)
GLOBAL	SPIMODE706
SPIMODE706:
;Supports Legacy SPI via MSSP module
;added for 16f18855
;added for 16f18855
;added for 16f18855
;Turn off SPI
;(Prevents any weird glitches during setup)
;Set SSPCON1.SSPEN Off ;(Prevents any weird glitches during setup)
	BANKSEL	SSP1CON1
	BCF	SSP1CON1,5
;Set clock pulse settings
;Set SSPSTAT.SMP Off
	BCF	SSP1STAT,7
;Set SSPSTAT.CKE Off
	BCF	SSP1STAT,6
;If SPIClockMode.0 = Off Then
	BANKSEL	SPICLOCKMODE
	BTFSC	SPICLOCKMODE,0
	GOTO	ENDIF17
;Set SSPSTAT.CKE On
	BANKSEL	SSP1STAT
	BSF	SSP1STAT,6
;End If
GLOBAL	ENDIF17
ENDIF17:
;Set SSPCON1.CKP Off
	BANKSEL	SSP1CON1
	BCF	SSP1CON1,4
;If SPIClockMode.1 = On Then
	BANKSEL	SPICLOCKMODE
	BTFSS	SPICLOCKMODE,1
	GOTO	ENDIF18
;Set SSPCON1.CKP On
	BANKSEL	SSP1CON1
	BSF	SSP1CON1,4
;End If
GLOBAL	ENDIF18
ENDIF18:
;Select mode and clock
;Set some mode bits off, can set on later
;Set SSPCON1.SSPM3 Off
	BANKSEL	SSP1CON1
	BCF	SSP1CON1,3
;Set SSPCON1.SSPM2 Off
	BCF	SSP1CON1,2
;Set SSPCON1.SSPM1 Off
	BCF	SSP1CON1,1
;Set SSPCON1.SSPM0 Off
	BCF	SSP1CON1,0
;Select Case SPICurrentMode
;Case MasterSSPADDMode   '1010
GLOBAL	SYSSELECT3CASE1
SYSSELECT3CASE1:
	MOVLW	16
	BANKSEL	SPICURRENTMODE
	SUBWF	SPICURRENTMODE,W
	BTFSS	STATUS,2
	GOTO	SYSSELECT3CASE2
;Set SSPCON1.SSPM3 On
	BANKSEL	SSP1CON1
	BSF	SSP1CON1,3
;Set SSPCON1.SSPM1 On
	BSF	SSP1CON1,1
;SSP1ADD = 1
	MOVLW	1
	MOVWF	SSP1ADD
;Case MasterUltraFast
	GOTO	SYSSELECTEND3
GLOBAL	SYSSELECT3CASE2
SYSSELECT3CASE2:
	MOVLW	14
	SUBWF	SPICURRENTMODE,W
	BTFSS	STATUS,2
	GOTO	SYSSELECT3CASE3
;Nothing to do on PIC
;Case MasterFast
	GOTO	SYSSELECTEND3
GLOBAL	SYSSELECT3CASE3
SYSSELECT3CASE3:
	MOVLW	13
	SUBWF	SPICURRENTMODE,W
	BTFSS	STATUS,2
	GOTO	SYSSELECT3CASE4
;Nothing to do
;Case Master
	GOTO	SYSSELECTEND3
GLOBAL	SYSSELECT3CASE4
SYSSELECT3CASE4:
	MOVLW	12
	SUBWF	SPICURRENTMODE,W
	BTFSS	STATUS,2
	GOTO	SYSSELECT3CASE5
;Set SSPCON1.SSPM0 On
	BANKSEL	SSP1CON1
	BSF	SSP1CON1,0
;Case MasterSlow
	GOTO	SYSSELECTEND3
GLOBAL	SYSSELECT3CASE5
SYSSELECT3CASE5:
	MOVLW	11
	SUBWF	SPICURRENTMODE,W
	BTFSS	STATUS,2
	GOTO	SYSSELECT3CASE6
;Set SSPCON1.SSPM1 On
	BANKSEL	SSP1CON1
	BSF	SSP1CON1,1
;Case Slave
	GOTO	SYSSELECTEND3
GLOBAL	SYSSELECT3CASE6
SYSSELECT3CASE6:
	MOVF	SPICURRENTMODE,F
	BTFSS	STATUS,2
	GOTO	SYSSELECT3CASE7
;Set SSPCON1.SSPM2 On
	BANKSEL	SSP1CON1
	BSF	SSP1CON1,2
;Set SSPCON1.SSPM0 On
	BSF	SSP1CON1,0
;Case SlaveSS
	GOTO	SYSSELECTEND3
GLOBAL	SYSSELECT3CASE7
SYSSELECT3CASE7:
	DECF	SPICURRENTMODE,W
	BTFSS	STATUS,2
	GOTO	SYSSELECTEND3
;Set SSPCON1.SSPM2 On
	BANKSEL	SSP1CON1
	BSF	SSP1CON1,2
;End Select
GLOBAL	SYSSELECTEND3
SYSSELECTEND3:
;Enable SPI
;Set SSPCON1.SSPEN On
	BANKSEL	SSP1CON1
	BSF	SSP1CON1,5
	BANKSEL	STATUS
	RETURN

;********************************************************************************

;SOURCE: SYSTEM.H (3078)
GLOBAL	SYSCOMPEQUAL
SYSCOMPEQUAL:
;Dim SysByteTempA, SysByteTempB, SysByteTempX as byte
;clrf SysByteTempX
	CLRF	SYSBYTETEMPX
;movf SysByteTempA, W
	MOVF	SYSBYTETEMPA, W
;subwf SysByteTempB, W
	SUBWF	SYSBYTETEMPB, W
;btfsc STATUS, Z
	BTFSC	STATUS,2
;comf SysByteTempX,F
	COMF	SYSBYTETEMPX,F
	RETURN

;********************************************************************************

;SOURCE: SYSTEM.H (3158)
GLOBAL	SYSCOMPEQUAL32
SYSCOMPEQUAL32:
;dim SysLongTempA as long
;dim SysLongTempB as long
;dim SysByteTempX as byte
;clrf SysByteTempX
	CLRF	SYSBYTETEMPX
;Test low, exit if false
;movf SysLongTempA, W
	MOVF	SYSLONGTEMPA, W
;subwf SysLongTempB, W
	SUBWF	SYSLONGTEMPB, W
;btfss STATUS, Z
	BTFSS	STATUS,2
;return
	RETURN
;Test high, exit if false
;movf SysLongTempA_H, W
	MOVF	SYSLONGTEMPA_H, W
;subwf SysLongTempB_H, W
	SUBWF	SYSLONGTEMPB_H, W
;btfss STATUS, Z
	BTFSS	STATUS,2
;return
	RETURN
;Test upper, exit if false
;movf SysLongTempA_U, W
	MOVF	SYSLONGTEMPA_U, W
;subwf SysLongTempB_U, W
	SUBWF	SYSLONGTEMPB_U, W
;btfss STATUS, Z
	BTFSS	STATUS,2
;return
	RETURN
;Test exp, exit if false
;movf SysLongTempA_E, W
	MOVF	SYSLONGTEMPA_E, W
;subwf SysLongTempB_E, W
	SUBWF	SYSLONGTEMPB_E, W
;btfss STATUS, Z
	BTFSS	STATUS,2
;return
	RETURN
;comf SysByteTempX,F
	COMF	SYSBYTETEMPX,F
	RETURN

;********************************************************************************

;SOURCE: SYSTEM.H (3383)
GLOBAL	SYSCOMPLESSTHAN
SYSCOMPLESSTHAN:
;Dim SysByteTempA, SysByteTempB, SysByteTempX as byte
;clrf SysByteTempX
	CLRF	SYSBYTETEMPX
;bsf STATUS, C
	BSF	STATUS,0
;movf SysByteTempB, W
	MOVF	SYSBYTETEMPB, W
;subwf SysByteTempA, W
	SUBWF	SYSBYTETEMPA, W
;btfss STATUS, C
	BTFSS	STATUS,0
;comf SysByteTempX,F
	COMF	SYSBYTETEMPX,F
	RETURN

;********************************************************************************

;SOURCE: SYSTEM.H (2518)
GLOBAL	SYSMULTSUB
SYSMULTSUB:
;dim SysByteTempA as byte
;dim SysByteTempB as byte
;dim SysByteTempX as byte
;clrf SysByteTempX
	CLRF	SYSBYTETEMPX
GLOBAL	MUL8LOOP
MUL8LOOP:
;movf SysByteTempA, W
	MOVF	SYSBYTETEMPA, W
;btfsc SysByteTempB, 0
	BTFSC	SYSBYTETEMPB, 0
;addwf SysByteTempX, F
	ADDWF	SYSBYTETEMPX, F
;bcf STATUS, C
	BCF	STATUS,0
;rrf SysByteTempB, F
	RRF	SYSBYTETEMPB, F
;bcf STATUS, C
	BCF	STATUS,0
;rlf SysByteTempA, F
	RLF	SYSBYTETEMPA, F
;movf SysByteTempB, F
	MOVF	SYSBYTETEMPB, F
;btfss STATUS, Z
	BTFSS	STATUS,2
;goto MUL8LOOP
	GOTO	MUL8LOOP
	RETURN

;********************************************************************************

GLOBAL	SYSSTRINGTABLES
SYSSTRINGTABLES:
	MOVF	SYSSTRINGA_H,W
	MOVWF	PCLATH
	MOVF	SYSSTRINGA,W
	INCF	SYSSTRINGA,F
	BTFSC	STATUS,2
	INCF	SYSSTRINGA_H,F
	MOVWF	PCL

GLOBAL	STRINGTABLE1
STRINGTABLE1:
	RETLW	16
	RETLW	71	;G
	RETLW	76	;L
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	RETLW	103	;G


;********************************************************************************

;START OF PROGRAM MEMORY PAGE 2
	PSECT	PROGMEM2,CLASS=CODE,SPACE=SPACE_CODE,DELTA=2, ABS, OVRLD 
	ORG	4096
;START OF PROGRAM MEMORY PAGE 3
	PSECT	PROGMEM3,CLASS=CODE,SPACE=SPACE_CODE,DELTA=2, ABS, OVRLD 
	ORG	6144
;
; Declare Power-On-Reset entry point
;
 END     RESETVEC
