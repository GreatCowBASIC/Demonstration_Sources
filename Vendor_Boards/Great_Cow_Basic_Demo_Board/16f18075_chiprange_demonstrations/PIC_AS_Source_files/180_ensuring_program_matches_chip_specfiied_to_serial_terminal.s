;Program compiled by Great Cow BASIC (1.00.00 Release Candidate 2022-09-11 (Windows 64 bit) : Build 1168x) for Microchip PIC-AS
;  See the GCBASIC forums at http://sourceforge.net/projects/gcbasic/forums,
;  Check the documentation and Help at http://gcbasic.sourceforge.net/help/,
;or, email:
;   evanvennn at users dot sourceforge dot net

;********************************************************************************


;Set up the assembler options (Chip type, clock source, other bits and pieces)
;PROCESSOR   16F18075
 PAGEWIDTH   180
 RADIX       DEC
 TITLE       "d:\GreatCowBASICGits\Demonstration_Sources.git\trunk\Vendor_Boards\Great_Cow_Basic_Demo_Board\16f18075_chiprange_demonstrations\180_ensuring_program_matches_chip_specfiied_to_serial_terminal.s"
 SUBTITLE    "09-11-2022"

; Reverse lookup file(s)
; C:\Program Files\Microchip\xc8\v2.40\pic\include\proc\pic16f18075.inc
; C:\Program Files\Microchip\xc8\v2.40\pic\dat\cfgmap\16f18075.cfgmap
; Alternative CONFIG file is to be found at C:\Program Files\Microchip\xc8\vX.YY\pic\dat\cfgdata as per Microchip support ticket #00730936 

;********************************************************************************

;********************************************************************************
;Explicit CONFIG
 CONFIG CLKOUTEN=OFF                             ;C1 Reverselookup CLKOUTEN = OFF
 CONFIG RSTOSC=HFINTOSC_32MHz                    ;C1 Reverselookup RSTOSC = HFINTOSC_32MHZ
 CONFIG FEXTOSC=OFF                              ;C1 Reverselookup FEXTOSC = OFF
 CONFIG WDTE=OFF                                 ;C1 Reverselookup WDTE = OFF
 CONFIG MCLRE=INTMCLR                            ;C1 Reverselookup MCLRE = INTMCLR
 CONFIG LVP=OFF                                  ;C1 Reverselookup LVP = OFF
 CONFIG WRTSAF=OFF                               ;C1 Reverselookup WRTSAF = OFF
 CONFIG WRTD=OFF                                 ;C1 Reverselookup WRTD = OFF
 CONFIG WRTB=OFF                                 ;C1 Reverselookup WRTB = OFF
 CONFIG CPD=OFF                                  ;C1 Reverselookup CPD = OFF
 CONFIG CP=OFF                                   ;C1 Reverselookup CP = OFF
;Inferred CONFIG


;********************************************************************************
; The XC8 xc.inc include file.  This MUST be placed after the CONFIG statements.

 #include <xc.inc>

;********************************************************************************

;Set aside RAM memory locations for variables. All variables are global.
 ASC                              EQU 32          ; 0X20
 COMPORT                          EQU 33          ; 0X21
 DELAYTEMP                        EQU 112          ; 0X70
 DELAYTEMP2                       EQU 113          ; 0X71
 HSERPRINTCRLFCOUNT               EQU 34          ; 0X22
 LTRIM                            EQU 9159          ; 0X23C7
 MID                              EQU 9118          ; 0X239E
 PRINTLEN                         EQU 35          ; 0X23
 RTRIM                            EQU 9077          ; 0X2375
 SERDATA                          EQU 36          ; 0X24
 STRINGPOINTER                    EQU 37          ; 0X25
 SYSARRAYTEMP1                    EQU 38          ; 0X26
 SYSARRAYTEMP2                    EQU 39          ; 0X27
 SYSBYTETEMPA                     EQU 117          ; 0X75
 SYSBYTETEMPB                     EQU 121          ; 0X79
 SYSBYTETEMPX                     EQU 112          ; 0X70
 SYSCALCTEMPA                     EQU 117          ; 0X75
 SYSCHAR                          EQU 40          ; 0X28
 SYSCHARCOUNT                     EQU 41          ; 0X29
 SYSCHARLT                        EQU 42          ; 0X2A
 SYSCHARLTCOUNT                   EQU 43          ; 0X2B
 SYSCHARRT                        EQU 44          ; 0X2C
 SYSCHARRTCOUNT                   EQU 45          ; 0X2D
 SYSCHARSTART                     EQU 46          ; 0X2E
 SYSDIVMULTA                      EQU 119          ; 0X77
 SYSDIVMULTA_H                    EQU 120          ; 0X78
 SYSFORLOOPSTEP4                  EQU 47          ; 0X2F
 SYSFORLOOPSTEP4_H                EQU 48          ; 0X30
 SYSINTEGERTEMPA                  EQU 117          ; 0X75
 SYSINTEGERTEMPA_H                EQU 118          ; 0X76
 SYSINTEGERTEMPB                  EQU 121          ; 0X79
 SYSINTEGERTEMPB_H                EQU 122          ; 0X7A
 SYSPRINTDATAHANDLER              EQU 49          ; 0X31
 SYSPRINTDATAHANDLER_H            EQU 50          ; 0X32
 SYSPRINTTEMP                     EQU 51          ; 0X33
 SYSREPEATTEMP1                   EQU 52          ; 0X34
 SYSSTRDATA                       EQU 53          ; 0X35
 SYSSTRINGA                       EQU 119          ; 0X77
 SYSSTRINGA_H                     EQU 120          ; 0X78
 SYSSTRINGLENGTH                  EQU 118          ; 0X76
 SYSSTRINGPARAM1                  EQU 8945          ; 0X22F1
 SYSSTRINGTEMP                    EQU 54          ; 0X36
 SYSSYSINSTRING2HANDLER           EQU 55          ; 0X37
 SYSSYSINSTRING2HANDLER_H         EQU 56          ; 0X38
 SYSSYSINSTRING3HANDLER           EQU 57          ; 0X39
 SYSSYSINSTRING3HANDLER_H         EQU 58          ; 0X3A
 SYSSYSINSTRINGAHANDLER           EQU 59          ; 0X3B
 SYSSYSINSTRINGAHANDLER_H         EQU 60          ; 0X3C
 SYSSYSINSTRINGHANDLER            EQU 61          ; 0X3D
 SYSSYSINSTRINGHANDLER_H          EQU 62          ; 0X3E
 SYSTEMP1                         EQU 63          ; 0X3F
 SYSTEMP2                         EQU 64          ; 0X40
 SYSTEMP2_H                       EQU 65          ; 0X41
 SYSTEMP3                         EQU 66          ; 0X42
 SYSTEMPARRAY                     EQU 9036          ; 0X234C
 SYSTEMPLT                        EQU 67          ; 0X43
 SYSTEMPRT                        EQU 68          ; 0X44
 SYSWAITTEMPMS                    EQU 114          ; 0X72
 SYSWAITTEMPMS_H                  EQU 115          ; 0X73
 SYSWAITTEMPS                     EQU 116          ; 0X74
 TRIM                             EQU 8995          ; 0X2323
 UCASE                            EQU 8954          ; 0X22FA

;********************************************************************************

;ALIAS VARIABLES
 AFSR0                            EQU 4
 AFSR0_H                          EQU 5
 SYSMID_0                         EQU 1486
 SYSUCASE_0                       EQU 1226

;********************************************************************************

 PSECT   PROGMEM0,delta=2, abs
 RESETVEC:
;VECTORS
	ORG	0
	PAGESEL	BASPROGRAMSTART
	GOTO	BASPROGRAMSTART
	ORG	4
	RETFIE

;********************************************************************************

;START OF PROGRAM MEMORY PAGE 0
	ORG	5
BASPROGRAMSTART:
;CALL INITIALISATION ROUTINES
	CALL	INITSYS
	CALL	INITPPS
	CALL	INITUSART

;START OF THE MAIN PROGRAM
	BCF	TRISB,1
	BCF	TRISB,2
	BCF	TRISB,3
	BCF	TRISB,4
	BSF	TRISA,0
	BSF	TRISB,5
	MOVLW	1
	MOVWF	HSERPRINTCRLFCOUNT
	MOVLW	1
	MOVWF	COMPORT
	CALL	HSERPRINTCRLF
	MOVLW	LOW SYSSTRINGPARAM1
	MOVWF	FSR1L
	MOVLW	HIGH SYSSTRINGPARAM1
	MOVWF	FSR1H
	CLRF	SYSSTRINGLENGTH
	MOVLW	LOW STRINGTABLE72
	MOVWF	SYSSTRINGA
	MOVLW	(HIGH STRINGTABLE72) & 127
	MOVWF	SYSSTRINGA_H
	CALL	SYSREADSTRINGPART
	MOVLW	LOW STRINGTABLE1
	MOVWF	SYSSTRINGA
	MOVLW	(HIGH STRINGTABLE1) & 127
	MOVWF	SYSSTRINGA_H
	CALL	SYSREADSTRINGPART
	MOVLW	LOW SYSSTRINGPARAM1
	MOVWF	FSR0L
	MOVLW	HIGH SYSSTRINGPARAM1
	MOVWF	FSR0H
	MOVF	SYSSTRINGLENGTH,W
	MOVWF	INDF0
	MOVLW	LOW SYSSTRINGPARAM1
	MOVWF	SYSPRINTDATAHANDLER
	MOVLW	HIGH SYSSTRINGPARAM1
	MOVWF	SYSPRINTDATAHANDLER_H
	MOVLW	1
	MOVWF	COMPORT
	CALL	HSERPRINT304
	MOVLW	1
	MOVWF	HSERPRINTCRLFCOUNT
	MOVLW	1
	MOVWF	COMPORT
	CALL	HSERPRINTCRLF
	MOVLW	1
	MOVWF	SYSWAITTEMPS
	CALL	DELAY_S
	MOVLW	LOW STRINGTABLE2
	MOVWF	SYSSYSINSTRINGHANDLER
	MOVLW	(HIGH STRINGTABLE2) | 128
	MOVWF	SYSSYSINSTRINGHANDLER_H
	CALL	FN_UCASE
	MOVLW	LOW UCASE
	MOVWF	SYSSYSINSTRINGHANDLER
	MOVLW	HIGH UCASE
	MOVWF	SYSSYSINSTRINGHANDLER_H
	CALL	FN_TRIM
	MOVLW	LOW SYSTEMPARRAY
	MOVWF	FSR1L
	MOVLW	HIGH SYSTEMPARRAY
	MOVWF	FSR1H
	MOVLW	LOW STRINGTABLE72
	MOVWF	SYSSTRINGA
	MOVLW	(HIGH STRINGTABLE72) & 127
	MOVWF	SYSSTRINGA_H
	CALL	SYSREADSTRING
	MOVLW	LOW TRIM
	MOVWF	FSR0L
	MOVLW	HIGH TRIM
	MOVWF	FSR0H
	MOVLW	LOW SYSTEMPARRAY
	MOVWF	FSR1L
	MOVLW	HIGH SYSTEMPARRAY
	MOVWF	FSR1H
	CALL	SYSCOMPEQUALSTRING
	COMF	SYSBYTETEMPX,F
	BTFSS	SYSBYTETEMPX,0
	GOTO	ELSE1_1
	MOVLW	LOW STRINGTABLE3
	MOVWF	SYSPRINTDATAHANDLER
	MOVLW	(HIGH STRINGTABLE3) | 128
	MOVWF	SYSPRINTDATAHANDLER_H
	MOVLW	1
	MOVWF	COMPORT
	CALL	HSERPRINT304
	MOVLW	1
	MOVWF	HSERPRINTCRLFCOUNT
	MOVLW	1
	MOVWF	COMPORT
	CALL	HSERPRINTCRLF
	MOVLW	LOW STRINGTABLE4
	MOVWF	SYSPRINTDATAHANDLER
	MOVLW	(HIGH STRINGTABLE4) | 128
	MOVWF	SYSPRINTDATAHANDLER_H
	MOVLW	1
	MOVWF	COMPORT
	CALL	HSERPRINT304
	MOVLW	LOW STRINGTABLE72
	MOVWF	SYSPRINTDATAHANDLER
	MOVLW	(HIGH STRINGTABLE72) | 128
	MOVWF	SYSPRINTDATAHANDLER_H
	MOVLW	1
	MOVWF	COMPORT
	CALL	HSERPRINT304
	MOVLW	1
	MOVWF	HSERPRINTCRLFCOUNT
	MOVLW	1
	MOVWF	COMPORT
	CALL	HSERPRINTCRLF
SYSWAITLOOP1:
	GOTO	SYSWAITLOOP1
	GOTO	ENDIF1
ELSE1_1:
	MOVLW	LOW STRINGTABLE5
	MOVWF	SYSPRINTDATAHANDLER
	MOVLW	(HIGH STRINGTABLE5) | 128
	MOVWF	SYSPRINTDATAHANDLER_H
	MOVLW	1
	MOVWF	COMPORT
	CALL	HSERPRINT304
	MOVLW	LOW STRINGTABLE72
	MOVWF	SYSPRINTDATAHANDLER
	MOVLW	(HIGH STRINGTABLE72) | 128
	MOVWF	SYSPRINTDATAHANDLER_H
	MOVLW	1
	MOVWF	COMPORT
	CALL	HSERPRINT304
	MOVLW	1
	MOVWF	HSERPRINTCRLFCOUNT
	MOVLW	1
	MOVWF	COMPORT
	CALL	HSERPRINTCRLF
SYSWAITLOOP2:
	GOTO	SYSWAITLOOP2
ENDIF1:
	GOTO	BASPROGRAMEND
BASPROGRAMEND:
	SLEEP
	GOTO	BASPROGRAMEND

;********************************************************************************

FN_ASC:
	CLRF	ASC
	MOVF	SYSSYSINSTRINGAHANDLER,W
	MOVWF	FSR0L
	MOVF	SYSSYSINSTRINGAHANDLER_H,W
	MOVWF	FSR0H
	MOVF	INDF0,W
	MOVWF	SYSCHARCOUNT
	MOVF	SYSCHARCOUNT,F
	BTFSC	STATUS,2
	RETURN
	MOVF	SYSCHAR,W
	SUBWF	SYSCHARCOUNT,W
	BTFSS	STATUS,0
	RETURN
	MOVF	SYSCHAR,W
	ADDWF	SYSSYSINSTRINGAHANDLER,W
	MOVWF	FSR0L
	MOVLW	0
	ADDWFC	SYSSYSINSTRINGAHANDLER_H,W
	MOVWF	FSR0H
	MOVF	INDF0,W
	MOVWF	ASC
	RETURN

;********************************************************************************

DELAY_MS:
	INCF	SYSWAITTEMPMS_H, F
DMS_START:
	MOVLW	14
	MOVWF	DELAYTEMP2
DMS_OUTER:
	MOVLW	189
	MOVWF	DELAYTEMP
DMS_INNER:
	DECFSZ	DELAYTEMP, F
	GOTO	DMS_INNER
	DECFSZ	DELAYTEMP2, F
	GOTO	DMS_OUTER
	DECFSZ	SYSWAITTEMPMS, F
	GOTO	DMS_START
	DECFSZ	SYSWAITTEMPMS_H, F
	GOTO	DMS_START
	RETURN

;********************************************************************************

DELAY_S:
DS_START:
	MOVLW	232
	MOVWF	SYSWAITTEMPMS
	MOVLW	3
	MOVWF	SYSWAITTEMPMS_H
	CALL	DELAY_MS
	DECFSZ	SYSWAITTEMPS, F
	GOTO	DS_START
	RETURN

;********************************************************************************

HSERPRINT304:
	MOVF	SYSPRINTDATAHANDLER,W
	MOVWF	FSR0L
	MOVF	SYSPRINTDATAHANDLER_H,W
	MOVWF	FSR0H
	MOVF	INDF0,W
	MOVWF	PRINTLEN
	MOVF	PRINTLEN,F
	BTFSC	STATUS,2
	GOTO	ENDIF12
	MOVLW	1
	MOVWF	SYSPRINTTEMP
SYSFORLOOP3:
	MOVF	SYSPRINTTEMP,W
	ADDWF	SYSPRINTDATAHANDLER,W
	MOVWF	FSR0L
	MOVLW	0
	ADDWFC	SYSPRINTDATAHANDLER_H,W
	MOVWF	FSR0H
	MOVF	INDF0,W
	MOVWF	SERDATA
	CALL	HSERSEND294
	MOVF	SYSPRINTTEMP,W
	SUBWF	PRINTLEN,W
	MOVWF	SYSTEMP1
	MOVWF	SYSBYTETEMPA
	CLRF	SYSBYTETEMPB
	CALL	SYSCOMPEQUAL
	COMF	SYSBYTETEMPX,F
	BTFSS	SYSBYTETEMPX,0
	GOTO	ENDIF13
	INCF	SYSPRINTTEMP,F
	GOTO	SYSFORLOOP3
ENDIF13:
SYSFORLOOPEND3:
ENDIF12:
	RETURN

;********************************************************************************

HSERPRINTCRLF:
	MOVF	HSERPRINTCRLFCOUNT,W
	MOVWF	SYSREPEATTEMP1
	BTFSC	STATUS,2
	GOTO	SYSREPEATLOOPEND1
SYSREPEATLOOP1:
	MOVLW	13
	MOVWF	SERDATA
	CALL	HSERSEND294
	MOVLW	10
	MOVWF	SERDATA
	CALL	HSERSEND294
	DECFSZ	SYSREPEATTEMP1,F
	GOTO	SYSREPEATLOOP1
SYSREPEATLOOPEND1:
	RETURN

;********************************************************************************

HSERSEND294:
	DECF	COMPORT,W
	BTFSS	STATUS,2
	GOTO	ENDIF25
SYSWAITLOOP3:
	BANKSEL	PIR3
	BTFSS	PIR3,2
	GOTO	SYSWAITLOOP3
SYSWAITLOOP4:
	BANKSEL	TX1STA
	BTFSS	TX1STA,1
	GOTO	SYSWAITLOOP4
	BANKSEL	SERDATA
	MOVF	SERDATA,W
	BANKSEL	TX1REG
	MOVWF	TX1REG
	MOVLW	1
	MOVWF	SYSWAITTEMPMS
	CLRF	SYSWAITTEMPMS_H
	BANKSEL	STATUS
	CALL	DELAY_MS
ENDIF25:
	RETURN

;********************************************************************************

INITPPS:
	MOVLW	14
	BANKSEL	RC6PPS
	MOVWF	RC6PPS
	BANKSEL	STATUS
	RETURN

;********************************************************************************

INITSYS:
;asm showdebug This code block sets the internal oscillator to ChipMHz
	BANKSEL	OSCCON2
	CLRF	OSCCON2
	CLRF	OSCCON3
	MOVLW	5
	MOVWF	OSCFRQ
;asm showdebug _Complete_the_chip_setup_of_BSR,ADCs,ANSEL_and_other_key_setup_registers_or_register_bits
	BANKSEL	ADCON0
	BCF	ADCON0,2
	BCF	ADCON0,7
	BANKSEL	ANSELA
	CLRF	ANSELA
	CLRF	ANSELB
	CLRF	ANSELC
	CLRF	ANSELD
	CLRF	ANSELE
	BANKSEL	CM1CON0
	BCF	CM1CON0,7
	BANKSEL	PORTA
	CLRF	PORTA
	CLRF	PORTB
	CLRF	PORTC
	CLRF	PORTD
	CLRF	PORTE
	RETURN

;********************************************************************************

INITUSART:
	MOVLW	1
	MOVWF	COMPORT
;asm showdebug Values_calculated_in_the_script
;asm showdebug _SPBRGH_TEMP=_ SPBRGH_TEMP
;asm showdebug _SPBRGL_TEMP=_ SPBRGL_TEMP
;asm showdebug _BRG16_TEMP=_ BRG16_TEMP
;asm showdebug _BRGH_TEMP=_ BRGH_TEMP
	MOVLW	64
	BANKSEL	SP1BRGL
	MOVWF	SP1BRGL
	MOVLW	3
	MOVWF	SP1BRGH
	MOVLW	64
	MOVWF	SP1BRGL
	BSF	BAUD1CON,3
	BSF	TX1STA,2
	BCF	TX1STA,4
	BSF	TX1STA,5
	BSF	RC1STA,7
	BSF	RC1STA,4
	BANKSEL	STATUS
	RETURN

;********************************************************************************

FN_LTRIM:
	MOVLW	LOW LTRIM
	MOVWF	FSR1L
	MOVLW	HIGH LTRIM
	MOVWF	FSR1H
	MOVLW	LOW STRINGTABLE37
	MOVWF	SYSSTRINGA
	MOVLW	(HIGH STRINGTABLE37) & 127
	MOVWF	SYSSTRINGA_H
	CALL	SYSREADSTRING
	MOVF	SYSSYSINSTRING2HANDLER,W
	MOVWF	FSR0L
	MOVF	SYSSYSINSTRING2HANDLER_H,W
	MOVWF	FSR0H
	MOVF	INDF0,W
	MOVWF	SYSCHARLTCOUNT
	MOVF	SYSCHARLTCOUNT,F
	BTFSC	STATUS,2
	RETURN
	CLRF	SYSCHARLT
	MOVLW	1
	MOVWF	SYSTEMPLT
SYSFORLOOP1:
	MOVF	SYSSYSINSTRING2HANDLER,W
	MOVWF	SYSSYSINSTRINGHANDLER
	MOVF	SYSSYSINSTRING2HANDLER_H,W
	MOVWF	SYSSYSINSTRINGHANDLER_H
	MOVF	SYSTEMPLT,W
	MOVWF	SYSCHARSTART
	MOVLW	1
	MOVWF	SYSCHARCOUNT
	CALL	FN_MID
	MOVLW	LOW MID
	MOVWF	SYSSYSINSTRINGAHANDLER
	MOVLW	HIGH MID
	MOVWF	SYSSYSINSTRINGAHANDLER_H
	MOVLW	1
	MOVWF	SYSCHAR
	CALL	FN_ASC
	MOVLW	32
	SUBWF	ASC,W
	BTFSC	STATUS,2
	GOTO	ENDIF3
	MOVF	SYSTEMPLT,W
	MOVWF	SYSCHARLT
	GOTO	FOUNDNONSPACECHAR1
ENDIF3:
	MOVF	SYSTEMPLT,W
	SUBWF	SYSCHARLTCOUNT,W
	MOVWF	SYSTEMP1
	MOVWF	SYSBYTETEMPA
	CLRF	SYSBYTETEMPB
	CALL	SYSCOMPEQUAL
	COMF	SYSBYTETEMPX,F
	BTFSS	SYSBYTETEMPX,0
	GOTO	ENDIF4
	INCF	SYSTEMPLT,F
	GOTO	SYSFORLOOP1
ENDIF4:
SYSFORLOOPEND1:
FOUNDNONSPACECHAR1:
	MOVF	SYSCHARLT,F
	BTFSC	STATUS,2
	GOTO	ENDIF5
	MOVF	SYSSYSINSTRING2HANDLER,W
	MOVWF	SYSSYSINSTRINGHANDLER
	MOVF	SYSSYSINSTRING2HANDLER_H,W
	MOVWF	SYSSYSINSTRINGHANDLER_H
	MOVF	SYSCHARLT,W
	MOVWF	SYSCHARSTART
	MOVLW	255
	MOVWF	SYSCHARCOUNT
	CALL	FN_MID
	MOVLW	LOW LTRIM
	MOVWF	FSR1L
	MOVLW	HIGH LTRIM
	MOVWF	FSR1H
	MOVLW	LOW MID
	MOVWF	FSR0L
	MOVLW	HIGH MID
	MOVWF	FSR0H
	CALL	SYSCOPYSTRING
	RETURN
ENDIF5:
	RETURN

;********************************************************************************

FN_MID:
	MOVF	SYSSYSINSTRINGHANDLER,W
	MOVWF	FSR0L
	MOVF	SYSSYSINSTRINGHANDLER_H,W
	MOVWF	FSR0H
	MOVF	INDF0,F
	BTFSS	STATUS,2
	GOTO	ENDIF14
	BANKSEL	SYSMID_0
	CLRF	SYSMID_0
	BANKSEL	STATUS
	RETURN
ENDIF14:
	MOVLW	1
	SUBWF	SYSCHARSTART,W
	BTFSC	STATUS,0
	GOTO	ENDIF15
	MOVLW	1
	MOVWF	SYSCHARSTART
ENDIF15:
	MOVF	SYSSYSINSTRINGHANDLER,W
	MOVWF	FSR0L
	MOVF	SYSSYSINSTRINGHANDLER_H,W
	MOVWF	FSR0H
	MOVF	SYSCHARSTART,W
	SUBWF	INDF0,W
	BTFSC	STATUS,0
	GOTO	ENDIF16
	BANKSEL	SYSMID_0
	CLRF	SYSMID_0
	BANKSEL	STATUS
	RETURN
ENDIF16:
	DECF	SYSCHARSTART,F
	MOVF	SYSSYSINSTRINGHANDLER,W
	MOVWF	FSR0L
	MOVF	SYSSYSINSTRINGHANDLER_H,W
	MOVWF	FSR0H
	MOVF	SYSCHARSTART,W
	SUBWF	INDF0,W
	MOVWF	SYSSTRINGTEMP
	MOVF	SYSCHARCOUNT,W
	SUBWF	SYSSTRINGTEMP,W
	BTFSC	STATUS,0
	GOTO	ENDIF17
	MOVF	SYSSTRINGTEMP,W
	MOVWF	SYSCHARCOUNT
ENDIF17:
	MOVLW	1
	MOVWF	SYSSTRINGTEMP
SYSFORLOOP4:
	MOVF	SYSSTRINGTEMP,W
	ADDWF	SYSCHARSTART,W
	MOVWF	SYSTEMP1
	ADDWF	SYSSYSINSTRINGHANDLER,W
	MOVWF	FSR0L
	MOVLW	0
	ADDWFC	SYSSYSINSTRINGHANDLER_H,W
	MOVWF	FSR0H
	MOVF	INDF0,W
	MOVWF	SYSARRAYTEMP1
	MOVWF	SYSARRAYTEMP2
	MOVLW	LOW(MID)
	ADDWF	SYSSTRINGTEMP,W
	MOVWF	FSR0L
	CLRF	SYSTEMP1
	MOVLW	HIGH(MID)
	ADDWFC	SYSTEMP1,W
	MOVWF	FSR0H
	MOVF	SYSARRAYTEMP2,W
	MOVWF	INDF0
	MOVF	SYSSTRINGTEMP,W
	SUBWF	SYSCHARCOUNT,W
	MOVWF	SYSTEMP1
	MOVWF	SYSBYTETEMPA
	CLRF	SYSBYTETEMPB
	CALL	SYSCOMPEQUAL
	COMF	SYSBYTETEMPX,F
	BTFSS	SYSBYTETEMPX,0
	GOTO	ENDIF18
	INCF	SYSSTRINGTEMP,F
	GOTO	SYSFORLOOP4
ENDIF18:
SYSFORLOOPEND4:
	MOVF	SYSCHARCOUNT,W
	BANKSEL	SYSMID_0
	MOVWF	SYSMID_0
	BANKSEL	STATUS
	RETURN

;********************************************************************************

FN_RTRIM:
	MOVLW	LOW RTRIM
	MOVWF	FSR1L
	MOVLW	HIGH RTRIM
	MOVWF	FSR1H
	MOVLW	LOW STRINGTABLE37
	MOVWF	SYSSTRINGA
	MOVLW	(HIGH STRINGTABLE37) & 127
	MOVWF	SYSSTRINGA_H
	CALL	SYSREADSTRING
	MOVF	SYSSYSINSTRING3HANDLER,W
	MOVWF	FSR0L
	MOVF	SYSSYSINSTRING3HANDLER_H,W
	MOVWF	FSR0H
	MOVF	INDF0,W
	MOVWF	SYSCHARRTCOUNT
	MOVF	SYSCHARRTCOUNT,F
	BTFSC	STATUS,2
	RETURN
	CLRF	SYSCHARRT
	MOVF	SYSCHARRTCOUNT,W
	MOVWF	SYSTEMPRT
SYSFORLOOP5:
;INIT SYSFORLOOPSTEP4 :#0
	MOVLW	255
	MOVWF	SYSFORLOOPSTEP4
	MOVWF	SYSFORLOOPSTEP4_H
	MOVF	SYSTEMPRT,W
	ADDWF	SYSSYSINSTRING3HANDLER,W
	MOVWF	FSR0L
	MOVLW	0
	ADDWFC	SYSSYSINSTRING3HANDLER_H,W
	MOVWF	FSR0H
	MOVLW	32
	SUBWF	INDF0,W
	BTFSC	STATUS,2
	GOTO	ENDIF20
	MOVF	SYSTEMPRT,W
	MOVWF	SYSCHARRT
	GOTO	FOUNDNONSPACECHAR2
ENDIF20:
	BTFSS	SYSFORLOOPSTEP4_H,7
	GOTO	ELSE21_1
	DECF	SYSTEMPRT,W
	MOVWF	SYSTEMP1
	COMF	SYSFORLOOPSTEP4,W
	MOVWF	SYSTEMP2
	COMF	SYSFORLOOPSTEP4_H,W
	MOVWF	SYSTEMP2_H
	INCF	SYSTEMP2,F
	BTFSC	STATUS,2
	INCF	SYSTEMP2_H,F
	MOVF	SYSTEMP1,W
	MOVWF	SYSINTEGERTEMPA
	CLRF	SYSINTEGERTEMPA_H
	MOVF	SYSTEMP2,W
	MOVWF	SYSINTEGERTEMPB
	MOVF	SYSTEMP2_H,W
	MOVWF	SYSINTEGERTEMPB_H
	CALL	SYSCOMPLESSTHANINT
	COMF	SYSBYTETEMPX,F
	BTFSS	SYSBYTETEMPX,0
	GOTO	ENDIF23
	MOVF	SYSFORLOOPSTEP4,W
	ADDWF	SYSTEMPRT,F
	GOTO	SYSFORLOOP5
ENDIF23:
	GOTO	ENDIF21
ELSE21_1:
	MOVF	SYSTEMPRT,W
	SUBLW	1
	MOVWF	SYSTEMP1
	MOVWF	SYSINTEGERTEMPA
	CLRF	SYSINTEGERTEMPA_H
	MOVF	SYSFORLOOPSTEP4,W
	MOVWF	SYSINTEGERTEMPB
	MOVF	SYSFORLOOPSTEP4_H,W
	MOVWF	SYSINTEGERTEMPB_H
	CALL	SYSCOMPLESSTHANINT
	COMF	SYSBYTETEMPX,F
	BTFSS	SYSBYTETEMPX,0
	GOTO	ENDIF24
	MOVF	SYSFORLOOPSTEP4,W
	ADDWF	SYSTEMPRT,F
	GOTO	SYSFORLOOP5
ENDIF24:
ENDIF21:
SYSFORLOOPEND5:
FOUNDNONSPACECHAR2:
	MOVF	SYSCHARRT,F
	BTFSC	STATUS,2
	GOTO	ENDIF22
	MOVF	SYSSYSINSTRING3HANDLER,W
	MOVWF	SYSSYSINSTRINGHANDLER
	MOVF	SYSSYSINSTRING3HANDLER_H,W
	MOVWF	SYSSYSINSTRINGHANDLER_H
	MOVLW	1
	MOVWF	SYSCHARSTART
	MOVF	SYSCHARRT,W
	MOVWF	SYSCHARCOUNT
	CALL	FN_MID
	MOVLW	LOW RTRIM
	MOVWF	FSR1L
	MOVLW	HIGH RTRIM
	MOVWF	FSR1H
	MOVLW	LOW MID
	MOVWF	FSR0L
	MOVLW	HIGH MID
	MOVWF	FSR0H
	CALL	SYSCOPYSTRING
	RETURN
ENDIF22:
	RETURN

;********************************************************************************

SYSCOMPEQUAL:
	CLRF	SYSBYTETEMPX
	MOVF	SYSBYTETEMPA, W
	SUBWF	SYSBYTETEMPB, W
	BTFSC	STATUS,2
	COMF	SYSBYTETEMPX,F
	RETURN

;********************************************************************************

SYSCOMPEQUALSTRING:
	CLRF	SYSBYTETEMPX
	MOVF	INDF0, W
	MOVWF	SYSBYTETEMPA
	SUBWF	INDF1, W
	BTFSS	STATUS,2
	RETURN
	MOVF	SYSBYTETEMPA, F
	BTFSC	STATUS,2
	GOTO	SCESTRTRUE
SYSSTRINGCOMP:
	ADDFSR	0, 1
	ADDFSR	1, 1
	MOVF	INDF0, W
	SUBWF	INDF1, W
	BTFSS	STATUS,2
	RETURN
	DECFSZ	SYSBYTETEMPA, F
	GOTO	SYSSTRINGCOMP
SCESTRTRUE:
	COMF	SYSBYTETEMPX, F
	RETURN

;********************************************************************************

SYSCOMPLESSTHANINT:
	CLRF	SYSBYTETEMPX
	BTFSS	SYSINTEGERTEMPA_H,7
	GOTO	ELSE26_1
	BTFSC	SYSINTEGERTEMPB_H,7
	GOTO	ENDIF27
	COMF	SYSBYTETEMPX,F
	RETURN
ENDIF27:
	COMF	SYSINTEGERTEMPA,W
	MOVWF	SYSDIVMULTA
	COMF	SYSINTEGERTEMPA_H,W
	MOVWF	SYSDIVMULTA_H
	INCF	SYSDIVMULTA,F
	BTFSC	STATUS,2
	INCF	SYSDIVMULTA_H,F
	COMF	SYSINTEGERTEMPB,W
	MOVWF	SYSINTEGERTEMPA
	COMF	SYSINTEGERTEMPB_H,W
	MOVWF	SYSINTEGERTEMPA_H
	INCF	SYSINTEGERTEMPA,F
	BTFSC	STATUS,2
	INCF	SYSINTEGERTEMPA_H,F
	MOVF	SYSDIVMULTA,W
	MOVWF	SYSINTEGERTEMPB
	MOVF	SYSDIVMULTA_H,W
	MOVWF	SYSINTEGERTEMPB_H
	GOTO	ENDIF26
ELSE26_1:
	BTFSC	SYSINTEGERTEMPB_H,7
	RETURN
ENDIF26:
	MOVF	SYSINTEGERTEMPA_H,W
	SUBWF	SYSINTEGERTEMPB_H,W
	BTFSS	STATUS,0
	RETURN
	MOVF	SYSINTEGERTEMPB_H,W
	SUBWF	SYSINTEGERTEMPA_H,W
	BTFSS	STATUS,0
	GOTO	SCLTINTTRUE
	MOVF	SYSINTEGERTEMPB,W
	SUBWF	SYSINTEGERTEMPA,W
	BTFSC	STATUS,0
	RETURN
SCLTINTTRUE:
	COMF	SYSBYTETEMPX,F
	RETURN

;********************************************************************************

SYSCOPYSTRING:
	MOVF	INDF0, W
	MOVWF	SYSCALCTEMPA
	MOVWF	INDF1
	GOTO	SYSCOPYSTRINGCHECK
SYSCOPYSTRINGPART:
	MOVF	INDF0, W
	MOVWF	SYSCALCTEMPA
	ADDWF	SYSSTRINGLENGTH, F
SYSCOPYSTRINGCHECK:
	MOVF	SYSCALCTEMPA,F
	BTFSC	STATUS,2
	RETURN
SYSSTRINGCOPY:
	ADDFSR	0, 1
	ADDFSR	1, 1
	MOVF	INDF0, W
	MOVWF	INDF1
	DECFSZ	SYSCALCTEMPA, F
	GOTO	SYSSTRINGCOPY
	RETURN

;********************************************************************************

SYSREADSTRING:
	CALL	SYSSTRINGTABLES
	MOVWF	SYSCALCTEMPA
	MOVWF	INDF1
	GOTO	SYSSTRINGREADCHECK
SYSREADSTRINGPART:
	CALL	SYSSTRINGTABLES
	MOVWF	SYSCALCTEMPA
	ADDWF	SYSSTRINGLENGTH,F
SYSSTRINGREADCHECK:
	MOVF	SYSCALCTEMPA,F
	BTFSC	STATUS,2
	RETURN
SYSSTRINGREAD:
	CALL	SYSSTRINGTABLES
	ADDFSR	1,1
	MOVWF	INDF1
	DECFSZ	SYSCALCTEMPA, F
	GOTO	SYSSTRINGREAD
	RETURN

;********************************************************************************

SYSSTRINGTABLES:
	MOVF	SYSSTRINGA_H,W
	MOVWF	PCLATH
	MOVF	SYSSTRINGA,W
	INCF	SYSSTRINGA,F
	BTFSC	STATUS,2
	INCF	SYSSTRINGA_H,F
	MOVWF	PCL

STRINGTABLE1:
	RETLW	21
	RETLW	32	; 
	RETLW	71	;G
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	RETLW	111	;O


STRINGTABLE2:
	RETLW	8
	RETLW	49	;1
	RETLW	54	;6
	RETLW	70	;F
	RETLW	49	;1
	RETLW	56	;8
	RETLW	48	;0
	RETLW	55	;7
	RETLW	53	;5


STRINGTABLE3:
	RETLW	51
	RETLW	87	;W
	RETLW	114	;R
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	RETLW	32	; 
	RETLW	49	;1
	RETLW	54	;6
	RETLW	70	;F
	RETLW	49	;1
	RETLW	56	;8
	RETLW	48	;0
	RETLW	55	;7
	RETLW	53	;5


STRINGTABLE4:
	RETLW	25
	RETLW	84	;T
	RETLW	104	;H
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	RETLW	32	; 


STRINGTABLE5:
	RETLW	45
	RETLW	84	;T
	RETLW	104	;H
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	RETLW	32	; 


STRINGTABLE37:
	RETLW	0


STRINGTABLE72:
	RETLW	8
	RETLW	49	;1
	RETLW	54	;6
	RETLW	70	;F
	RETLW	49	;1
	RETLW	56	;8
	RETLW	48	;0
	RETLW	55	;7
	RETLW	53	;5


;********************************************************************************

FN_TRIM:
	MOVF	SYSSYSINSTRINGHANDLER,W
	MOVWF	SYSSYSINSTRING2HANDLER
	MOVF	SYSSYSINSTRINGHANDLER_H,W
	MOVWF	SYSSYSINSTRING2HANDLER_H
	CALL	FN_LTRIM
	MOVLW	LOW LTRIM
	MOVWF	SYSSYSINSTRING3HANDLER
	MOVLW	HIGH LTRIM
	MOVWF	SYSSYSINSTRING3HANDLER_H
	CALL	FN_RTRIM
	MOVLW	LOW TRIM
	MOVWF	FSR1L
	MOVLW	HIGH TRIM
	MOVWF	FSR1H
	MOVLW	LOW RTRIM
	MOVWF	FSR0L
	MOVLW	HIGH RTRIM
	MOVWF	FSR0H
	GOTO	SYSCOPYSTRING

;********************************************************************************

FN_UCASE:
	MOVF	SYSSYSINSTRINGHANDLER,W
	MOVWF	FSR0L
	MOVF	SYSSYSINSTRINGHANDLER_H,W
	MOVWF	FSR0H
	MOVF	INDF0,W
	MOVWF	SYSCHARCOUNT
	BANKSEL	SYSUCASE_0
	MOVWF	SYSUCASE_0
	BANKSEL	SYSCHARCOUNT
	MOVF	SYSCHARCOUNT,F
	BTFSC	STATUS,2
	RETURN
	MOVLW	1
	MOVWF	SYSSTRINGTEMP
SYSFORLOOP2:
	MOVF	SYSSTRINGTEMP,W
	ADDWF	SYSSYSINSTRINGHANDLER,W
	MOVWF	FSR0L
	MOVLW	0
	ADDWFC	SYSSYSINSTRINGHANDLER_H,W
	MOVWF	FSR0H
	MOVF	INDF0,W
	MOVWF	SYSSTRDATA
	MOVLW	97
	SUBWF	SYSSTRDATA,W
	BTFSS	STATUS,0
	GOTO	ENDIF7
	MOVF	SYSSTRDATA,W
	SUBLW	122
	BTFSS	STATUS,0
	GOTO	ENDIF9
	MOVLW	32
	SUBWF	SYSSTRDATA,F
ENDIF9:
ENDIF7:
	MOVLW	LOW(UCASE)
	ADDWF	SYSSTRINGTEMP,W
	MOVWF	FSR0L
	CLRF	SYSTEMP1
	MOVLW	HIGH(UCASE)
	ADDWFC	SYSTEMP1,W
	MOVWF	FSR0H
	MOVF	SYSSTRDATA,W
	MOVWF	INDF0
	MOVF	SYSSTRINGTEMP,W
	SUBWF	SYSCHARCOUNT,W
	MOVWF	SYSTEMP1
	MOVWF	SYSBYTETEMPA
	CLRF	SYSBYTETEMPB
	CALL	SYSCOMPEQUAL
	COMF	SYSBYTETEMPX,F
	BTFSS	SYSBYTETEMPX,0
	GOTO	ENDIF8
	INCF	SYSSTRINGTEMP,F
	GOTO	SYSFORLOOP2
ENDIF8:
SYSFORLOOPEND2:
	RETURN

;********************************************************************************

;START OF PROGRAM MEMORY PAGE 1
	PSECT	PROGMEM1,CLASS=CODE,SPACE=SPACE_CODE,DELTA=2, ABS, OVRLD 
	ORG	2048
;START OF PROGRAM MEMORY PAGE 2
	PSECT	PROGMEM2,CLASS=CODE,SPACE=SPACE_CODE,DELTA=2, ABS, OVRLD 
	ORG	4096
;START OF PROGRAM MEMORY PAGE 3
	PSECT	PROGMEM3,CLASS=CODE,SPACE=SPACE_CODE,DELTA=2, ABS, OVRLD 
	ORG	6144
;
; Declare Power-On-Reset entry point
;
 END     RESETVEC
