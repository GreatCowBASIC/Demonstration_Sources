;Program compiled by Great Cow BASIC (1.00.00 Release Candidate 2022-09-11 (Windows 64 bit) : Build 1168x) for Microchip PIC-AS
;  See the GCBASIC forums at http://sourceforge.net/projects/gcbasic/forums,
;  Check the documentation and Help at http://gcbasic.sourceforge.net/help/,
;or, email:
;   evanvennn at users dot sourceforge dot net

;********************************************************************************


;Set up the assembler options (Chip type, clock source, other bits and pieces)
;PROCESSOR   16F18075
 PAGEWIDTH   180
 RADIX       DEC
 TITLE       "d:\GreatCowBASICGits\Demonstration_Sources.git\trunk\Vendor_Boards\Great_Cow_Basic_Demo_Board\16f18075_chiprange_demonstrations\280_showing_SAF_data_to_serial_terminal.s"
 SUBTITLE    "09-11-2022"

; Reverse lookup file(s)
; C:\Program Files\Microchip\xc8\v2.40\pic\include\proc\pic16f18075.inc
; C:\Program Files\Microchip\xc8\v2.40\pic\dat\cfgmap\16f18075.cfgmap
; Alternative CONFIG file is to be found at C:\Program Files\Microchip\xc8\vX.YY\pic\dat\cfgdata as per Microchip support ticket #00730936 

;********************************************************************************

;********************************************************************************
;Explicit CONFIG
 CONFIG CLKOUTEN=OFF                             ;C1 Reverselookup CLKOUTEN = OFF
 CONFIG RSTOSC=HFINTOSC_32MHz                    ;C1 Reverselookup RSTOSC = HFINTOSC_32MHZ
 CONFIG FEXTOSC=OFF                              ;C1 Reverselookup FEXTOSC = OFF
 CONFIG WDTE=OFF                                 ;C1 Reverselookup WDTE = OFF
 CONFIG MCLRE=INTMCLR                            ;C1 Reverselookup MCLRE = INTMCLR
 CONFIG LVP=OFF                                  ;C1 Reverselookup LVP = OFF
 CONFIG WRTSAF=OFF                               ;C1 Reverselookup WRTSAF = OFF
 CONFIG WRTD=OFF                                 ;C1 Reverselookup WRTD = OFF
 CONFIG WRTB=OFF                                 ;C1 Reverselookup WRTB = OFF
 CONFIG SAFEN=ON                                 ;C1 Reverselookup SAFEN = ON
 CONFIG CPD=OFF                                  ;C1 Reverselookup CPD = OFF
 CONFIG CP=OFF                                   ;C1 Reverselookup CP = OFF
;Inferred CONFIG


;********************************************************************************
; The XC8 xc.inc include file.  This MUST be placed after the CONFIG statements.

 #include <xc.inc>

;********************************************************************************

;Set aside RAM memory locations for variables. All variables are global.
 BLOCKNUM                         EQU 32          ; 0X20
 COMPORT                          EQU 33          ; 0X21
 DATABYTE                         EQU 34          ; 0X22
 DATAWORD                         EQU 35          ; 0X23
 DATAWORD_H                       EQU 36          ; 0X24
 DELAYTEMP                        EQU 112          ; 0X70
 DELAYTEMP2                       EQU 113          ; 0X71
 HSERPRINTCRLFCOUNT               EQU 37          ; 0X25
 INDEX                            EQU 38          ; 0X26
 INDEXWORD                        EQU 39          ; 0X27
 INDEXWORD_H                      EQU 40          ; 0X28
 MYBUFFER                         EQU 9167          ; 0X23CF
 NUMBYTES                         EQU 41          ; 0X29
 NVM_ADDRESS                      EQU 42          ; 0X2A
 NVM_ADDRESS_E                    EQU 45          ; 0X2D
 NVM_ADDRESS_H                    EQU 43          ; 0X2B
 NVM_ADDRESS_U                    EQU 44          ; 0X2C
 OUTVALUETEMP                     EQU 46          ; 0X2E
 PRINTLEN                         EQU 47          ; 0X2F
 REL_ADDRESS                      EQU 48          ; 0X30
 SAFREAD                          EQU 49          ; 0X31
 SAFREADWORD                      EQU 50          ; 0X32
 SAFREADWORD_H                    EQU 51          ; 0X33
 SERDATA                          EQU 52          ; 0X34
 SERPRINTVAL                      EQU 53          ; 0X35
 STRINGPOINTER                    EQU 54          ; 0X36
 SYSBYTETEMPA                     EQU 117          ; 0X75
 SYSBYTETEMPB                     EQU 121          ; 0X79
 SYSBYTETEMPX                     EQU 112          ; 0X70
 SYSCALCTEMPA                     EQU 117          ; 0X75
 SYSCALCTEMPX                     EQU 112          ; 0X70
 SYSDIVLOOP                       EQU 116          ; 0X74
 SYSDIVMULTA                      EQU 119          ; 0X77
 SYSDIVMULTA_H                    EQU 120          ; 0X78
 SYSDIVMULTB                      EQU 123          ; 0X7B
 SYSDIVMULTB_H                    EQU 124          ; 0X7C
 SYSDIVMULTX                      EQU 114          ; 0X72
 SYSDIVMULTX_H                    EQU 115          ; 0X73
 SYSLONGDIVMULTA                  EQU 55          ; 0X37
 SYSLONGDIVMULTA_E                EQU 58          ; 0X3A
 SYSLONGDIVMULTA_H                EQU 56          ; 0X38
 SYSLONGDIVMULTA_U                EQU 57          ; 0X39
 SYSLONGDIVMULTB                  EQU 59          ; 0X3B
 SYSLONGDIVMULTB_E                EQU 62          ; 0X3E
 SYSLONGDIVMULTB_H                EQU 60          ; 0X3C
 SYSLONGDIVMULTB_U                EQU 61          ; 0X3D
 SYSLONGDIVMULTX                  EQU 63          ; 0X3F
 SYSLONGDIVMULTX_E                EQU 66          ; 0X42
 SYSLONGDIVMULTX_H                EQU 64          ; 0X40
 SYSLONGDIVMULTX_U                EQU 65          ; 0X41
 SYSLONGTEMPA                     EQU 117          ; 0X75
 SYSLONGTEMPA_E                   EQU 120          ; 0X78
 SYSLONGTEMPA_H                   EQU 118          ; 0X76
 SYSLONGTEMPA_U                   EQU 119          ; 0X77
 SYSLONGTEMPB                     EQU 121          ; 0X79
 SYSLONGTEMPB_E                   EQU 124          ; 0X7C
 SYSLONGTEMPB_H                   EQU 122          ; 0X7A
 SYSLONGTEMPB_U                   EQU 123          ; 0X7B
 SYSLONGTEMPX                     EQU 112          ; 0X70
 SYSLONGTEMPX_E                   EQU 115          ; 0X73
 SYSLONGTEMPX_H                   EQU 113          ; 0X71
 SYSLONGTEMPX_U                   EQU 114          ; 0X72
 SYSPRINTDATAHANDLER              EQU 67          ; 0X43
 SYSPRINTDATAHANDLER_H            EQU 68          ; 0X44
 SYSPRINTTEMP                     EQU 69          ; 0X45
 SYSREPEATTEMP1                   EQU 70          ; 0X46
 SYSREPEATTEMP2                   EQU 71          ; 0X47
 SYSREPEATTEMP3                   EQU 72          ; 0X48
 SYSSTRINGA                       EQU 119          ; 0X77
 SYSSTRINGA_H                     EQU 120          ; 0X78
 SYSSTRINGLENGTH                  EQU 118          ; 0X76
 SYSSTRINGPARAM1                  EQU 9117          ; 0X239D
 SYSSTRINGTEMP                    EQU 73          ; 0X49
 SYSTEMP1                         EQU 74          ; 0X4A
 SYSTEMP1_E                       EQU 77          ; 0X4D
 SYSTEMP1_H                       EQU 75          ; 0X4B
 SYSTEMP1_U                       EQU 76          ; 0X4C
 SYSTEMP2                         EQU 78          ; 0X4E
 SYSTEMP2_H                       EQU 79          ; 0X4F
 SYSTEMP3                         EQU 80          ; 0X50
 SYSVALTEMP                       EQU 81          ; 0X51
 SYSWAITTEMPMS                    EQU 114          ; 0X72
 SYSWAITTEMPMS_H                  EQU 115          ; 0X73
 SYSWORDTEMPA                     EQU 117          ; 0X75
 SYSWORDTEMPA_H                   EQU 118          ; 0X76
 SYSWORDTEMPB                     EQU 121          ; 0X79
 SYSWORDTEMPB_H                   EQU 122          ; 0X7A
 SYSWORDTEMPX                     EQU 112          ; 0X70
 SYSWORDTEMPX_H                   EQU 113          ; 0X71
 SYS_HEF_BUFFERHANDLER            EQU 82          ; 0X52
 SYS_HEF_BUFFERHANDLER_H          EQU 83          ; 0X53
 WORD1                            EQU 84          ; 0X54
 WORD1_H                          EQU 85          ; 0X55
 WORD2                            EQU 86          ; 0X56
 WORD2_H                          EQU 87          ; 0X57
 WORD3                            EQU 88          ; 0X58
 WORD3_H                          EQU 89          ; 0X59
 WORD4                            EQU 90          ; 0X5A
 WORD4_H                          EQU 91          ; 0X5B
 _GIE_SAVE                        EQU 92          ; 0X5C
 _HEF_BLOCKNUM                    EQU 93          ; 0X5D
 _HEF_BUFFER                      EQU 9134          ; 0X23AE
 _HEF_COUNT                       EQU 94          ; 0X5E
 _HEF_COUNT_H                     EQU 95          ; 0X5F
 _HEF_DATABYTE                    EQU 96          ; 0X60
 _HEF_DATAWORD                    EQU 97          ; 0X61
 _HEF_DATAWORD_H                  EQU 98          ; 0X62
 _HEF_DUMMY                       EQU 99          ; 0X63
 _HEF_INDEX                       EQU 100          ; 0X64
 _HEF_INDEX_H                     EQU 101          ; 0X65
 _HEF_OFFSET                      EQU 102          ; 0X66
 _HEF_OFFSET_H                    EQU 103          ; 0X67
 _HEF_REL_ADDR                    EQU 104          ; 0X68
 _HEXPICAS                        EQU 9113          ; 0X2399

;********************************************************************************

;ALIAS VARIABLES
 AFSR0                            EQU 4
 AFSR0_H                          EQU 5
 SYS_HEXPICAS_0                   EQU 1481
 SYS_HEXPICAS_1                   EQU 1482
 SYS_HEXPICAS_2                   EQU 1483
 _HEF_ABS_ADDR                    EQU 7308
 _HEF_ABS_ADDR_H                  EQU 7309
 _HEF_ABS_ADDR_U                  EQU 99
 _HEF_ABS_ADDR_E                  EQU 99

;********************************************************************************

 PSECT   PROGMEM0,delta=2, abs
 RESETVEC:
;VECTORS
	ORG	0
	PAGESEL	BASPROGRAMSTART
	GOTO	BASPROGRAMSTART
	ORG	4
	RETFIE

;********************************************************************************

;START OF PROGRAM MEMORY PAGE 0
	ORG	5
BASPROGRAMSTART:
;CALL INITIALISATION ROUTINES
	CALL	INITSYS
	CALL	INITPPS
	CALL	INITUSART

;START OF THE MAIN PROGRAM
	BCF	TRISB,1
	BCF	TRISB,2
	BCF	TRISB,3
	BCF	TRISB,4
	BSF	TRISA,0
	BSF	TRISB,5
	MOVLW	200
	MOVWF	SYSWAITTEMPMS
	CLRF	SYSWAITTEMPMS_H
	CALL	DELAY_MS
	MOVLW	LOW MYBUFFER
	MOVWF	FSR0L
	MOVLW	HIGH MYBUFFER
	MOVWF	FSR0H
	MOVLW	8
	MOVWF	INDF0
	INCF	FSR0L,F
	MOVLW	32
	MOVWF	INDF0
	INCF	FSR0L,F
	MOVLW	44
	MOVWF	INDF0
	INCF	FSR0L,F
	MOVLW	88
	MOVWF	INDF0
	INCF	FSR0L,F
	MOVLW	91
	MOVWF	INDF0
	INCF	FSR0L,F
	MOVLW	77
	MOVWF	INDF0
	INCF	FSR0L,F
	MOVLW	78
	MOVWF	INDF0
	INCF	FSR0L,F
	MOVLW	63
	MOVWF	INDF0
	INCF	FSR0L,F
	MOVLW	99
	MOVWF	INDF0
	MOVLW	8
	MOVWF	NUMBYTES
	MOVLW	2
	MOVWF	HSERPRINTCRLFCOUNT
	MOVLW	1
	MOVWF	COMPORT
	CALL	HSERPRINTCRLF
	MOVLW	LOW STRINGTABLE1
	MOVWF	SYSPRINTDATAHANDLER
	MOVLW	(HIGH STRINGTABLE1) | 128
	MOVWF	SYSPRINTDATAHANDLER_H
	MOVLW	1
	MOVWF	COMPORT
	CALL	HSERPRINT305
	MOVLW	1
	MOVWF	HSERPRINTCRLFCOUNT
	MOVLW	1
	MOVWF	COMPORT
	CALL	HSERPRINTCRLF
	MOVLW	LOW STRINGTABLE2
	MOVWF	SYSPRINTDATAHANDLER
	MOVLW	(HIGH STRINGTABLE2) | 128
	MOVWF	SYSPRINTDATAHANDLER_H
	MOVLW	1
	MOVWF	COMPORT
	CALL	HSERPRINT305
	MOVLW	1
	MOVWF	INDEX
SYSFORLOOP1:
	MOVLW	LOW STRINGTABLE3
	MOVWF	SYSPRINTDATAHANDLER
	MOVLW	(HIGH STRINGTABLE3) | 128
	MOVWF	SYSPRINTDATAHANDLER_H
	MOVLW	1
	MOVWF	COMPORT
	CALL	HSERPRINT305
	MOVLW	LOW(MYBUFFER)
	ADDWF	INDEX,W
	MOVWF	FSR0L
	CLRF	SYSTEMP2
	MOVLW	HIGH(MYBUFFER)
	ADDWFC	SYSTEMP2,W
	MOVWF	FSR0H
	MOVF	INDF0,W
	MOVWF	SYSVALTEMP
	CALL	FN__HEXPICAS
	MOVLW	LOW _HEXPICAS
	MOVWF	SYSPRINTDATAHANDLER
	MOVLW	HIGH _HEXPICAS
	MOVWF	SYSPRINTDATAHANDLER_H
	MOVLW	1
	MOVWF	COMPORT
	CALL	HSERPRINT305
	MOVLW	32
	MOVWF	SERDATA
	CALL	HSERSEND294
	MOVF	INDEX,W
	SUBWF	NUMBYTES,W
	MOVWF	SYSTEMP1
	MOVWF	SYSBYTETEMPA
	CLRF	SYSBYTETEMPB
	CALL	SYSCOMPEQUAL
	COMF	SYSBYTETEMPX,F
	BTFSS	SYSBYTETEMPX,0
	GOTO	ENDIF1
	INCF	INDEX,F
	GOTO	SYSFORLOOP1
ENDIF1:
SYSFORLOOPEND1:
	CLRF	_HEF_BLOCKNUM
	MOVLW	LOW MYBUFFER
	MOVWF	SYS_HEF_BUFFERHANDLER
	MOVLW	HIGH MYBUFFER
	MOVWF	SYS_HEF_BUFFERHANDLER_H
	MOVF	NUMBYTES,W
	MOVWF	_HEF_COUNT
	CLRF	_HEF_COUNT_H
	CALL	SAFWRITEBLOCK
	CLRF	INDEXWORD
	CLRF	INDEXWORD_H
SYSFORLOOP2:
	MOVLW	LOW(MYBUFFER)
	ADDWF	INDEXWORD,W
	MOVWF	FSR0L
	MOVLW	HIGH(MYBUFFER)
	ADDWFC	INDEXWORD_H,W
	MOVWF	FSR0H
	MOVLW	255
	MOVWF	INDF0
	MOVF	INDEXWORD,W
	SUBLW	31
	MOVWF	SYSTEMP1
	CLRF	SYSTEMP2
	MOVF	INDEXWORD_H,W
	SUBWFB	SYSTEMP2,W
	MOVWF	SYSTEMP1_H
	MOVF	SYSTEMP1,W
	MOVWF	SYSWORDTEMPA
	MOVF	SYSTEMP1_H,W
	MOVWF	SYSWORDTEMPA_H
	CLRF	SYSWORDTEMPB
	CLRF	SYSWORDTEMPB_H
	CALL	SYSCOMPEQUAL16
	COMF	SYSBYTETEMPX,F
	BTFSS	SYSBYTETEMPX,0
	GOTO	ENDIF2
	INCF	INDEXWORD,F
	BTFSC	STATUS,2
	INCF	INDEXWORD_H,F
	GOTO	SYSFORLOOP2
ENDIF2:
SYSFORLOOPEND2:
	CLRF	_HEF_BLOCKNUM
	MOVLW	LOW MYBUFFER
	MOVWF	SYS_HEF_BUFFERHANDLER
	MOVLW	HIGH MYBUFFER
	MOVWF	SYS_HEF_BUFFERHANDLER_H
	MOVF	NUMBYTES,W
	MOVWF	_HEF_COUNT
	CLRF	_HEF_COUNT_H
	CALL	SAFREADBLOCK
	MOVLW	1
	MOVWF	HSERPRINTCRLFCOUNT
	MOVLW	1
	MOVWF	COMPORT
	CALL	HSERPRINTCRLF
	MOVLW	LOW STRINGTABLE4
	MOVWF	SYSPRINTDATAHANDLER
	MOVLW	(HIGH STRINGTABLE4) | 128
	MOVWF	SYSPRINTDATAHANDLER_H
	MOVLW	1
	MOVWF	COMPORT
	CALL	HSERPRINT305
	MOVLW	1
	MOVWF	INDEX
SYSFORLOOP3:
	MOVLW	LOW STRINGTABLE3
	MOVWF	SYSPRINTDATAHANDLER
	MOVLW	(HIGH STRINGTABLE3) | 128
	MOVWF	SYSPRINTDATAHANDLER_H
	MOVLW	1
	MOVWF	COMPORT
	CALL	HSERPRINT305
	MOVLW	LOW(MYBUFFER)
	ADDWF	INDEX,W
	MOVWF	FSR0L
	CLRF	SYSTEMP2
	MOVLW	HIGH(MYBUFFER)
	ADDWFC	SYSTEMP2,W
	MOVWF	FSR0H
	MOVF	INDF0,W
	MOVWF	SYSVALTEMP
	CALL	FN__HEXPICAS
	MOVLW	LOW _HEXPICAS
	MOVWF	SYSPRINTDATAHANDLER
	MOVLW	HIGH _HEXPICAS
	MOVWF	SYSPRINTDATAHANDLER_H
	MOVLW	1
	MOVWF	COMPORT
	CALL	HSERPRINT305
	MOVLW	32
	MOVWF	SERDATA
	CALL	HSERSEND294
	MOVF	INDEX,W
	SUBWF	NUMBYTES,W
	MOVWF	SYSTEMP2
	MOVWF	SYSBYTETEMPA
	CLRF	SYSBYTETEMPB
	CALL	SYSCOMPEQUAL
	COMF	SYSBYTETEMPX,F
	BTFSS	SYSBYTETEMPX,0
	GOTO	ENDIF3
	INCF	INDEX,F
	GOTO	SYSFORLOOP3
ENDIF3:
SYSFORLOOPEND3:
	MOVLW	1
	MOVWF	HSERPRINTCRLFCOUNT
	MOVLW	1
	MOVWF	COMPORT
	CALL	HSERPRINTCRLF
	MOVLW	LOW STRINGTABLE5
	MOVWF	SYSPRINTDATAHANDLER
	MOVLW	(HIGH STRINGTABLE5) | 128
	MOVWF	SYSPRINTDATAHANDLER_H
	MOVLW	1
	MOVWF	COMPORT
	CALL	HSERPRINT305
	MOVLW	255
	MOVWF	REL_ADDRESS
SYSFORLOOP4:
	INCF	REL_ADDRESS,F
	MOVF	REL_ADDRESS,W
	MOVWF	_HEF_REL_ADDR
	CALL	SAFREAD394
	MOVF	_HEF_DATABYTE,W
	MOVWF	DATABYTE
	MOVWF	SYSVALTEMP
	CALL	FN__HEXPICAS
	MOVLW	LOW SYSSTRINGPARAM1
	MOVWF	FSR1L
	MOVLW	HIGH SYSSTRINGPARAM1
	MOVWF	FSR1H
	CLRF	SYSSTRINGLENGTH
	MOVLW	LOW STRINGTABLE3
	MOVWF	SYSSTRINGA
	MOVLW	(HIGH STRINGTABLE3) & 127
	MOVWF	SYSSTRINGA_H
	CALL	SYSREADSTRINGPART
	MOVLW	LOW _HEXPICAS
	MOVWF	FSR0L
	MOVLW	HIGH _HEXPICAS
	MOVWF	FSR0H
	CALL	SYSCOPYSTRINGPART
	MOVLW	LOW SYSSTRINGPARAM1
	MOVWF	FSR0L
	MOVLW	HIGH SYSSTRINGPARAM1
	MOVWF	FSR0H
	MOVF	SYSSTRINGLENGTH,W
	MOVWF	INDF0
	MOVLW	LOW SYSSTRINGPARAM1
	MOVWF	SYSPRINTDATAHANDLER
	MOVLW	HIGH SYSSTRINGPARAM1
	MOVWF	SYSPRINTDATAHANDLER_H
	MOVLW	1
	MOVWF	COMPORT
	CALL	HSERPRINT305
	MOVLW	32
	MOVWF	SERDATA
	CALL	HSERSEND294
	MOVLW	3
	SUBWF	REL_ADDRESS,W
	BTFSS	STATUS,0
	GOTO	SYSFORLOOP4
SYSFORLOOPEND4:
	MOVLW	2
	MOVWF	HSERPRINTCRLFCOUNT
	MOVLW	1
	MOVWF	COMPORT
	CALL	HSERPRINTCRLF
	MOVLW	LOW STRINGTABLE6
	MOVWF	SYSPRINTDATAHANDLER
	MOVLW	(HIGH STRINGTABLE6) | 128
	MOVWF	SYSPRINTDATAHANDLER_H
	MOVLW	1
	MOVWF	COMPORT
	CALL	HSERPRINT305
	CALL	SAFM_DUMP
	MOVLW	175
	MOVWF	WORD1
	MOVLW	91
	MOVWF	WORD1_H
	MOVLW	240
	MOVWF	WORD2
	MOVLW	1
	MOVWF	WORD2_H
	MOVLW	113
	MOVWF	WORD3
	MOVLW	210
	MOVWF	WORD3_H
	MOVLW	33
	MOVWF	WORD4
	MOVLW	67
	MOVWF	WORD4_H
	MOVLW	2
	MOVWF	HSERPRINTCRLFCOUNT
	MOVLW	1
	MOVWF	COMPORT
	CALL	HSERPRINTCRLF
	MOVLW	LOW STRINGTABLE7
	MOVWF	SYSPRINTDATAHANDLER
	MOVLW	(HIGH STRINGTABLE7) | 128
	MOVWF	SYSPRINTDATAHANDLER_H
	MOVLW	1
	MOVWF	COMPORT
	CALL	HSERPRINT305
	MOVLW	1
	MOVWF	HSERPRINTCRLFCOUNT
	MOVLW	1
	MOVWF	COMPORT
	CALL	HSERPRINTCRLF
	MOVF	WORD1_H,W
	MOVWF	SYSVALTEMP
	CALL	FN__HEXPICAS
	MOVLW	LOW SYSSTRINGPARAM1
	MOVWF	FSR1L
	MOVLW	HIGH SYSSTRINGPARAM1
	MOVWF	FSR1H
	CLRF	SYSSTRINGLENGTH
	MOVLW	LOW STRINGTABLE3
	MOVWF	SYSSTRINGA
	MOVLW	(HIGH STRINGTABLE3) & 127
	MOVWF	SYSSTRINGA_H
	CALL	SYSREADSTRINGPART
	MOVLW	LOW _HEXPICAS
	MOVWF	FSR0L
	MOVLW	HIGH _HEXPICAS
	MOVWF	FSR0H
	CALL	SYSCOPYSTRINGPART
	MOVLW	LOW SYSSTRINGPARAM1
	MOVWF	FSR0L
	MOVLW	HIGH SYSSTRINGPARAM1
	MOVWF	FSR0H
	MOVF	SYSSTRINGLENGTH,W
	MOVWF	INDF0
	MOVLW	LOW SYSSTRINGPARAM1
	MOVWF	SYSPRINTDATAHANDLER
	MOVLW	HIGH SYSSTRINGPARAM1
	MOVWF	SYSPRINTDATAHANDLER_H
	MOVLW	1
	MOVWF	COMPORT
	CALL	HSERPRINT305
	MOVF	WORD1,W
	MOVWF	SYSVALTEMP
	CALL	FN__HEXPICAS
	MOVLW	LOW _HEXPICAS
	MOVWF	SYSPRINTDATAHANDLER
	MOVLW	HIGH _HEXPICAS
	MOVWF	SYSPRINTDATAHANDLER_H
	MOVLW	1
	MOVWF	COMPORT
	CALL	HSERPRINT305
	MOVLW	32
	MOVWF	SERDATA
	CALL	HSERSEND294
	MOVF	WORD2_H,W
	MOVWF	SYSVALTEMP
	CALL	FN__HEXPICAS
	MOVLW	LOW SYSSTRINGPARAM1
	MOVWF	FSR1L
	MOVLW	HIGH SYSSTRINGPARAM1
	MOVWF	FSR1H
	CLRF	SYSSTRINGLENGTH
	MOVLW	LOW STRINGTABLE3
	MOVWF	SYSSTRINGA
	MOVLW	(HIGH STRINGTABLE3) & 127
	MOVWF	SYSSTRINGA_H
	CALL	SYSREADSTRINGPART
	MOVLW	LOW _HEXPICAS
	MOVWF	FSR0L
	MOVLW	HIGH _HEXPICAS
	MOVWF	FSR0H
	CALL	SYSCOPYSTRINGPART
	MOVLW	LOW SYSSTRINGPARAM1
	MOVWF	FSR0L
	MOVLW	HIGH SYSSTRINGPARAM1
	MOVWF	FSR0H
	MOVF	SYSSTRINGLENGTH,W
	MOVWF	INDF0
	MOVLW	LOW SYSSTRINGPARAM1
	MOVWF	SYSPRINTDATAHANDLER
	MOVLW	HIGH SYSSTRINGPARAM1
	MOVWF	SYSPRINTDATAHANDLER_H
	MOVLW	1
	MOVWF	COMPORT
	CALL	HSERPRINT305
	MOVF	WORD2,W
	MOVWF	SYSVALTEMP
	CALL	FN__HEXPICAS
	MOVLW	LOW _HEXPICAS
	MOVWF	SYSPRINTDATAHANDLER
	MOVLW	HIGH _HEXPICAS
	MOVWF	SYSPRINTDATAHANDLER_H
	MOVLW	1
	MOVWF	COMPORT
	CALL	HSERPRINT305
	MOVLW	32
	MOVWF	SERDATA
	CALL	HSERSEND294
	MOVF	WORD3_H,W
	MOVWF	SYSVALTEMP
	CALL	FN__HEXPICAS
	MOVLW	LOW SYSSTRINGPARAM1
	MOVWF	FSR1L
	MOVLW	HIGH SYSSTRINGPARAM1
	MOVWF	FSR1H
	CLRF	SYSSTRINGLENGTH
	MOVLW	LOW STRINGTABLE3
	MOVWF	SYSSTRINGA
	MOVLW	(HIGH STRINGTABLE3) & 127
	MOVWF	SYSSTRINGA_H
	CALL	SYSREADSTRINGPART
	MOVLW	LOW _HEXPICAS
	MOVWF	FSR0L
	MOVLW	HIGH _HEXPICAS
	MOVWF	FSR0H
	CALL	SYSCOPYSTRINGPART
	MOVLW	LOW SYSSTRINGPARAM1
	MOVWF	FSR0L
	MOVLW	HIGH SYSSTRINGPARAM1
	MOVWF	FSR0H
	MOVF	SYSSTRINGLENGTH,W
	MOVWF	INDF0
	MOVLW	LOW SYSSTRINGPARAM1
	MOVWF	SYSPRINTDATAHANDLER
	MOVLW	HIGH SYSSTRINGPARAM1
	MOVWF	SYSPRINTDATAHANDLER_H
	MOVLW	1
	MOVWF	COMPORT
	CALL	HSERPRINT305
	MOVF	WORD3,W
	MOVWF	SYSVALTEMP
	CALL	FN__HEXPICAS
	MOVLW	LOW _HEXPICAS
	MOVWF	SYSPRINTDATAHANDLER
	MOVLW	HIGH _HEXPICAS
	MOVWF	SYSPRINTDATAHANDLER_H
	MOVLW	1
	MOVWF	COMPORT
	CALL	HSERPRINT305
	MOVLW	32
	MOVWF	SERDATA
	CALL	HSERSEND294
	MOVF	WORD4_H,W
	MOVWF	SYSVALTEMP
	CALL	FN__HEXPICAS
	MOVLW	LOW SYSSTRINGPARAM1
	MOVWF	FSR1L
	MOVLW	HIGH SYSSTRINGPARAM1
	MOVWF	FSR1H
	CLRF	SYSSTRINGLENGTH
	MOVLW	LOW STRINGTABLE3
	MOVWF	SYSSTRINGA
	MOVLW	(HIGH STRINGTABLE3) & 127
	MOVWF	SYSSTRINGA_H
	CALL	SYSREADSTRINGPART
	MOVLW	LOW _HEXPICAS
	MOVWF	FSR0L
	MOVLW	HIGH _HEXPICAS
	MOVWF	FSR0H
	CALL	SYSCOPYSTRINGPART
	MOVLW	LOW SYSSTRINGPARAM1
	MOVWF	FSR0L
	MOVLW	HIGH SYSSTRINGPARAM1
	MOVWF	FSR0H
	MOVF	SYSSTRINGLENGTH,W
	MOVWF	INDF0
	MOVLW	LOW SYSSTRINGPARAM1
	MOVWF	SYSPRINTDATAHANDLER
	MOVLW	HIGH SYSSTRINGPARAM1
	MOVWF	SYSPRINTDATAHANDLER_H
	MOVLW	1
	MOVWF	COMPORT
	CALL	HSERPRINT305
	MOVF	WORD4,W
	MOVWF	SYSVALTEMP
	CALL	FN__HEXPICAS
	MOVLW	LOW _HEXPICAS
	MOVWF	SYSPRINTDATAHANDLER
	MOVLW	HIGH _HEXPICAS
	MOVWF	SYSPRINTDATAHANDLER_H
	MOVLW	1
	MOVWF	COMPORT
	CALL	HSERPRINT305
	MOVLW	32
	MOVWF	SERDATA
	CALL	HSERSEND294
	MOVLW	8
	MOVWF	_HEF_REL_ADDR
	MOVF	WORD1,W
	MOVWF	_HEF_DATAWORD
	MOVF	WORD1_H,W
	MOVWF	_HEF_DATAWORD_H
	CALL	SAFWRITEWORD
	MOVLW	10
	MOVWF	_HEF_REL_ADDR
	MOVF	WORD2,W
	MOVWF	_HEF_DATAWORD
	MOVF	WORD2_H,W
	MOVWF	_HEF_DATAWORD_H
	CALL	SAFWRITEWORD
	MOVLW	12
	MOVWF	_HEF_REL_ADDR
	MOVF	WORD3,W
	MOVWF	_HEF_DATAWORD
	MOVF	WORD3_H,W
	MOVWF	_HEF_DATAWORD_H
	CALL	SAFWRITEWORD
	MOVLW	14
	MOVWF	_HEF_REL_ADDR
	MOVF	WORD4,W
	MOVWF	_HEF_DATAWORD
	MOVF	WORD4_H,W
	MOVWF	_HEF_DATAWORD_H
	CALL	SAFWRITEWORD
	MOVLW	8
	MOVWF	REL_ADDRESS
	MOVLW	1
	MOVWF	HSERPRINTCRLFCOUNT
	MOVLW	1
	MOVWF	COMPORT
	CALL	HSERPRINTCRLF
	MOVLW	4
	MOVWF	SYSREPEATTEMP1
SYSREPEATLOOP1:
	MOVF	REL_ADDRESS,W
	MOVWF	_HEF_REL_ADDR
	CALL	SAFREADWORD396
	MOVF	_HEF_DATAWORD,W
	MOVWF	DATAWORD
	MOVF	_HEF_DATAWORD_H,W
	MOVWF	DATAWORD_H
	MOVWF	SYSVALTEMP
	CALL	FN__HEXPICAS
	MOVLW	LOW SYSSTRINGPARAM1
	MOVWF	FSR1L
	MOVLW	HIGH SYSSTRINGPARAM1
	MOVWF	FSR1H
	CLRF	SYSSTRINGLENGTH
	MOVLW	LOW STRINGTABLE3
	MOVWF	SYSSTRINGA
	MOVLW	(HIGH STRINGTABLE3) & 127
	MOVWF	SYSSTRINGA_H
	CALL	SYSREADSTRINGPART
	MOVLW	LOW _HEXPICAS
	MOVWF	FSR0L
	MOVLW	HIGH _HEXPICAS
	MOVWF	FSR0H
	CALL	SYSCOPYSTRINGPART
	MOVLW	LOW SYSSTRINGPARAM1
	MOVWF	FSR0L
	MOVLW	HIGH SYSSTRINGPARAM1
	MOVWF	FSR0H
	MOVF	SYSSTRINGLENGTH,W
	MOVWF	INDF0
	MOVLW	LOW SYSSTRINGPARAM1
	MOVWF	SYSPRINTDATAHANDLER
	MOVLW	HIGH SYSSTRINGPARAM1
	MOVWF	SYSPRINTDATAHANDLER_H
	MOVLW	1
	MOVWF	COMPORT
	CALL	HSERPRINT305
	MOVF	DATAWORD,W
	MOVWF	SYSVALTEMP
	CALL	FN__HEXPICAS
	MOVLW	LOW _HEXPICAS
	MOVWF	SYSPRINTDATAHANDLER
	MOVLW	HIGH _HEXPICAS
	MOVWF	SYSPRINTDATAHANDLER_H
	MOVLW	1
	MOVWF	COMPORT
	CALL	HSERPRINT305
	MOVLW	32
	MOVWF	SERDATA
	CALL	HSERSEND294
	MOVLW	2
	ADDWF	REL_ADDRESS,F
	DECFSZ	SYSREPEATTEMP1,F
	GOTO	SYSREPEATLOOP1
SYSREPEATLOOPEND1:
	MOVLW	2
	MOVWF	HSERPRINTCRLFCOUNT
	MOVLW	1
	MOVWF	COMPORT
	CALL	HSERPRINTCRLF
	CALL	SAFM_DUMP
	GOTO	BASPROGRAMEND
BASPROGRAMEND:
	SLEEP
	GOTO	BASPROGRAMEND

;********************************************************************************

DELAY_MS:
	INCF	SYSWAITTEMPMS_H, F
DMS_START:
	MOVLW	14
	MOVWF	DELAYTEMP2
DMS_OUTER:
	MOVLW	189
	MOVWF	DELAYTEMP
DMS_INNER:
	DECFSZ	DELAYTEMP, F
	GOTO	DMS_INNER
	DECFSZ	DELAYTEMP2, F
	GOTO	DMS_OUTER
	DECFSZ	SYSWAITTEMPMS, F
	GOTO	DMS_START
	DECFSZ	SYSWAITTEMPMS_H, F
	GOTO	DMS_START
	RETURN

;********************************************************************************

HSERPRINT305:
	MOVF	SYSPRINTDATAHANDLER,W
	MOVWF	FSR0L
	MOVF	SYSPRINTDATAHANDLER_H,W
	MOVWF	FSR0H
	MOVF	INDF0,W
	MOVWF	PRINTLEN
	MOVF	PRINTLEN,F
	BTFSC	STATUS,2
	GOTO	ENDIF13
	MOVLW	1
	MOVWF	SYSPRINTTEMP
SYSFORLOOP6:
	MOVF	SYSPRINTTEMP,W
	ADDWF	SYSPRINTDATAHANDLER,W
	MOVWF	FSR0L
	MOVLW	0
	ADDWFC	SYSPRINTDATAHANDLER_H,W
	MOVWF	FSR0H
	MOVF	INDF0,W
	MOVWF	SERDATA
	CALL	HSERSEND295
	MOVF	SYSPRINTTEMP,W
	SUBWF	PRINTLEN,W
	MOVWF	SYSTEMP2
	MOVWF	SYSBYTETEMPA
	CLRF	SYSBYTETEMPB
	CALL	SYSCOMPEQUAL
	COMF	SYSBYTETEMPX,F
	BTFSS	SYSBYTETEMPX,0
	GOTO	ENDIF14
	INCF	SYSPRINTTEMP,F
	GOTO	SYSFORLOOP6
ENDIF14:
SYSFORLOOPEND6:
ENDIF13:
	RETURN

;********************************************************************************

HSERPRINT306:
	CLRF	OUTVALUETEMP
	MOVLW	100
	SUBWF	SERPRINTVAL,W
	BTFSS	STATUS,0
	GOTO	ENDIF15
	MOVF	SERPRINTVAL,W
	MOVWF	SYSBYTETEMPA
	MOVLW	100
	MOVWF	SYSBYTETEMPB
	CALL	SYSDIVSUB
	MOVF	SYSBYTETEMPA,W
	MOVWF	OUTVALUETEMP
	MOVF	SYSCALCTEMPX,W
	MOVWF	SERPRINTVAL
	MOVLW	48
	ADDWF	OUTVALUETEMP,W
	MOVWF	SERDATA
	CALL	HSERSEND295
ENDIF15:
	MOVF	OUTVALUETEMP,W
	MOVWF	SYSBYTETEMPB
	CLRF	SYSBYTETEMPA
	CALL	SYSCOMPLESSTHAN
	MOVF	SYSBYTETEMPX,W
	MOVWF	SYSTEMP2
	MOVF	SERPRINTVAL,W
	MOVWF	SYSBYTETEMPA
	MOVLW	10
	MOVWF	SYSBYTETEMPB
	CALL	SYSCOMPLESSTHAN
	COMF	SYSBYTETEMPX,F
	MOVF	SYSTEMP2,W
	IORWF	SYSBYTETEMPX,W
	MOVWF	SYSTEMP3
	BTFSS	SYSTEMP3,0
	GOTO	ENDIF16
	MOVF	SERPRINTVAL,W
	MOVWF	SYSBYTETEMPA
	MOVLW	10
	MOVWF	SYSBYTETEMPB
	CALL	SYSDIVSUB
	MOVF	SYSBYTETEMPA,W
	MOVWF	OUTVALUETEMP
	MOVF	SYSCALCTEMPX,W
	MOVWF	SERPRINTVAL
	MOVLW	48
	ADDWF	OUTVALUETEMP,W
	MOVWF	SERDATA
	CALL	HSERSEND295
ENDIF16:
	MOVLW	48
	ADDWF	SERPRINTVAL,W
	MOVWF	SERDATA
	GOTO	HSERSEND295

;********************************************************************************

HSERPRINTCRLF:
	MOVF	HSERPRINTCRLFCOUNT,W
	MOVWF	SYSREPEATTEMP3
	BTFSC	STATUS,2
	GOTO	SYSREPEATLOOPEND3
SYSREPEATLOOP3:
	MOVLW	13
	MOVWF	SERDATA
	CALL	HSERSEND295
	MOVLW	10
	MOVWF	SERDATA
	CALL	HSERSEND295
	DECFSZ	SYSREPEATTEMP3,F
	GOTO	SYSREPEATLOOP3
SYSREPEATLOOPEND3:
	RETURN

;********************************************************************************

HSERSEND294:
SYSWAITLOOP1:
	BANKSEL	PIR3
	BTFSS	PIR3,2
	GOTO	SYSWAITLOOP1
SYSWAITLOOP2:
	BANKSEL	TX1STA
	BTFSS	TX1STA,1
	GOTO	SYSWAITLOOP2
	BANKSEL	SERDATA
	MOVF	SERDATA,W
	BANKSEL	TX1REG
	MOVWF	TX1REG
	MOVLW	1
	MOVWF	SYSWAITTEMPMS
	CLRF	SYSWAITTEMPMS_H
	BANKSEL	STATUS
	GOTO	DELAY_MS

;********************************************************************************

HSERSEND295:
	DECF	COMPORT,W
	BTFSS	STATUS,2
	GOTO	ENDIF24
SYSWAITLOOP3:
	BANKSEL	PIR3
	BTFSS	PIR3,2
	GOTO	SYSWAITLOOP3
SYSWAITLOOP4:
	BANKSEL	TX1STA
	BTFSS	TX1STA,1
	GOTO	SYSWAITLOOP4
	BANKSEL	SERDATA
	MOVF	SERDATA,W
	BANKSEL	TX1REG
	MOVWF	TX1REG
	MOVLW	1
	MOVWF	SYSWAITTEMPMS
	CLRF	SYSWAITTEMPMS_H
	BANKSEL	STATUS
	CALL	DELAY_MS
ENDIF24:
	RETURN

;********************************************************************************

INITPPS:
	MOVLW	14
	BANKSEL	RC6PPS
	MOVWF	RC6PPS
	BANKSEL	STATUS
	RETURN

;********************************************************************************

INITSYS:
;asm showdebug This code block sets the internal oscillator to ChipMHz
	BANKSEL	OSCCON2
	CLRF	OSCCON2
	CLRF	OSCCON3
	MOVLW	5
	MOVWF	OSCFRQ
;asm showdebug _Complete_the_chip_setup_of_BSR,ADCs,ANSEL_and_other_key_setup_registers_or_register_bits
	BANKSEL	ADCON0
	BCF	ADCON0,2
	BCF	ADCON0,7
	BANKSEL	ANSELA
	CLRF	ANSELA
	CLRF	ANSELB
	CLRF	ANSELC
	CLRF	ANSELD
	CLRF	ANSELE
	BANKSEL	CM1CON0
	BCF	CM1CON0,7
	BANKSEL	PORTA
	CLRF	PORTA
	CLRF	PORTB
	CLRF	PORTC
	CLRF	PORTD
	CLRF	PORTE
	RETURN

;********************************************************************************

INITUSART:
	MOVLW	1
	MOVWF	COMPORT
;asm showdebug Values_calculated_in_the_script
;asm showdebug _SPBRGH_TEMP=_ SPBRGH_TEMP
;asm showdebug _SPBRGL_TEMP=_ SPBRGL_TEMP
;asm showdebug _BRG16_TEMP=_ BRG16_TEMP
;asm showdebug _BRGH_TEMP=_ BRGH_TEMP
	MOVLW	64
	BANKSEL	SP1BRGL
	MOVWF	SP1BRGL
	MOVLW	3
	MOVWF	SP1BRGH
	MOVLW	64
	MOVWF	SP1BRGL
	BSF	BAUD1CON,3
	BSF	TX1STA,2
	BCF	TX1STA,4
	BSF	TX1STA,5
	BSF	RC1STA,7
	BSF	RC1STA,4
	BANKSEL	STATUS
	RETURN

;********************************************************************************

SAFERASEBLOCK:
	MOVF	_HEF_BLOCKNUM,W
	MOVWF	SYSBYTETEMPA
	MOVLW	32
	MOVWF	SYSBYTETEMPB
	CALL	SYSMULTSUB
	MOVF	SYSBYTETEMPX,W
	MOVWF	SYSTEMP3
	MOVLW	128
	ADDWF	SYSTEMP3,W
	BANKSEL	NVMADRL
	MOVWF	NVMADRL
	MOVLW	0
	BANKSEL	SYSTEMP1
	MOVWF	SYSTEMP1
	MOVLW	31
	ADDWFC	SYSTEMP1,W
	BANKSEL	NVMADRH
	MOVWF	NVMADRH
	BANKSEL	_HEF_ABS_ADDR_U
	CLRF	_HEF_ABS_ADDR_U
	BTFSC	STATUS,0
	INCF	_HEF_ABS_ADDR_U,F
	CLRF	_HEF_ABS_ADDR_E
	BANKSEL	NVMCON1
	CLRF	NVMCON1
	BCF	NVMCON1,6
	BSF	NVMCON1,4
	BSF	NVMCON1,2
	BANKSEL	_GIE_SAVE
	CLRF	_GIE_SAVE
	BTFSC	INTCON,7
	INCF	_GIE_SAVE,F
	BCF	INTCON,7
	MOVLW	85
	BANKSEL	NVMCON2
	MOVWF	NVMCON2
	MOVLW	170
	MOVWF	NVMCON2
	BSF	NVMCON1,1
	NOP
	NOP
	BCF	NVMCON1,2
	BANKSEL	_GIE_SAVE
	BTFSC	_GIE_SAVE,0
	BSF	INTCON,7
	BTFSS	_GIE_SAVE,0
	BCF	INTCON,7
	RETURN

;********************************************************************************

SAFM_DUMP:
	MOVLW	128
	MOVWF	NVM_ADDRESS
	MOVLW	31
	MOVWF	NVM_ADDRESS_H
	CLRF	NVM_ADDRESS_U
	CLRF	NVM_ADDRESS_E
	CLRF	BLOCKNUM
	MOVLW	64
	MOVWF	SYSREPEATTEMP2
SYSREPEATLOOP2:
	MOVF	NVM_ADDRESS,W
	MOVWF	SYSLONGTEMPA
	MOVF	NVM_ADDRESS_H,W
	MOVWF	SYSLONGTEMPA_H
	MOVF	NVM_ADDRESS_U,W
	MOVWF	SYSLONGTEMPA_U
	MOVF	NVM_ADDRESS_E,W
	MOVWF	SYSLONGTEMPA_E
	MOVLW	32
	MOVWF	SYSLONGTEMPB
	CLRF	SYSLONGTEMPB_H
	CLRF	SYSLONGTEMPB_U
	CLRF	SYSLONGTEMPB_E
	CALL	SYSDIVSUB32
	MOVF	SYSLONGTEMPX,W
	MOVWF	SYSTEMP1
	MOVF	SYSLONGTEMPX_H,W
	MOVWF	SYSTEMP1_H
	MOVF	SYSLONGTEMPX_U,W
	MOVWF	SYSTEMP1_U
	MOVF	SYSLONGTEMPX_E,W
	MOVWF	SYSTEMP1_E
	MOVF	SYSTEMP1,W
	MOVWF	SYSLONGTEMPA
	MOVF	SYSTEMP1_H,W
	MOVWF	SYSLONGTEMPA_H
	MOVF	SYSTEMP1_U,W
	MOVWF	SYSLONGTEMPA_U
	MOVF	SYSTEMP1_E,W
	MOVWF	SYSLONGTEMPA_E
	CLRF	SYSLONGTEMPB
	CLRF	SYSLONGTEMPB_H
	CLRF	SYSLONGTEMPB_U
	CLRF	SYSLONGTEMPB_E
	CALL	SYSCOMPEQUAL32
	BTFSS	SYSBYTETEMPX,0
	GOTO	ENDIF5
	MOVF	BLOCKNUM,W
	SUBLW	0
	BTFSC	STATUS,0
	GOTO	ENDIF7
	MOVLW	1
	MOVWF	HSERPRINTCRLFCOUNT
	MOVLW	1
	MOVWF	COMPORT
	CALL	HSERPRINTCRLF
ENDIF7:
	MOVLW	1
	MOVWF	HSERPRINTCRLFCOUNT
	MOVLW	1
	MOVWF	COMPORT
	CALL	HSERPRINTCRLF
	MOVLW	LOW STRINGTABLE8
	MOVWF	SYSPRINTDATAHANDLER
	MOVLW	(HIGH STRINGTABLE8) | 128
	MOVWF	SYSPRINTDATAHANDLER_H
	MOVLW	1
	MOVWF	COMPORT
	CALL	HSERPRINT305
	MOVF	BLOCKNUM,W
	MOVWF	SERPRINTVAL
	MOVLW	1
	MOVWF	COMPORT
	CALL	HSERPRINT306
	MOVLW	LOW STRINGTABLE9
	MOVWF	SYSPRINTDATAHANDLER
	MOVLW	(HIGH STRINGTABLE9) | 128
	MOVWF	SYSPRINTDATAHANDLER_H
	MOVLW	1
	MOVWF	COMPORT
	CALL	HSERPRINT305
	INCF	BLOCKNUM,F
ENDIF5:
	MOVF	NVM_ADDRESS,W
	MOVWF	SYSLONGTEMPA
	MOVF	NVM_ADDRESS_H,W
	MOVWF	SYSLONGTEMPA_H
	MOVF	NVM_ADDRESS_U,W
	MOVWF	SYSLONGTEMPA_U
	MOVF	NVM_ADDRESS_E,W
	MOVWF	SYSLONGTEMPA_E
	MOVLW	8
	MOVWF	SYSLONGTEMPB
	CLRF	SYSLONGTEMPB_H
	CLRF	SYSLONGTEMPB_U
	CLRF	SYSLONGTEMPB_E
	CALL	SYSDIVSUB32
	MOVF	SYSLONGTEMPX,W
	MOVWF	SYSTEMP1
	MOVF	SYSLONGTEMPX_H,W
	MOVWF	SYSTEMP1_H
	MOVF	SYSLONGTEMPX_U,W
	MOVWF	SYSTEMP1_U
	MOVF	SYSLONGTEMPX_E,W
	MOVWF	SYSTEMP1_E
	MOVF	SYSTEMP1,W
	MOVWF	SYSLONGTEMPA
	MOVF	SYSTEMP1_H,W
	MOVWF	SYSLONGTEMPA_H
	MOVF	SYSTEMP1_U,W
	MOVWF	SYSLONGTEMPA_U
	MOVF	SYSTEMP1_E,W
	MOVWF	SYSLONGTEMPA_E
	CLRF	SYSLONGTEMPB
	CLRF	SYSLONGTEMPB_H
	CLRF	SYSLONGTEMPB_U
	CLRF	SYSLONGTEMPB_E
	CALL	SYSCOMPEQUAL32
	BTFSS	SYSBYTETEMPX,0
	GOTO	ENDIF6
	MOVLW	1
	MOVWF	HSERPRINTCRLFCOUNT
	MOVLW	1
	MOVWF	COMPORT
	CALL	HSERPRINTCRLF
	MOVF	NVM_ADDRESS_H,W
	MOVWF	SYSVALTEMP
	CALL	FN__HEXPICAS
	MOVLW	LOW _HEXPICAS
	MOVWF	SYSPRINTDATAHANDLER
	MOVLW	HIGH _HEXPICAS
	MOVWF	SYSPRINTDATAHANDLER_H
	MOVLW	1
	MOVWF	COMPORT
	CALL	HSERPRINT305
	MOVF	NVM_ADDRESS,W
	MOVWF	SYSVALTEMP
	CALL	FN__HEXPICAS
	MOVLW	LOW _HEXPICAS
	MOVWF	SYSPRINTDATAHANDLER
	MOVLW	HIGH _HEXPICAS
	MOVWF	SYSPRINTDATAHANDLER_H
	MOVLW	1
	MOVWF	COMPORT
	CALL	HSERPRINT305
	MOVLW	LOW STRINGTABLE10
	MOVWF	SYSPRINTDATAHANDLER
	MOVLW	(HIGH STRINGTABLE10) | 128
	MOVWF	SYSPRINTDATAHANDLER_H
	MOVLW	1
	MOVWF	COMPORT
	CALL	HSERPRINT305
ENDIF6:
	MOVLW	128
	SUBWF	NVM_ADDRESS,W
	MOVWF	REL_ADDRESS
	MOVWF	_HEF_REL_ADDR
	CALL	SAFREADWORD396
	MOVF	_HEF_DATAWORD,W
	MOVWF	DATAWORD
	MOVF	_HEF_DATAWORD_H,W
	MOVWF	DATAWORD_H
	MOVWF	SYSVALTEMP
	CALL	FN__HEXPICAS
	MOVLW	LOW _HEXPICAS
	MOVWF	SYSPRINTDATAHANDLER
	MOVLW	HIGH _HEXPICAS
	MOVWF	SYSPRINTDATAHANDLER_H
	MOVLW	1
	MOVWF	COMPORT
	CALL	HSERPRINT305
	MOVF	DATAWORD,W
	MOVWF	SYSVALTEMP
	CALL	FN__HEXPICAS
	MOVLW	LOW _HEXPICAS
	MOVWF	SYSPRINTDATAHANDLER
	MOVLW	HIGH _HEXPICAS
	MOVWF	SYSPRINTDATAHANDLER_H
	MOVLW	1
	MOVWF	COMPORT
	CALL	HSERPRINT305
	MOVLW	LOW STRINGTABLE11
	MOVWF	SYSPRINTDATAHANDLER
	MOVLW	(HIGH STRINGTABLE11) | 128
	MOVWF	SYSPRINTDATAHANDLER_H
	MOVLW	1
	MOVWF	COMPORT
	CALL	HSERPRINT305
	MOVLW	2
	ADDWF	NVM_ADDRESS,F
	MOVLW	0
	ADDWFC	NVM_ADDRESS_H,F
	MOVLW	0
	ADDWFC	NVM_ADDRESS_U,F
	MOVLW	0
	ADDWFC	NVM_ADDRESS_E,F
	DECFSZ	SYSREPEATTEMP2,F
	GOTO	SYSREPEATLOOP2
SYSREPEATLOOPEND2:
	MOVLW	1
	MOVWF	HSERPRINTCRLFCOUNT
	MOVLW	1
	MOVWF	COMPORT
	GOTO	HSERPRINTCRLF

;********************************************************************************

SAFREAD394:
	MOVLW	128
	ADDWF	_HEF_REL_ADDR,W
	BANKSEL	NVMADRL
	MOVWF	NVMADRL
	MOVLW	0
	BANKSEL	SYSTEMP2
	MOVWF	SYSTEMP2
	MOVLW	31
	ADDWFC	SYSTEMP2,W
	BANKSEL	NVMADRH
	MOVWF	NVMADRH
	BANKSEL	_HEF_ABS_ADDR_U
	CLRF	_HEF_ABS_ADDR_U
	BTFSC	STATUS,0
	INCF	_HEF_ABS_ADDR_U,F
	CLRF	_HEF_ABS_ADDR_E
	BANKSEL	NVMCON1
	BCF	NVMCON1,6
	BSF	NVMCON1,0
	NOP
	NOP
	MOVF	NVMDATL,W
	BANKSEL	_HEF_DATABYTE
	MOVWF	_HEF_DATABYTE
	RETURN

;********************************************************************************

SAFREADBLOCK:
	MOVF	_HEF_BLOCKNUM,W
	MOVWF	SYSBYTETEMPA
	MOVLW	32
	MOVWF	SYSBYTETEMPB
	CALL	SYSMULTSUB
	MOVF	SYSBYTETEMPX,W
	MOVWF	SYSTEMP3
	MOVLW	128
	ADDWF	SYSTEMP3,W
	BANKSEL	NVMADRL
	MOVWF	NVMADRL
	MOVLW	0
	BANKSEL	SYSTEMP1
	MOVWF	SYSTEMP1
	MOVLW	31
	ADDWFC	SYSTEMP1,W
	BANKSEL	NVMADRH
	MOVWF	NVMADRH
	BANKSEL	_HEF_ABS_ADDR_U
	CLRF	_HEF_ABS_ADDR_U
	BTFSC	STATUS,0
	INCF	_HEF_ABS_ADDR_U,F
	CLRF	_HEF_ABS_ADDR_E
	BANKSEL	NVMCON1
	BCF	NVMCON1,6
	MOVLW	1
	BANKSEL	_HEF_INDEX
	MOVWF	_HEF_INDEX
	CLRF	_HEF_INDEX_H
SYSFORLOOP7:
	BANKSEL	NVMCON1
	BSF	NVMCON1,0
	NOP
	NOP
	BANKSEL	_HEF_INDEX
	MOVF	_HEF_INDEX,W
	ADDWF	SYS_HEF_BUFFERHANDLER,W
	MOVWF	FSR0L
	MOVF	_HEF_INDEX_H,W
	ADDWFC	SYS_HEF_BUFFERHANDLER_H,W
	MOVWF	FSR0H
	BANKSEL	NVMDATL
	MOVF	NVMDATL,W
	MOVWF	INDF0
	INCF	NVMADRL,F
	BTFSC	STATUS,2
	INCF	NVMADRH,F
	BTFSC	STATUS,2
	BANKSEL	_HEF_ABS_ADDR_U
	INCF	_HEF_ABS_ADDR_U,F
	BTFSC	STATUS,2
	BANKSEL	_HEF_ABS_ADDR_E
	INCF	_HEF_ABS_ADDR_E,F
	MOVLW	1
	BANKSEL	_HEF_COUNT
	SUBWF	_HEF_COUNT,W
	MOVWF	SYSTEMP1
	MOVLW	0
	SUBWFB	_HEF_COUNT_H,W
	MOVWF	SYSTEMP1_H
	MOVF	_HEF_INDEX,W
	SUBWF	SYSTEMP1,W
	MOVWF	SYSTEMP2
	MOVF	_HEF_INDEX_H,W
	SUBWFB	SYSTEMP1_H,W
	MOVWF	SYSTEMP2_H
	MOVF	SYSTEMP2,W
	MOVWF	SYSWORDTEMPA
	MOVF	SYSTEMP2_H,W
	MOVWF	SYSWORDTEMPA_H
	CLRF	SYSWORDTEMPB
	CLRF	SYSWORDTEMPB_H
	CALL	SYSCOMPEQUAL16
	COMF	SYSBYTETEMPX,F
	BTFSS	SYSBYTETEMPX,0
	GOTO	ENDIF17
	INCF	_HEF_INDEX,F
	BTFSC	STATUS,2
	INCF	_HEF_INDEX_H,F
	GOTO	SYSFORLOOP7
ENDIF17:
SYSFORLOOPEND7:
	BANKSEL	NVMCON1
	BSF	NVMCON1,0
	NOP
	NOP
	MOVLW	1
	BANKSEL	_HEF_INDEX
	ADDWF	_HEF_INDEX,W
	MOVWF	SYSTEMP2
	MOVLW	0
	ADDWFC	_HEF_INDEX_H,W
	MOVWF	SYSTEMP2_H
	MOVF	SYSTEMP2,W
	ADDWF	SYS_HEF_BUFFERHANDLER,W
	MOVWF	FSR0L
	MOVF	SYSTEMP2_H,W
	ADDWFC	SYS_HEF_BUFFERHANDLER_H,W
	MOVWF	FSR0H
	BANKSEL	NVMDATL
	MOVF	NVMDATL,W
	MOVWF	INDF0
	BANKSEL	STATUS
	RETURN

;********************************************************************************

SAFREADWORD396:
	MOVLW	128
	ADDWF	_HEF_REL_ADDR,W
	BANKSEL	NVMADRL
	MOVWF	NVMADRL
	MOVLW	0
	BANKSEL	SYSTEMP2
	MOVWF	SYSTEMP2
	MOVLW	31
	ADDWFC	SYSTEMP2,W
	BANKSEL	NVMADRH
	MOVWF	NVMADRH
	BANKSEL	_HEF_ABS_ADDR_U
	CLRF	_HEF_ABS_ADDR_U
	BTFSC	STATUS,0
	INCF	_HEF_ABS_ADDR_U,F
	CLRF	_HEF_ABS_ADDR_E
	BANKSEL	NVMCON1
	BCF	NVMCON1,6
	BSF	NVMCON1,0
	NOP
	NOP
	MOVF	NVMDATL,W
	BANKSEL	_HEF_DATAWORD
	MOVWF	_HEF_DATAWORD
	CLRF	_HEF_DATAWORD_H
	BANKSEL	NVMADRL
	INCF	NVMADRL,F
	BTFSC	STATUS,2
	INCF	NVMADRH,F
	BTFSC	STATUS,2
	BANKSEL	_HEF_ABS_ADDR_U
	INCF	_HEF_ABS_ADDR_U,F
	BTFSC	STATUS,2
	BANKSEL	_HEF_ABS_ADDR_E
	INCF	_HEF_ABS_ADDR_E,F
	BANKSEL	NVMCON1
	BSF	NVMCON1,0
	NOP
	NOP
	MOVF	NVMDATL,W
	BANKSEL	_HEF_DATAWORD_H
	MOVWF	_HEF_DATAWORD_H
	RETURN

;********************************************************************************

SAFWRITEBLOCK:
	MOVF	_HEF_BLOCKNUM,W
	MOVWF	SYSBYTETEMPA
	MOVLW	32
	MOVWF	SYSBYTETEMPB
	CALL	SYSMULTSUB
	MOVF	SYSBYTETEMPX,W
	MOVWF	SYSTEMP3
	MOVLW	128
	ADDWF	SYSTEMP3,W
	BANKSEL	NVMADRL
	MOVWF	NVMADRL
	MOVLW	0
	BANKSEL	SYSTEMP1
	MOVWF	SYSTEMP1
	MOVLW	31
	ADDWFC	SYSTEMP1,W
	BANKSEL	NVMADRH
	MOVWF	NVMADRH
	BANKSEL	_HEF_ABS_ADDR_U
	CLRF	_HEF_ABS_ADDR_U
	BTFSC	STATUS,0
	INCF	_HEF_ABS_ADDR_U,F
	CLRF	_HEF_ABS_ADDR_E
	CALL	SAFERASEBLOCK
	BANKSEL	NVMCON1
	BCF	NVMCON1,6
	BCF	NVMCON1,4
	BSF	NVMCON1,2
	MOVLW	63
	MOVWF	NVMDATH
	MOVLW	255
	MOVWF	NVMDATL
	BANKSEL	_GIE_SAVE
	CLRF	_GIE_SAVE
	BTFSC	INTCON,7
	INCF	_GIE_SAVE,F
	BCF	INTCON,7
	BANKSEL	NVMCON1
	BSF	NVMCON1,5
	MOVLW	1
	BANKSEL	_HEF_INDEX
	MOVWF	_HEF_INDEX
	CLRF	_HEF_INDEX_H
SYSFORLOOP8:
	MOVF	_HEF_INDEX,W
	ADDWF	SYS_HEF_BUFFERHANDLER,W
	MOVWF	FSR0L
	MOVF	_HEF_INDEX_H,W
	ADDWFC	SYS_HEF_BUFFERHANDLER_H,W
	MOVWF	FSR0H
	MOVF	INDF0,W
	BANKSEL	NVMDATL
	MOVWF	NVMDATL
	MOVLW	85
	MOVWF	NVMCON2
	MOVLW	170
	MOVWF	NVMCON2
	BSF	NVMCON1,1
	NOP
	NOP
	INCF	NVMADRL,F
	BTFSC	STATUS,2
	INCF	NVMADRH,F
	BTFSC	STATUS,2
	BANKSEL	_HEF_ABS_ADDR_U
	INCF	_HEF_ABS_ADDR_U,F
	BTFSC	STATUS,2
	BANKSEL	_HEF_ABS_ADDR_E
	INCF	_HEF_ABS_ADDR_E,F
	MOVLW	1
	BANKSEL	_HEF_COUNT
	SUBWF	_HEF_COUNT,W
	MOVWF	SYSTEMP2
	MOVLW	0
	SUBWFB	_HEF_COUNT_H,W
	MOVWF	SYSTEMP2_H
	MOVF	_HEF_INDEX,W
	SUBWF	SYSTEMP2,W
	MOVWF	SYSTEMP1
	MOVF	_HEF_INDEX_H,W
	SUBWFB	SYSTEMP2_H,W
	MOVWF	SYSTEMP1_H
	MOVF	SYSTEMP1,W
	MOVWF	SYSWORDTEMPA
	MOVF	SYSTEMP1_H,W
	MOVWF	SYSWORDTEMPA_H
	CLRF	SYSWORDTEMPB
	CLRF	SYSWORDTEMPB_H
	CALL	SYSCOMPEQUAL16
	COMF	SYSBYTETEMPX,F
	BTFSS	SYSBYTETEMPX,0
	GOTO	ENDIF18
	INCF	_HEF_INDEX,F
	BTFSC	STATUS,2
	INCF	_HEF_INDEX_H,F
	GOTO	SYSFORLOOP8
ENDIF18:
SYSFORLOOPEND8:
	MOVLW	1
	ADDWF	_HEF_INDEX,W
	MOVWF	SYSTEMP2
	MOVLW	0
	ADDWFC	_HEF_INDEX_H,W
	MOVWF	SYSTEMP2_H
	MOVF	SYSTEMP2,W
	ADDWF	SYS_HEF_BUFFERHANDLER,W
	MOVWF	FSR0L
	MOVF	SYSTEMP2_H,W
	ADDWFC	SYS_HEF_BUFFERHANDLER_H,W
	MOVWF	FSR0H
	MOVF	INDF0,W
	BANKSEL	NVMDATL
	MOVWF	NVMDATL
	BCF	NVMCON1,5
	MOVLW	85
	MOVWF	NVMCON2
	MOVLW	170
	MOVWF	NVMCON2
	BSF	NVMCON1,1
	NOP
	NOP
	BCF	NVMCON1,2
	BANKSEL	_GIE_SAVE
	BTFSC	_GIE_SAVE,0
	BSF	INTCON,7
	BTFSS	_GIE_SAVE,0
	BCF	INTCON,7
	RETURN

;********************************************************************************

SAFWRITEWORD:
	MOVF	_HEF_REL_ADDR,W
	MOVWF	SYSBYTETEMPA
	MOVLW	32
	MOVWF	SYSBYTETEMPB
	CALL	SYSDIVSUB
	MOVF	SYSBYTETEMPA,W
	MOVWF	_HEF_BLOCKNUM
	MOVF	_HEF_REL_ADDR,W
	MOVWF	SYSWORDTEMPA
	CLRF	SYSWORDTEMPA_H
	MOVLW	32
	MOVWF	SYSWORDTEMPB
	CLRF	SYSWORDTEMPB_H
	CALL	SYSDIVSUB16
	MOVF	SYSWORDTEMPX,W
	MOVWF	_HEF_OFFSET
	MOVF	SYSWORDTEMPX_H,W
	MOVWF	_HEF_OFFSET_H
	MOVLW	LOW _HEF_BUFFER
	MOVWF	SYS_HEF_BUFFERHANDLER
	MOVLW	HIGH _HEF_BUFFER
	MOVWF	SYS_HEF_BUFFERHANDLER_H
	MOVLW	32
	MOVWF	_HEF_COUNT
	CLRF	_HEF_COUNT_H
	CALL	SAFREADBLOCK
	MOVLW	1
	ADDWF	_HEF_OFFSET,W
	MOVWF	SYSTEMP2
	MOVLW	0
	ADDWFC	_HEF_OFFSET_H,W
	MOVWF	SYSTEMP2_H
	MOVLW	LOW(_HEF_BUFFER)
	ADDWF	SYSTEMP2,W
	MOVWF	FSR0L
	MOVLW	HIGH(_HEF_BUFFER)
	ADDWFC	SYSTEMP2_H,W
	MOVWF	FSR0H
	MOVF	_HEF_DATAWORD,W
	MOVWF	INDF0
	MOVLW	2
	ADDWF	_HEF_OFFSET,W
	MOVWF	SYSTEMP2
	MOVLW	0
	ADDWFC	_HEF_OFFSET_H,W
	MOVWF	SYSTEMP2_H
	MOVLW	LOW(_HEF_BUFFER)
	ADDWF	SYSTEMP2,W
	MOVWF	FSR0L
	MOVLW	HIGH(_HEF_BUFFER)
	ADDWFC	SYSTEMP2_H,W
	MOVWF	FSR0H
	MOVF	_HEF_DATAWORD_H,W
	MOVWF	INDF0
	MOVLW	LOW _HEF_BUFFER
	MOVWF	SYS_HEF_BUFFERHANDLER
	MOVLW	HIGH _HEF_BUFFER
	MOVWF	SYS_HEF_BUFFERHANDLER_H
	MOVLW	32
	MOVWF	_HEF_COUNT
	CLRF	_HEF_COUNT_H
	GOTO	SAFWRITEBLOCK

;********************************************************************************

SYSCOMPEQUAL:
	CLRF	SYSBYTETEMPX
	MOVF	SYSBYTETEMPA, W
	SUBWF	SYSBYTETEMPB, W
	BTFSC	STATUS,2
	COMF	SYSBYTETEMPX,F
	RETURN

;********************************************************************************

SYSCOMPEQUAL16:
	CLRF	SYSBYTETEMPX
	MOVF	SYSWORDTEMPA, W
	SUBWF	SYSWORDTEMPB, W
	BTFSS	STATUS,2
	RETURN
	MOVF	SYSWORDTEMPA_H, W
	SUBWF	SYSWORDTEMPB_H, W
	BTFSS	STATUS,2
	RETURN
	COMF	SYSBYTETEMPX,F
	RETURN

;********************************************************************************

SYSCOMPEQUAL32:
	CLRF	SYSBYTETEMPX
	MOVF	SYSLONGTEMPA, W
	SUBWF	SYSLONGTEMPB, W
	BTFSS	STATUS,2
	RETURN
	MOVF	SYSLONGTEMPA_H, W
	SUBWF	SYSLONGTEMPB_H, W
	BTFSS	STATUS,2
	RETURN
	MOVF	SYSLONGTEMPA_U, W
	SUBWF	SYSLONGTEMPB_U, W
	BTFSS	STATUS,2
	RETURN
	MOVF	SYSLONGTEMPA_E, W
	SUBWF	SYSLONGTEMPB_E, W
	BTFSS	STATUS,2
	RETURN
	COMF	SYSBYTETEMPX,F
	RETURN

;********************************************************************************

SYSCOMPLESSTHAN:
	CLRF	SYSBYTETEMPX
	BSF	STATUS,0
	MOVF	SYSBYTETEMPB, W
	SUBWF	SYSBYTETEMPA, W
	BTFSS	STATUS,0
	COMF	SYSBYTETEMPX,F
	RETURN

;********************************************************************************

SYSCOPYSTRING:
	MOVF	INDF0, W
	MOVWF	SYSCALCTEMPA
	MOVWF	INDF1
	GOTO	SYSCOPYSTRINGCHECK
SYSCOPYSTRINGPART:
	MOVF	INDF0, W
	MOVWF	SYSCALCTEMPA
	ADDWF	SYSSTRINGLENGTH, F
SYSCOPYSTRINGCHECK:
	MOVF	SYSCALCTEMPA,F
	BTFSC	STATUS,2
	RETURN
SYSSTRINGCOPY:
	ADDFSR	0, 1
	ADDFSR	1, 1
	MOVF	INDF0, W
	MOVWF	INDF1
	DECFSZ	SYSCALCTEMPA, F
	GOTO	SYSSTRINGCOPY
	RETURN

;********************************************************************************

SYSDIVSUB:
	MOVF	SYSBYTETEMPB, F
	BTFSC	STATUS,2
	RETURN
	CLRF	SYSBYTETEMPX
	MOVLW	8
	MOVWF	SYSDIVLOOP
SYSDIV8START:
	BCF	STATUS,0
	RLF	SYSBYTETEMPA, F
	RLF	SYSBYTETEMPX, F
	MOVF	SYSBYTETEMPB, W
	SUBWF	SYSBYTETEMPX, F
	BSF	SYSBYTETEMPA, 0
	BTFSC	STATUS,0
	GOTO	DIV8NOTNEG
	BCF	SYSBYTETEMPA, 0
	MOVF	SYSBYTETEMPB, W
	ADDWF	SYSBYTETEMPX, F
DIV8NOTNEG:
	DECFSZ	SYSDIVLOOP, F
	GOTO	SYSDIV8START
	RETURN

;********************************************************************************

SYSDIVSUB16:
	MOVF	SYSWORDTEMPA,W
	MOVWF	SYSDIVMULTA
	MOVF	SYSWORDTEMPA_H,W
	MOVWF	SYSDIVMULTA_H
	MOVF	SYSWORDTEMPB,W
	MOVWF	SYSDIVMULTB
	MOVF	SYSWORDTEMPB_H,W
	MOVWF	SYSDIVMULTB_H
	CLRF	SYSDIVMULTX
	CLRF	SYSDIVMULTX_H
	MOVF	SYSDIVMULTB,W
	MOVWF	SYSWORDTEMPA
	MOVF	SYSDIVMULTB_H,W
	MOVWF	SYSWORDTEMPA_H
	CLRF	SYSWORDTEMPB
	CLRF	SYSWORDTEMPB_H
	CALL	SYSCOMPEQUAL16
	BTFSS	SYSBYTETEMPX,0
	GOTO	ENDIF22
	CLRF	SYSWORDTEMPA
	CLRF	SYSWORDTEMPA_H
	RETURN
ENDIF22:
	MOVLW	16
	MOVWF	SYSDIVLOOP
SYSDIV16START:
	BCF	STATUS,0
	RLF	SYSDIVMULTA,F
	RLF	SYSDIVMULTA_H,F
	RLF	SYSDIVMULTX,F
	RLF	SYSDIVMULTX_H,F
	MOVF	SYSDIVMULTB,W
	SUBWF	SYSDIVMULTX,F
	MOVF	SYSDIVMULTB_H,W
	SUBWFB	SYSDIVMULTX_H,F
	BSF	SYSDIVMULTA,0
	BTFSC	STATUS,0
	GOTO	ENDIF23
	BCF	SYSDIVMULTA,0
	MOVF	SYSDIVMULTB,W
	ADDWF	SYSDIVMULTX,F
	MOVF	SYSDIVMULTB_H,W
	ADDWFC	SYSDIVMULTX_H,F
ENDIF23:
	DECFSZ	SYSDIVLOOP, F
	GOTO	SYSDIV16START
	MOVF	SYSDIVMULTA,W
	MOVWF	SYSWORDTEMPA
	MOVF	SYSDIVMULTA_H,W
	MOVWF	SYSWORDTEMPA_H
	MOVF	SYSDIVMULTX,W
	MOVWF	SYSWORDTEMPX
	MOVF	SYSDIVMULTX_H,W
	MOVWF	SYSWORDTEMPX_H
	RETURN

;********************************************************************************

SYSDIVSUB32:
	MOVF	SYSLONGTEMPA,W
	MOVWF	SYSLONGDIVMULTA
	MOVF	SYSLONGTEMPA_H,W
	MOVWF	SYSLONGDIVMULTA_H
	MOVF	SYSLONGTEMPA_U,W
	MOVWF	SYSLONGDIVMULTA_U
	MOVF	SYSLONGTEMPA_E,W
	MOVWF	SYSLONGDIVMULTA_E
	MOVF	SYSLONGTEMPB,W
	MOVWF	SYSLONGDIVMULTB
	MOVF	SYSLONGTEMPB_H,W
	MOVWF	SYSLONGDIVMULTB_H
	MOVF	SYSLONGTEMPB_U,W
	MOVWF	SYSLONGDIVMULTB_U
	MOVF	SYSLONGTEMPB_E,W
	MOVWF	SYSLONGDIVMULTB_E
	CLRF	SYSLONGDIVMULTX
	CLRF	SYSLONGDIVMULTX_H
	CLRF	SYSLONGDIVMULTX_U
	CLRF	SYSLONGDIVMULTX_E
	MOVF	SYSLONGDIVMULTB,W
	MOVWF	SYSLONGTEMPA
	MOVF	SYSLONGDIVMULTB_H,W
	MOVWF	SYSLONGTEMPA_H
	MOVF	SYSLONGDIVMULTB_U,W
	MOVWF	SYSLONGTEMPA_U
	MOVF	SYSLONGDIVMULTB_E,W
	MOVWF	SYSLONGTEMPA_E
	CLRF	SYSLONGTEMPB
	CLRF	SYSLONGTEMPB_H
	CLRF	SYSLONGTEMPB_U
	CLRF	SYSLONGTEMPB_E
	CALL	SYSCOMPEQUAL32
	BTFSS	SYSBYTETEMPX,0
	GOTO	ENDIF11
	CLRF	SYSLONGTEMPA
	CLRF	SYSLONGTEMPA_H
	CLRF	SYSLONGTEMPA_U
	CLRF	SYSLONGTEMPA_E
	RETURN
ENDIF11:
	MOVLW	32
	MOVWF	SYSDIVLOOP
SYSDIV32START:
	BCF	STATUS,0
	RLF	SYSLONGDIVMULTA,F
	RLF	SYSLONGDIVMULTA_H,F
	RLF	SYSLONGDIVMULTA_U,F
	RLF	SYSLONGDIVMULTA_E,F
	RLF	SYSLONGDIVMULTX,F
	RLF	SYSLONGDIVMULTX_H,F
	RLF	SYSLONGDIVMULTX_U,F
	RLF	SYSLONGDIVMULTX_E,F
	MOVF	SYSLONGDIVMULTB,W
	SUBWF	SYSLONGDIVMULTX,F
	MOVF	SYSLONGDIVMULTB_H,W
	SUBWFB	SYSLONGDIVMULTX_H,F
	MOVF	SYSLONGDIVMULTB_U,W
	SUBWFB	SYSLONGDIVMULTX_U,F
	MOVF	SYSLONGDIVMULTB_E,W
	SUBWFB	SYSLONGDIVMULTX_E,F
	BSF	SYSLONGDIVMULTA,0
	BTFSC	STATUS,0
	GOTO	ENDIF12
	BCF	SYSLONGDIVMULTA,0
	MOVF	SYSLONGDIVMULTB,W
	ADDWF	SYSLONGDIVMULTX,F
	MOVF	SYSLONGDIVMULTB_H,W
	ADDWFC	SYSLONGDIVMULTX_H,F
	MOVF	SYSLONGDIVMULTB_U,W
	ADDWFC	SYSLONGDIVMULTX_U,F
	MOVF	SYSLONGDIVMULTB_E,W
	ADDWFC	SYSLONGDIVMULTX_E,F
ENDIF12:
	DECFSZ	SYSDIVLOOP, F
	GOTO	SYSDIV32START
	MOVF	SYSLONGDIVMULTA,W
	MOVWF	SYSLONGTEMPA
	MOVF	SYSLONGDIVMULTA_H,W
	MOVWF	SYSLONGTEMPA_H
	MOVF	SYSLONGDIVMULTA_U,W
	MOVWF	SYSLONGTEMPA_U
	MOVF	SYSLONGDIVMULTA_E,W
	MOVWF	SYSLONGTEMPA_E
	MOVF	SYSLONGDIVMULTX,W
	MOVWF	SYSLONGTEMPX
	MOVF	SYSLONGDIVMULTX_H,W
	MOVWF	SYSLONGTEMPX_H
	MOVF	SYSLONGDIVMULTX_U,W
	MOVWF	SYSLONGTEMPX_U
	MOVF	SYSLONGDIVMULTX_E,W
	MOVWF	SYSLONGTEMPX_E
	RETURN

;********************************************************************************

SYSMULTSUB:
	CLRF	SYSBYTETEMPX
MUL8LOOP:
	MOVF	SYSBYTETEMPA, W
	BTFSC	SYSBYTETEMPB, 0
	ADDWF	SYSBYTETEMPX, F
	BCF	STATUS,0
	RRF	SYSBYTETEMPB, F
	BCF	STATUS,0
	RLF	SYSBYTETEMPA, F
	MOVF	SYSBYTETEMPB, F
	BTFSS	STATUS,2
	GOTO	MUL8LOOP
	RETURN

;********************************************************************************

SYSREADSTRING:
	CALL	SYSSTRINGTABLES
	MOVWF	SYSCALCTEMPA
	MOVWF	INDF1
	GOTO	SYSSTRINGREADCHECK
SYSREADSTRINGPART:
	CALL	SYSSTRINGTABLES
	MOVWF	SYSCALCTEMPA
	ADDWF	SYSSTRINGLENGTH,F
SYSSTRINGREADCHECK:
	MOVF	SYSCALCTEMPA,F
	BTFSC	STATUS,2
	RETURN
SYSSTRINGREAD:
	CALL	SYSSTRINGTABLES
	ADDFSR	1,1
	MOVWF	INDF1
	DECFSZ	SYSCALCTEMPA, F
	GOTO	SYSSTRINGREAD
	RETURN

;********************************************************************************

SYSSTRINGTABLES:
	MOVF	SYSSTRINGA_H,W
	MOVWF	PCLATH
	MOVF	SYSSTRINGA,W
	INCF	SYSSTRINGA,F
	BTFSC	STATUS,2
	INCF	SYSSTRINGA_H,F
	MOVWF	PCL

STRINGTABLE1:
	RETLW	46
	RETLW	66	;B
	RETLW	117	;U
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	RETLW	46	;.


STRINGTABLE2:
	RETLW	34
	RETLW	66	;B
	RETLW	117	;U
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	RETLW	32	; 


STRINGTABLE3:
	RETLW	2
	RETLW	48	;0
	RETLW	120	;X


STRINGTABLE4:
	RETLW	34
	RETLW	66	;B
	RETLW	117	;U
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	RETLW	32	; 


STRINGTABLE5:
	RETLW	34
	RETLW	68	;D
	RETLW	105	;I
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	RETLW	32	; 


STRINGTABLE6:
	RETLW	9
	RETLW	83	;S
	RETLW	65	;A
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	RETLW	32	; 


STRINGTABLE7:
	RETLW	48
	RETLW	83	;S
	RETLW	101	;E
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	RETLW	120	;X
	RETLW	48	;0
	RETLW	56	;8
	RETLW	32	; 
	RETLW	45	;-
	RETLW	32	; 
	RETLW	48	;0
	RETLW	120	;X
	RETLW	48	;0
	RETLW	67	;C
	RETLW	32	; 
	RETLW	45	;-
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	RETLW	101	;E


STRINGTABLE8:
	RETLW	5
	RETLW	66	;B
	RETLW	108	;L
	RETLW	111	;O
	RETLW	99	;C
	RETLW	107	;K


STRINGTABLE9:
	RETLW	23
	RETLW	32	; 
	RETLW	32	; 
	RETLW	49	;1
	RETLW	32	; 
	RETLW	48	;0
	RETLW	32	; 
	RETLW	32	; 
	RETLW	32	; 
	RETLW	51	;3
	RETLW	32	; 
	RETLW	50	;2
	RETLW	32	; 
	RETLW	32	; 
	RETLW	32	; 
	RETLW	53	;5
	RETLW	32	; 
	RETLW	52	;4
	RETLW	32	; 
	RETLW	32	; 
	RETLW	32	; 
	RETLW	55	;7
	RETLW	32	; 
	RETLW	54	;6


STRINGTABLE10:
	RETLW	4
	RETLW	32	; 
	RETLW	32	; 
	RETLW	32	; 
	RETLW	32	; 


STRINGTABLE11:
	RETLW	2
	RETLW	32	; 
	RETLW	32	; 


;********************************************************************************

FN__HEXPICAS:
	MOVLW	2
	BANKSEL	SYS_HEXPICAS_0
	MOVWF	SYS_HEXPICAS_0
	MOVLW	15
	BANKSEL	SYSVALTEMP
	ANDWF	SYSVALTEMP,W
	MOVWF	SYSSTRINGTEMP
	SUBLW	9
	BTFSC	STATUS,0
	GOTO	ENDIF8
	MOVLW	7
	ADDWF	SYSSTRINGTEMP,F
ENDIF8:
	MOVLW	48
	ADDWF	SYSSTRINGTEMP,W
	BANKSEL	SYS_HEXPICAS_2
	MOVWF	SYS_HEXPICAS_2
	BANKSEL	SYSSTRINGTEMP
	CLRF	SYSSTRINGTEMP
SYSFORLOOP5:
	INCF	SYSSTRINGTEMP,F
	RRF	SYSVALTEMP,F
	MOVLW	4
	SUBWF	SYSSTRINGTEMP,W
	BTFSS	STATUS,0
	GOTO	SYSFORLOOP5
SYSFORLOOPEND5:
	MOVLW	15
	ANDWF	SYSVALTEMP,W
	MOVWF	SYSSTRINGTEMP
	SUBLW	9
	BTFSC	STATUS,0
	GOTO	ENDIF10
	MOVLW	7
	ADDWF	SYSSTRINGTEMP,F
ENDIF10:
	MOVLW	48
	ADDWF	SYSSTRINGTEMP,W
	BANKSEL	SYS_HEXPICAS_1
	MOVWF	SYS_HEXPICAS_1
	BANKSEL	STATUS
	RETURN

;********************************************************************************

;START OF PROGRAM MEMORY PAGE 1
	PSECT	PROGMEM1,CLASS=CODE,SPACE=SPACE_CODE,DELTA=2, ABS, OVRLD 
	ORG	2048
;START OF PROGRAM MEMORY PAGE 2
	PSECT	PROGMEM2,CLASS=CODE,SPACE=SPACE_CODE,DELTA=2, ABS, OVRLD 
	ORG	4096
;START OF PROGRAM MEMORY PAGE 3
	PSECT	PROGMEM3,CLASS=CODE,SPACE=SPACE_CODE,DELTA=2, ABS, OVRLD 
	ORG	6144
;
; Declare Power-On-Reset entry point
;
 END     RESETVEC
