;Program compiled by GCBASIC (1.00.00 Release Candidate 2022-11-06 (Windows 64 bit) : Build 1189) for Microchip PIC-AS
;  See the GCBASIC forums at http://sourceforge.net/projects/gcbasic/forums,
;  Check the documentation and Help at http://gcbasic.sourceforge.net/help/,
;or, email:
;   evanvennn at users dot sourceforge dot net

;********************************************************************************


;Set up the assembler options (Chip type, clock source, other bits and pieces)
;PROCESSOR   16F17126
 PAGEWIDTH   180
 RADIX       DEC
 TITLE       "d:\GreatCowBASICGits\Demonstration_Sources.git\trunk\Vendor_Boards\Great_Cow_Basic_Demo_Board\16F17126_chiprange_demonstrations\215_i2c_glcd_bmp_ssd1306_128_64.s"
 SUBTITLE    "11-14-2022"

; Reverse lookup file(s)
; C:\Program Files\Microchip\xc8\v2.40\pic\include\proc\pic16f17126.inc
; C:\Program Files\Microchip\xc8\v2.40\pic\dat\cfgmap\16f17126.cfgmap
; Alternative CONFIG file is to be found at C:\Program Files\Microchip\xc8\vX.YY\pic\dat\cfgdata as per Microchip support ticket #00730936 

;********************************************************************************

;********************************************************************************
;Explicit CONFIG
 CONFIG FCMEN=ON                                 ;C1 Reverselookup FCMEN = ON
 CONFIG CLKOUTEN=OFF                             ;C1 Reverselookup CLKOUTEN = OFF
 CONFIG RSTOSC=HFINTOSC_32MHz                    ;C1 Reverselookup RSTOSC = HFINTOSC_32MHZ
 CONFIG FEXTOSC=OFF                              ;C1 Reverselookup FEXTOSC = OFF
 CONFIG MCLRE=INTMCLR                            ;C1 Reverselookup MCLRE = INTMCLR
 CONFIG WDTE=OFF                                 ;C1 Reverselookup WDTE = OFF
 CONFIG LVP=OFF                                  ;C1 Reverselookup LVP = OFF
 CONFIG WRTSAF=OFF                               ;C1 Reverselookup WRTSAF = OFF
 CONFIG WRTD=OFF                                 ;C1 Reverselookup WRTD = OFF
 CONFIG WRTB=OFF                                 ;C1 Reverselookup WRTB = OFF
 CONFIG CPD=OFF                                  ;C1 Reverselookup CPD = OFF
 CONFIG CP=OFF                                   ;C1 Reverselookup CP = OFF
;Inferred CONFIG


;********************************************************************************
; The XC8 xc.inc include file.  This MUST be placed after the CONFIG statements.

 #include <xc.inc>

;********************************************************************************

;Set aside RAM memory locations for variables. All variables are global.
GLOBAL	CHARCODE
 CHARCODE                         EQU 32          ; 0X20
GLOBAL	CHARCOL
 CHARCOL                          EQU 33          ; 0X21
GLOBAL	CHARCOLS
 CHARCOLS                         EQU 35          ; 0X23
GLOBAL	CHARCOL_H
 CHARCOL_H                        EQU 34          ; 0X22
GLOBAL	CHARLOCX
 CHARLOCX                         EQU 36          ; 0X24
GLOBAL	CHARLOCX_H
 CHARLOCX_H                       EQU 37          ; 0X25
GLOBAL	CHARLOCY
 CHARLOCY                         EQU 38          ; 0X26
GLOBAL	CHARLOCY_H
 CHARLOCY_H                       EQU 39          ; 0X27
GLOBAL	CHARROW
 CHARROW                          EQU 40          ; 0X28
GLOBAL	CHARROWS
 CHARROWS                         EQU 42          ; 0X2A
GLOBAL	CHARROW_H
 CHARROW_H                        EQU 41          ; 0X29
GLOBAL	COL
 COL                              EQU 43          ; 0X2B
GLOBAL	CURRCHARCOL
 CURRCHARCOL                      EQU 44          ; 0X2C
GLOBAL	CURRCHARROW
 CURRCHARROW                      EQU 45          ; 0X2D
GLOBAL	CURRCHARVAL
 CURRCHARVAL                      EQU 46          ; 0X2E
GLOBAL	DELAYTEMP
 DELAYTEMP                        EQU 112          ; 0X70
GLOBAL	DELAYTEMP2
 DELAYTEMP2                       EQU 113          ; 0X71
GLOBAL	FIRSTPASS
 FIRSTPASS                        EQU 47          ; 0X2F
GLOBAL	GLCDBACKGROUND
 GLCDBACKGROUND                   EQU 48          ; 0X30
GLOBAL	GLCDBACKGROUND_H
 GLCDBACKGROUND_H                 EQU 49          ; 0X31
GLOBAL	GLCDBITNO
 GLCDBITNO                        EQU 50          ; 0X32
GLOBAL	GLCDCHANGE
 GLCDCHANGE                       EQU 51          ; 0X33
GLOBAL	GLCDCOLOUR
 GLCDCOLOUR                       EQU 52          ; 0X34
GLOBAL	GLCDCOLOUR_H
 GLCDCOLOUR_H                     EQU 53          ; 0X35
GLOBAL	GLCDDATATEMP
 GLCDDATATEMP                     EQU 54          ; 0X36
GLOBAL	GLCDFNTDEFAULT
 GLCDFNTDEFAULT                   EQU 55          ; 0X37
GLOBAL	GLCDFNTDEFAULTHEIGHT
 GLCDFNTDEFAULTHEIGHT             EQU 56          ; 0X38
GLOBAL	GLCDFNTDEFAULTSIZE
 GLCDFNTDEFAULTSIZE               EQU 57          ; 0X39
GLOBAL	GLCDFONTWIDTH
 GLCDFONTWIDTH                    EQU 58          ; 0X3A
GLOBAL	GLCDFOREGROUND
 GLCDFOREGROUND                   EQU 59          ; 0X3B
GLOBAL	GLCDFOREGROUND_H
 GLCDFOREGROUND_H                 EQU 60          ; 0X3C
GLOBAL	GLCDPRINTLEN
 GLCDPRINTLEN                     EQU 61          ; 0X3D
GLOBAL	GLCDPRINTLOC
 GLCDPRINTLOC                     EQU 62          ; 0X3E
GLOBAL	GLCDPRINTLOC_H
 GLCDPRINTLOC_H                   EQU 63          ; 0X3F
GLOBAL	GLCDPRINT_STRING_COUNTER
 GLCDPRINT_STRING_COUNTER         EQU 64          ; 0X40
GLOBAL	GLCDTEMP
 GLCDTEMP                         EQU 65          ; 0X41
GLOBAL	GLCDX
 GLCDX                            EQU 66          ; 0X42
GLOBAL	GLCDY
 GLCDY                            EQU 67          ; 0X43
GLOBAL	GLCD_YORDINATE
 GLCD_YORDINATE                   EQU 68          ; 0X44
GLOBAL	GLCD_YORDINATE_H
 GLCD_YORDINATE_H                 EQU 69          ; 0X45
GLOBAL	HEIGHTOFPICTURE
 HEIGHTOFPICTURE                  EQU 70          ; 0X46
GLOBAL	HI2CACKPOLLSTATE
 HI2CACKPOLLSTATE                 EQU 71          ; 0X47
GLOBAL	HI2CCURRENTMODE
 HI2CCURRENTMODE                  EQU 72          ; 0X48
GLOBAL	HI2CWAITMSSPTIMEOUT
 HI2CWAITMSSPTIMEOUT              EQU 73          ; 0X49
GLOBAL	I2CBYTE
 I2CBYTE                          EQU 74          ; 0X4A
GLOBAL	LENGTHOFPICTURE
 LENGTHOFPICTURE                  EQU 75          ; 0X4B
GLOBAL	LENGTHOFPICTURE_H
 LENGTHOFPICTURE_H                EQU 76          ; 0X4C
GLOBAL	LINECOLOUR
 LINECOLOUR                       EQU 77          ; 0X4D
GLOBAL	LINECOLOUR_H
 LINECOLOUR_H                     EQU 78          ; 0X4E
GLOBAL	LOCX
 LOCX                             EQU 79          ; 0X4F
GLOBAL	LOCY
 LOCY                             EQU 80          ; 0X50
GLOBAL	ORGCHARLOCX
 ORGCHARLOCX                      EQU 81          ; 0X51
GLOBAL	POSCHARX
 POSCHARX                         EQU 82          ; 0X52
GLOBAL	POSCHARX_H
 POSCHARX_H                       EQU 83          ; 0X53
GLOBAL	POSCHARY
 POSCHARY                         EQU 84          ; 0X54
GLOBAL	PRINTLOCX
 PRINTLOCX                        EQU 85          ; 0X55
GLOBAL	PRINTLOCX_H
 PRINTLOCX_H                      EQU 86          ; 0X56
GLOBAL	PRINTLOCY
 PRINTLOCY                        EQU 87          ; 0X57
GLOBAL	PRINTLOCY_H
 PRINTLOCY_H                      EQU 88          ; 0X58
GLOBAL	RAM_INDEX
 RAM_INDEX                        EQU 89          ; 0X59
GLOBAL	RAM_INDEX_H
 RAM_INDEX_H                      EQU 90          ; 0X5A
GLOBAL	ROW
 ROW                              EQU 91          ; 0X5B
GLOBAL	SSD1306SENDBYTE
 SSD1306SENDBYTE                  EQU 92          ; 0X5C
GLOBAL	SSD1306_BUFFERALIAS
 SSD1306_BUFFERALIAS              EQU 9199          ; 0X23EF
GLOBAL	SSD1306_BUFFERLOCATIONCALC
 SSD1306_BUFFERLOCATIONCALC       EQU 93          ; 0X5D
GLOBAL	SSD1306_BUFFERLOCATIONCALC_H
 SSD1306_BUFFERLOCATIONCALC_H     EQU 94          ; 0X5E
GLOBAL	STRINGPOINTER
 STRINGPOINTER                    EQU 95          ; 0X5F
GLOBAL	SYSBYTETEMPA
 SYSBYTETEMPA                     EQU 117          ; 0X75
GLOBAL	SYSBYTETEMPB
 SYSBYTETEMPB                     EQU 121          ; 0X79
GLOBAL	SYSBYTETEMPX
 SYSBYTETEMPX                     EQU 112          ; 0X70
GLOBAL	SYSDIVLOOP
 SYSDIVLOOP                       EQU 116          ; 0X74
GLOBAL	SYSDIVMULTA
 SYSDIVMULTA                      EQU 119          ; 0X77
GLOBAL	SYSDIVMULTA_H
 SYSDIVMULTA_H                    EQU 120          ; 0X78
GLOBAL	SYSDIVMULTB
 SYSDIVMULTB                      EQU 123          ; 0X7B
GLOBAL	SYSDIVMULTB_H
 SYSDIVMULTB_H                    EQU 124          ; 0X7C
GLOBAL	SYSDIVMULTX
 SYSDIVMULTX                      EQU 114          ; 0X72
GLOBAL	SYSDIVMULTX_H
 SYSDIVMULTX_H                    EQU 115          ; 0X73
GLOBAL	SYSFORLOOPABSVALUE4
 SYSFORLOOPABSVALUE4              EQU 96          ; 0X60
GLOBAL	SYSFORLOOPABSVALUE4_H
 SYSFORLOOPABSVALUE4_H            EQU 97          ; 0X61
GLOBAL	SYSFORLOOPSTEP3
 SYSFORLOOPSTEP3                  EQU 98          ; 0X62
GLOBAL	SYSFORLOOPSTEP3_H
 SYSFORLOOPSTEP3_H                EQU 99          ; 0X63
GLOBAL	SYSLCDPRINTDATAHANDLER
 SYSLCDPRINTDATAHANDLER           EQU 100          ; 0X64
GLOBAL	SYSLCDPRINTDATAHANDLER_H
 SYSLCDPRINTDATAHANDLER_H         EQU 101          ; 0X65
GLOBAL	SYSREPEATTEMP1
 SYSREPEATTEMP1                   EQU 102          ; 0X66
GLOBAL	SYSREPEATTEMP4
 SYSREPEATTEMP4                   EQU 103          ; 0X67
GLOBAL	SYSSTRINGA
 SYSSTRINGA                       EQU 119          ; 0X77
GLOBAL	SYSSTRINGA_H
 SYSSTRINGA_H                     EQU 120          ; 0X78
GLOBAL	SYSTEMP1
 SYSTEMP1                         EQU 104          ; 0X68
GLOBAL	SYSTEMP1_H
 SYSTEMP1_H                       EQU 105          ; 0X69
GLOBAL	SYSTEMP2
 SYSTEMP2                         EQU 106          ; 0X6A
GLOBAL	SYSTEMP2_H
 SYSTEMP2_H                       EQU 107          ; 0X6B
GLOBAL	SYSTEMP3
 SYSTEMP3                         EQU 108          ; 0X6C
GLOBAL	SYSWAITTEMPMS
 SYSWAITTEMPMS                    EQU 114          ; 0X72
GLOBAL	SYSWAITTEMPMS_H
 SYSWAITTEMPMS_H                  EQU 115          ; 0X73
GLOBAL	SYSWAITTEMPS
 SYSWAITTEMPS                     EQU 116          ; 0X74
GLOBAL	SYSWORDTEMPA
 SYSWORDTEMPA                     EQU 117          ; 0X75
GLOBAL	SYSWORDTEMPA_H
 SYSWORDTEMPA_H                   EQU 118          ; 0X76
GLOBAL	SYSWORDTEMPB
 SYSWORDTEMPB                     EQU 121          ; 0X79
GLOBAL	SYSWORDTEMPB_H
 SYSWORDTEMPB_H                   EQU 122          ; 0X7A
GLOBAL	SYSWORDTEMPX
 SYSWORDTEMPX                     EQU 112          ; 0X70
GLOBAL	SYSWORDTEMPX_H
 SYSWORDTEMPX_H                   EQU 113          ; 0X71
GLOBAL	WIDTHOFPICTURE
 WIDTHOFPICTURE                   EQU 109          ; 0X6D

;********************************************************************************

;ALIAS VARIABLES
GLOBAL	AFSR0
 AFSR0                            EQU 4
GLOBAL	AFSR0_H
 AFSR0_H                          EQU 5

;********************************************************************************

 PSECT   PROGMEM0,delta=2, abs
 RESETVEC:
;VECTORS
	ORG	0
	PAGESEL	BASPROGRAMSTART
	GOTO	BASPROGRAMSTART
	ORG	4
	RETFIE

;********************************************************************************

;START OF PROGRAM MEMORY PAGE 0
	ORG	5
GLOBAL	BASPROGRAMSTART
BASPROGRAMSTART:
;CALL INITIALISATION ROUTINES
	CALL	INITSYS
	CALL	INITPPS
	CALL	HI2CINIT
	CALL	INITGLCD_SSD1306
	PAGESEL	$

;START OF THE MAIN PROGRAM
;''
;''This demonstration program is a simple GLCD demonstration of the SSD1306 GLCD capabilities.
;''
;''This program is a simple GLCD demonstration of the SSD1306 GLCD capabilities.
;''This program draws lines, boxes, circles and prints strings and numbers.
;''The SSD1306 controller a small graphical OLED, suitable for a lot of various projects.
;''The display is 38*35 mm, with an active display surface of 0.96inches, and a 128*64 pixel resolution.
;''The display is easy to interface, using an I2C type of communication.
;''The GLCD is connected to the microprocessor as shown in the hardware section of this code.
;''
;''This version is compatible will all version of GCBASIC as this demonstration uses Full Memory GLCD mode only.  This can be adapted to Low Memory GLCD mode.
;''
;''************************************************************************
;''@author  EvanV
;''@licence GPL
;''@version 1.00
;''@date    31.10.2022
;----- Configuration
;Chip Settings.
;Generated by PIC PPS Tool for GCBASIC
;PPS Tool version: 0.0.6.3
;PinManager data: Not available (3)
;Generated for 16F17126
;
;Template comment at the start of the config file
;
;Template comment at the end of the config file
;' -------------------PORTA----------------
;' Bit#:  -7---6---5---4---3---2---1---0---
;' IO:   -------------SDA-SW------SCL-ADC--
;'-----------------------------------------
;'
;' -------------------PORTB----------------
;' Bit#:  -7---6---5---4---3---2---1---0---
;' IO:    ---------------------------------
;'-----------------------------------------
;'
;' ------------------PORTC-----------------
;' Bit#:  -7---6---5---4---3---2---1---0---
;' IO:    ------------TX-LED--LED-LED LED--
;'-----------------------------------------
;Define constants to make things easier. We can reuse these at any time.
;Dir     RC0         Out
	BCF	TRISC,0
;Dir     RC1         Out
	BCF	TRISC,1
;Dir     RC2         Out
	BCF	TRISC,2
;Dir     RC3         Out
	BCF	TRISC,3
;Dir     POTENTIOMETER In
	BSF	TRISA,0
;Dir     SWITCHIN      In
	BSF	TRISA,3
;Setup Serial port
;Define I2C settings
;Initialise I2C - note for the I2C module the ports need to be set to IN
;Dir HI2C_DATA In
	BSF	TRISA,4
;Dir HI2C_CLOCK In
	BSF	TRISA,1
;*****************************************************************************************************
;Main program commences here.. everything before this is setup for the board.
;A constant to  allow you to change the GLCD memory usage.
;Include a BMP file.  This will automatically convert to a table called ANOBIUMFULL
;Dim lengthofpicture, ram_index as word
;Dim bytenumber, widthofpicture, heightofpicture, orgcharlocx, currcharval, firstpass, charlocy, currcharrow, charlocx, ccount as Byte
;Display a BMP file
;GLCDCLS
	CALL	GLCDCLS_SSD1306
;GLCDPrintStringLn "About to load BMP"
	MOVLW	LOW STRINGTABLE2
	MOVWF	SYSLCDPRINTDATAHANDLER
	MOVLW	(HIGH STRINGTABLE2) | 128
	MOVWF	SYSLCDPRINTDATAHANDLER_H
	FCALL	GLCDPRINTSTRINGLN
;Wait 1 s
	MOVLW	1
	MOVWF	SYSWAITTEMPS
	FCALL	DELAY_S
;Add your own case statement here to handle multiple BMPs, you just  need the variables to be defined
;ReadTable AnobiumFull, 0, lengthofpicture
	MOVLW	2
	MOVWF	LENGTHOFPICTURE
	MOVLW	4
	MOVWF	LENGTHOFPICTURE_H
;ReadTable AnobiumFull, 1, widthofpicture
	MOVLW	128
	MOVWF	WIDTHOFPICTURE
;ReadTable AnobiumFull, 2, heightofpicture
	MOVLW	64
	MOVWF	HEIGHTOFPICTURE
;lengthofpicture =  heightofpicture / 8
	MOVWF	SYSWORDTEMPA
	CLRF	SYSWORDTEMPA_H
	MOVLW	8
	MOVWF	SYSWORDTEMPB
	CLRF	SYSWORDTEMPB_H
	FCALL	SYSDIVSUB16
	MOVF	SYSWORDTEMPA,W
	MOVWF	LENGTHOFPICTURE
	MOVF	SYSWORDTEMPA_H,W
	MOVWF	LENGTHOFPICTURE_H
;lengthofpicture = [word]lengthofpicture * widthofpicture
	MOVF	LENGTHOFPICTURE,W
	MOVWF	SYSWORDTEMPA
	MOVF	LENGTHOFPICTURE_H,W
	MOVWF	SYSWORDTEMPA_H
	MOVF	WIDTHOFPICTURE,W
	MOVWF	SYSWORDTEMPB
	CLRF	SYSWORDTEMPB_H
	FCALL	SYSMULTSUB16
	MOVF	SYSWORDTEMPX,W
	MOVWF	LENGTHOFPICTURE
	MOVF	SYSWORDTEMPX_H,W
	MOVWF	LENGTHOFPICTURE_H
;For BMP that fit the display simple write the data to the screen
;CharLocX = 0                       ' specify X pos for BMP
	CLRF	CHARLOCX
;CharLocY = 0                       ' specify Y pos for BMP.  For buffer any valid Y, for non-buffered 0,8,16, 24 etc...
	CLRF	CHARLOCY
;OrgCharLocX = CharLocX              ' specify X orginisal X pos
	MOVF	CHARLOCX,W
	MOVWF	ORGCHARLOCX
;firstpass = true                    ' specify this is the first pass
	MOVLW	255
	MOVWF	FIRSTPASS
;for  ram_index =  3 to lengthofpicture + 3         ; start at third byte and finish at the end
	MOVLW	3
	MOVWF	RAM_INDEX
	CLRF	RAM_INDEX_H
GLOBAL	SYSFORLOOP1
SYSFORLOOP1:
;Add your own case statement here to handle multiple BMPs, you just  need set CurrCharVal to the data value
;ReadTable AnobiumFull,  ( ram_index ), CurrCharVal  ' read data
	MOVF	RAM_INDEX,W
	MOVWF	SYSSTRINGA
	MOVF	RAM_INDEX_H,W
	MOVWF	SYSSTRINGA_H
	CALL	ANOBIUMFULL
	MOVWF	CURRCHARVAL
;if ( ( ram_index - 3 ) % widthofpicture ) = 0  and firstpass = false then     ' change position for new line of data
	MOVLW	3
	SUBWF	RAM_INDEX,W
	MOVWF	SYSTEMP1
	MOVLW	0
	SUBWFB	RAM_INDEX_H,W
	MOVWF	SYSTEMP1_H
	MOVF	SYSTEMP1,W
	MOVWF	SYSWORDTEMPA
	MOVF	SYSTEMP1_H,W
	MOVWF	SYSWORDTEMPA_H
	MOVF	WIDTHOFPICTURE,W
	MOVWF	SYSWORDTEMPB
	CLRF	SYSWORDTEMPB_H
	FCALL	SYSDIVSUB16
	MOVF	SYSWORDTEMPX,W
	MOVWF	SYSTEMP2
	MOVF	SYSWORDTEMPX_H,W
	MOVWF	SYSTEMP2_H
	MOVF	SYSTEMP2,W
	MOVWF	SYSWORDTEMPA
	MOVF	SYSTEMP2_H,W
	MOVWF	SYSWORDTEMPA_H
	CLRF	SYSWORDTEMPB
	CLRF	SYSWORDTEMPB_H
	FCALL	SYSCOMPEQUAL16
	MOVF	SYSBYTETEMPX,W
	MOVWF	SYSTEMP1
	MOVF	FIRSTPASS,W
	MOVWF	SYSBYTETEMPA
	CLRF	SYSBYTETEMPB
	FCALL	SYSCOMPEQUAL
	MOVF	SYSTEMP1,W
	ANDWF	SYSBYTETEMPX,W
	MOVWF	SYSTEMP2
	BTFSS	SYSTEMP2,0
	GOTO	ENDIF1
;CharLocY = CharLocY + 8
	MOVLW	8
	ADDWF	CHARLOCY,F
;CharLocX = OrgCharLocX
	MOVF	ORGCHARLOCX,W
	MOVWF	CHARLOCX
;end if
GLOBAL	ENDIF1
ENDIF1:
;For CurrCharRow = 0 to 7
;LEGACY METHOD
	MOVLW	255
	MOVWF	CURRCHARROW
GLOBAL	SYSFORLOOP2
SYSFORLOOP2:
	INCF	CURRCHARROW,F
;if ( CharLocY + CurrCharRow < GLCD_HEIGHT ) and ( CharLocX < GLCD_WIDTH ) then
	MOVF	CURRCHARROW,W
	ADDWF	CHARLOCY,W
	MOVWF	SYSTEMP1
	MOVWF	SYSBYTETEMPA
	MOVLW	64
	MOVWF	SYSBYTETEMPB
	FCALL	SYSCOMPLESSTHAN
	MOVF	SYSBYTETEMPX,W
	MOVWF	SYSTEMP2
	MOVF	CHARLOCX,W
	MOVWF	SYSBYTETEMPA
	MOVLW	128
	MOVWF	SYSBYTETEMPB
	FCALL	SYSCOMPLESSTHAN
	MOVF	SYSBYTETEMPX,W
	MOVWF	SYSTEMP1
	MOVF	SYSTEMP2,W
	ANDWF	SYSTEMP1,W
	MOVWF	SYSTEMP3
	BTFSS	SYSTEMP3,0
	GOTO	ENDIF2
;If CurrCharVal.0 = 0 Then
	BTFSC	CURRCHARVAL,0
	GOTO	ELSE5_1
;PSet CharLocX , CharLocY + CurrCharRow, GLCDBackground
	MOVF	CHARLOCX,W
	MOVWF	GLCDX
	MOVF	CURRCHARROW,W
	ADDWF	CHARLOCY,W
	MOVWF	GLCDY
	MOVF	GLCDBACKGROUND,W
	MOVWF	GLCDCOLOUR
	MOVF	GLCDBACKGROUND_H,W
	MOVWF	GLCDCOLOUR_H
	FCALL	PSET_SSD1306
;Else
	GOTO	ENDIF5
GLOBAL	ELSE5_1
ELSE5_1:
;PSet CharLocX , CharLocY + CurrCharRow, GLCDForeground
	MOVF	CHARLOCX,W
	MOVWF	GLCDX
	MOVF	CURRCHARROW,W
	ADDWF	CHARLOCY,W
	MOVWF	GLCDY
	MOVF	GLCDFOREGROUND,W
	MOVWF	GLCDCOLOUR
	MOVF	GLCDFOREGROUND_H,W
	MOVWF	GLCDCOLOUR_H
	FCALL	PSET_SSD1306
;End If
GLOBAL	ENDIF5
ENDIF5:
;end if
GLOBAL	ENDIF2
ENDIF2:
;Rotate CurrCharVal Right
	RRF	CURRCHARVAL,F
;Next
	MOVLW	7
	SUBWF	CURRCHARROW,W
	BTFSS	STATUS,0
	GOTO	SYSFORLOOP2
GLOBAL	SYSFORLOOPEND2
SYSFORLOOPEND2:
;firstpass = false                                          ' now this is NOT the first pass
	CLRF	FIRSTPASS
;CharLocX++                                                 ' increment the X pos
	INCF	CHARLOCX,F
;next
;POSITIVE VALUE STEP HANDLER IN FOR-NEXT STATEMENT :#4P 
	MOVLW	3
	ADDWF	LENGTHOFPICTURE,W
	MOVWF	SYSTEMP1
	MOVLW	0
	ADDWFC	LENGTHOFPICTURE_H,W
	MOVWF	SYSTEMP1_H
	MOVF	RAM_INDEX,W
	SUBWF	SYSTEMP1,W
	MOVWF	SYSTEMP2
	MOVF	RAM_INDEX_H,W
	SUBWFB	SYSTEMP1_H,W
	MOVWF	SYSTEMP2_H
	MOVF	SYSTEMP2,W
	MOVWF	SYSWORDTEMPA
	MOVF	SYSTEMP2_H,W
	MOVWF	SYSWORDTEMPA_H
	CLRF	SYSWORDTEMPB
	CLRF	SYSWORDTEMPB_H
	FCALL	SYSCOMPEQUAL16
	COMF	SYSBYTETEMPX,F
	BTFSS	SYSBYTETEMPX,0
	GOTO	ENDIF4
;SET LOOPVAR TO LOOPVAR + STEPVALUE WHERE STEPVALUE IS A POSITIVE VALUE
	INCF	RAM_INDEX,F
	BTFSC	STATUS,2
	INCF	RAM_INDEX_H,F
	GOTO	SYSFORLOOP1
;END IF
GLOBAL	ENDIF4
ENDIF4:
GLOBAL	SYSFORLOOPEND1
SYSFORLOOPEND1:
;asm showdebug  GGLCD SSD1306 buffer is 1024bytes
GLOBAL	BASPROGRAMEND
BASPROGRAMEND:
	SLEEP
	GOTO	BASPROGRAMEND

;********************************************************************************

GLOBAL	ANOBIUMFULL
ANOBIUMFULL:
	MOVF	SYSSTRINGA,W
	MOVWF	SYSWORDTEMPA
	MOVF	SYSSTRINGA_H,W
	MOVWF	SYSWORDTEMPA_H
	MOVLW	191
	MOVWF	SYSWORDTEMPB
	MOVLW	3
	MOVWF	SYSWORDTEMPB_H
	FCALL	SYSCOMPLESSTHAN16
	BTFSS	SYSBYTETEMPX,0
	RETLW	0
	MOVF	SYSSTRINGA, W
	ADDLW	LOW TABLEANOBIUMFULL
	MOVWF	SYSSTRINGA
	MOVLW	(HIGH TABLEANOBIUMFULL) & 127
	BTFSC	STATUS,0
	ADDLW	1
	ADDWF	SYSSTRINGA_H, W
	MOVWF	PCLATH
	MOVF	SYSSTRINGA, W
	MOVWF	PCL
GLOBAL	TABLEANOBIUMFULL
TABLEANOBIUMFULL:
	RETLW	2
	RETLW	128
	RETLW	64
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	RETLW	7

;********************************************************************************

GLOBAL	GLCDCHARCOL3
GLCDCHARCOL3:
	MOVLW	113
	SUBWF	SYSSTRINGA, W
	BTFSC	STATUS,0
	RETLW	0
	MOVF	SYSSTRINGA, W
	ADDLW	LOW TABLEGLCDCHARCOL3
	MOVWF	SYSSTRINGA
	MOVLW	(HIGH TABLEGLCDCHARCOL3) & 127
	BTFSC	STATUS,0
	ADDLW	1
	MOVWF	PCLATH
	MOVF	SYSSTRINGA, W
	MOVWF	PCL
GLOBAL	TABLEGLCDCHARCOL3
TABLEGLCDCHARCOL3:
	RETLW	112
	RETLW	0
	RETLW	16
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	RETLW	120

;********************************************************************************

GLOBAL	GLCDCHARCOL4
GLCDCHARCOL4:
	MOVLW	113
	SUBWF	SYSSTRINGA, W
	BTFSC	STATUS,0
	RETLW	0
	MOVF	SYSSTRINGA, W
	ADDLW	LOW TABLEGLCDCHARCOL4
	MOVWF	SYSSTRINGA
	MOVLW	(HIGH TABLEGLCDCHARCOL4) & 127
	BTFSC	STATUS,0
	ADDLW	1
	MOVWF	PCLATH
	MOVF	SYSSTRINGA, W
	MOVWF	PCL
GLOBAL	TABLEGLCDCHARCOL4
TABLEGLCDCHARCOL4:
	RETLW	112
	RETLW	254
	RETLW	56
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	RETLW	68

;********************************************************************************

;SOURCE: GLCD_SSD1306.H (427)
GLOBAL	GLCDCLS_SSD1306
GLCDCLS_SSD1306:
;initialise global variable. Required variable for Circle in all DEVICE DRIVERS- DO NOT DELETE
;GLCD_yordinate = 0
	CLRF	GLCD_YORDINATE
	CLRF	GLCD_YORDINATE_H
;For SSD1306_BufferLocationCalc = 1 to GLCD_HEIGHT * GLCD_WIDTH / 8
	MOVLW	1
	MOVWF	SSD1306_BUFFERLOCATIONCALC
	CLRF	SSD1306_BUFFERLOCATIONCALC_H
GLOBAL	SYSFORLOOP3
SYSFORLOOP3:
;SSD1306_BufferAlias(SSD1306_BufferLocationCalc) = 0
	MOVLW	LOW(SSD1306_BUFFERALIAS)
	ADDWF	SSD1306_BUFFERLOCATIONCALC,W
	MOVWF	FSR0L
	MOVLW	HIGH(SSD1306_BUFFERALIAS)
	ADDWFC	SSD1306_BUFFERLOCATIONCALC_H,W
	MOVWF	FSR0H
	CLRF	INDF0
;Next
;POSITIVE VALUE STEP HANDLER IN FOR-NEXT STATEMENT :#4P 
	MOVF	SSD1306_BUFFERLOCATIONCALC,W
	SUBLW	0
	MOVWF	SYSTEMP1
	MOVLW	4
	MOVWF	SYSTEMP3
	MOVF	SSD1306_BUFFERLOCATIONCALC_H,W
	SUBWFB	SYSTEMP3,W
	MOVWF	SYSTEMP1_H
	MOVF	SYSTEMP1,W
	MOVWF	SYSWORDTEMPA
	MOVF	SYSTEMP1_H,W
	MOVWF	SYSWORDTEMPA_H
	CLRF	SYSWORDTEMPB
	CLRF	SYSWORDTEMPB_H
	FCALL	SYSCOMPEQUAL16
	COMF	SYSBYTETEMPX,F
	BTFSS	SYSBYTETEMPX,0
	GOTO	ENDIF6
;SET LOOPVAR TO LOOPVAR + STEPVALUE WHERE STEPVALUE IS A POSITIVE VALUE
	INCF	SSD1306_BUFFERLOCATIONCALC,F
	BTFSC	STATUS,2
	INCF	SSD1306_BUFFERLOCATIONCALC_H,F
	GOTO	SYSFORLOOP3
;END IF
GLOBAL	ENDIF6
ENDIF6:
GLOBAL	SYSFORLOOPEND3
SYSFORLOOPEND3:
;1.14 changed to transaction
;For SSD1306_BufferLocationCalc = 0 to GLCD_HEIGHT-1 step 8
	CLRF	SSD1306_BUFFERLOCATIONCALC
	CLRF	SSD1306_BUFFERLOCATIONCALC_H
GLOBAL	SYSFORLOOP4
SYSFORLOOP4:
;INIT SYSFORLOOPSTEP3 :#0
	MOVLW	8
	MOVWF	SYSFORLOOPSTEP3
	CLRF	SYSFORLOOPSTEP3_H
;Cursor_Position_SSD1306 ( 0 , SSD1306_BufferLocationCalc )
	CLRF	LOCX
	MOVF	SSD1306_BUFFERLOCATIONCALC,W
	MOVWF	LOCY
	FCALL	CURSOR_POSITION_SSD1306
;Open_Transaction_SSD1306
;Macro Source: glcd_ssd1306.h (1218)
;4wire not supported, see Write_Transaction_Data_SSD1306
;HI2CStart
	FCALL	HI2CSTART
;HI2CSend GLCD_I2C_Address
	MOVLW	120
	MOVWF	I2CBYTE
	FCALL	HI2CSEND
;HI2CSend 0x40
	MOVLW	64
	MOVWF	I2CBYTE
	FCALL	HI2CSEND
;For GLCDTemp = 0 to 127
;LEGACY METHOD
	MOVLW	255
	MOVWF	GLCDTEMP
GLOBAL	SYSFORLOOP5
SYSFORLOOP5:
	INCF	GLCDTEMP,F
;Write_Transaction_Data_SSD1306(GLCDBackground)
;Macro Source: glcd_ssd1306.h (1249)
;HI2CSend SSD1306SendByte
	MOVF	GLCDBACKGROUND,W
	MOVWF	I2CBYTE
	FCALL	HI2CSEND
;Next
	MOVLW	127
	SUBWF	GLCDTEMP,W
	BTFSS	STATUS,0
	GOTO	SYSFORLOOP5
GLOBAL	SYSFORLOOPEND5
SYSFORLOOPEND5:
;Close_Transaction_SSD1306
;Macro Source: glcd_ssd1306.h (1282)
;4wire not supported, see Write_Transaction_Data_SSD1306
;HI2CStop
	FCALL	HI2CSTOP
;Next
;INTEGER NEGATIVE STEP HANDLER IN FOR-NEXT STATEMENT
	BTFSS	SYSFORLOOPSTEP3_H,7
	GOTO	ELSE8_1
;SET SYSFORLOOPABSVALUE TO -STEPVALUE :#1 
	COMF	SYSFORLOOPSTEP3,W
	MOVWF	SYSFORLOOPABSVALUE4
	COMF	SYSFORLOOPSTEP3_H,W
	MOVWF	SYSFORLOOPABSVALUE4_H
	INCF	SYSFORLOOPABSVALUE4,F
	BTFSC	STATUS,2
	INCF	SYSFORLOOPABSVALUE4_H,F
;IF ( SSD1306_BUFFERLOCATIONCALC - 64-1) } [WORD]SYSFORLOOPABSVALUE4 THEN  :#1N 
	MOVLW	64
	SUBWF	SSD1306_BUFFERLOCATIONCALC,W
	MOVWF	SYSTEMP1
	MOVLW	0
	SUBWFB	SSD1306_BUFFERLOCATIONCALC_H,W
	MOVWF	SYSTEMP1_H
	MOVLW	1
	SUBWF	SYSTEMP1,W
	MOVWF	SYSTEMP2
	MOVLW	0
	SUBWFB	SYSTEMP1_H,W
	MOVWF	SYSTEMP2_H
	MOVF	SYSTEMP2,W
	MOVWF	SYSWORDTEMPA
	MOVF	SYSTEMP2_H,W
	MOVWF	SYSWORDTEMPA_H
	MOVF	SYSFORLOOPABSVALUE4,W
	MOVWF	SYSWORDTEMPB
	MOVF	SYSFORLOOPABSVALUE4_H,W
	MOVWF	SYSWORDTEMPB_H
	FCALL	SYSCOMPLESSTHAN16
	COMF	SYSBYTETEMPX,F
	BTFSS	SYSBYTETEMPX,0
	GOTO	ENDIF9
;SET LOOPVAR TO LOOPVAR + STEPVALUE WHERE STEPVALUE IS A NEGATIVE VALUE
	MOVF	SYSFORLOOPSTEP3,W
	ADDWF	SSD1306_BUFFERLOCATIONCALC,F
	MOVF	SYSFORLOOPSTEP3_H,W
	ADDWFC	SSD1306_BUFFERLOCATIONCALC_H,F
	GOTO	SYSFORLOOP4
;END IF
GLOBAL	ENDIF9
ENDIF9:
	GOTO	ENDIF8
GLOBAL	ELSE8_1
ELSE8_1:
;INTEGER POSITIVE STEP HANDLER IN FOR-NEXT STATEMENT
;IF ([WORD]64-1 - [WORD]SSD1306_BUFFERLOCATIONCALC) } [WORD]SYSFORLOOPSTEP3 THEN :#1P 
	MOVF	SSD1306_BUFFERLOCATIONCALC,W
	SUBLW	63
	MOVWF	SYSTEMP1
	CLRF	SYSTEMP3
	MOVF	SSD1306_BUFFERLOCATIONCALC_H,W
	SUBWFB	SYSTEMP3,W
	MOVWF	SYSTEMP1_H
	MOVF	SYSTEMP1,W
	MOVWF	SYSWORDTEMPA
	MOVF	SYSTEMP1_H,W
	MOVWF	SYSWORDTEMPA_H
	MOVF	SYSFORLOOPSTEP3,W
	MOVWF	SYSWORDTEMPB
	MOVF	SYSFORLOOPSTEP3_H,W
	MOVWF	SYSWORDTEMPB_H
	FCALL	SYSCOMPLESSTHAN16
	COMF	SYSBYTETEMPX,F
	BTFSS	SYSBYTETEMPX,0
	GOTO	ENDIF10
;SET LOOPVAR TO LOOPVAR + STEPVALUE WHERE STEPVALUE IS A POSITIVE VALUE
	MOVF	SYSFORLOOPSTEP3,W
	ADDWF	SSD1306_BUFFERLOCATIONCALC,F
	MOVF	SYSFORLOOPSTEP3_H,W
	ADDWFC	SSD1306_BUFFERLOCATIONCALC_H,F
	GOTO	SYSFORLOOP4
;END IF
GLOBAL	ENDIF10
ENDIF10:
;END IF
GLOBAL	ENDIF8
ENDIF8:
GLOBAL	SYSFORLOOPEND4
SYSFORLOOPEND4:
;Removed at 1.14. Retained for documentation only
;Cursor_Position_SSD1306 ( 0 , 0 )
;for SSD1306_BufferLocationCalc = 0 to GLCD_HEIGHT-1 step 8
;for GLCDTemp = 0 to 127
;Write_Data_SSD1306(GLCDBackground)
;Next
;next
;Cursor_Position_SSD1306 ( 0 , 0 )
	CLRF	LOCX
	CLRF	LOCY
	FCALL	CURSOR_POSITION_SSD1306
;PrintLocX =0
	CLRF	PRINTLOCX
;PrintLocY =0
	CLRF	PRINTLOCY
	RETURN

;********************************************************************************

;SOURCE: GLCD_SSD1306.H (475)
GLOBAL	GLCDDRAWCHAR_SSD1306
GLCDDRAWCHAR_SSD1306:
;This is now in four parts
;1. Handler for GLCD LM mode
;2. Preamble
;3. GCB Font set handler
;4. OLED Font set handler
;***** Handler for GLCD LM mode
;****** Preamble
;invert colors if required
;if LineColour <> GLCDForeground  then
	MOVF	LINECOLOUR,W
	MOVWF	SYSWORDTEMPA
	MOVF	LINECOLOUR_H,W
	MOVWF	SYSWORDTEMPA_H
	MOVF	GLCDFOREGROUND,W
	MOVWF	SYSWORDTEMPB
	MOVF	GLCDFOREGROUND_H,W
	MOVWF	SYSWORDTEMPB_H
	FCALL	SYSCOMPEQUAL16
	COMF	SYSBYTETEMPX,F
	BTFSS	SYSBYTETEMPX,0
	GOTO	ENDIF33
;Inverted Colours
;GLCDBackground = 1
	MOVLW	1
	MOVWF	GLCDBACKGROUND
	CLRF	GLCDBACKGROUND_H
;GLCDForeground = 0
	CLRF	GLCDFOREGROUND
	CLRF	GLCDFOREGROUND_H
;end if
GLOBAL	ENDIF33
ENDIF33:
;dim CharCol, CharRow as word
;CharCode -= 15
	MOVLW	15
	SUBWF	CHARCODE,F
;CharCol=0
	CLRF	CHARCOL
	CLRF	CHARCOL_H
;Cursor_Position_SSD1306 ( CharLocX , CharLocY )
	MOVF	CHARLOCX,W
	MOVWF	LOCX
	MOVF	CHARLOCY,W
	MOVWF	LOCY
	FCALL	CURSOR_POSITION_SSD1306
;1.14 Added transaction
;****** GCB Font set handler
;if CharCode>=178 and CharCode<=202 then
	MOVF	CHARCODE,W
	MOVWF	SYSBYTETEMPA
	MOVLW	178
	MOVWF	SYSBYTETEMPB
	FCALL	SYSCOMPLESSTHAN
	COMF	SYSBYTETEMPX,F
	MOVF	SYSBYTETEMPX,W
	MOVWF	SYSTEMP3
	MOVF	CHARCODE,W
	MOVWF	SYSBYTETEMPB
	MOVLW	202
	MOVWF	SYSBYTETEMPA
	FCALL	SYSCOMPLESSTHAN
	COMF	SYSBYTETEMPX,F
	MOVF	SYSTEMP3,W
	ANDWF	SYSBYTETEMPX,W
	MOVWF	SYSTEMP1
	BTFSS	SYSTEMP1,0
	GOTO	ENDIF34
;CharLocY=CharLocY-1
	MOVLW	1
	SUBWF	CHARLOCY,F
	MOVLW	0
	SUBWFB	CHARLOCY_H,F
;end if
GLOBAL	ENDIF34
ENDIF34:
;For CurrCharCol = 1 to 5
;LEGACY METHOD
	CLRF	CURRCHARCOL
GLOBAL	SYSFORLOOP7
SYSFORLOOP7:
	INCF	CURRCHARCOL,F
;Select Case CurrCharCol
;Case 1: ReadTable GLCDCharCol3, CharCode, CurrCharVal
GLOBAL	SYSSELECT1CASE1
SYSSELECT1CASE1:
	DECF	CURRCHARCOL,W
	BTFSS	STATUS,2
	GOTO	SYSSELECT1CASE2
;Case 1: ReadTable GLCDCharCol3, CharCode, CurrCharVal
	MOVF	CHARCODE,W
	MOVWF	SYSSTRINGA
	CALL	GLCDCHARCOL3
	MOVWF	CURRCHARVAL
;Case 2: ReadTable GLCDCharCol4, CharCode, CurrCharVal
	GOTO	SYSSELECTEND1
GLOBAL	SYSSELECT1CASE2
SYSSELECT1CASE2:
	MOVLW	2
	SUBWF	CURRCHARCOL,W
	BTFSS	STATUS,2
	GOTO	SYSSELECT1CASE3
;Case 2: ReadTable GLCDCharCol4, CharCode, CurrCharVal
	MOVF	CHARCODE,W
	MOVWF	SYSSTRINGA
	CALL	GLCDCHARCOL4
	MOVWF	CURRCHARVAL
;Case 3: ReadTable GLCDCharCol5, CharCode, CurrCharVal
	GOTO	SYSSELECTEND1
GLOBAL	SYSSELECT1CASE3
SYSSELECT1CASE3:
	MOVLW	3
	SUBWF	CURRCHARCOL,W
	BTFSS	STATUS,2
	GOTO	SYSSELECT1CASE4
;Case 3: ReadTable GLCDCharCol5, CharCode, CurrCharVal
	MOVF	CHARCODE,W
	MOVWF	SYSSTRINGA
	FCALL	GLCDCHARCOL5
	MOVWF	CURRCHARVAL
;Case 4: ReadTable GLCDCharCol6, CharCode, CurrCharVal
	GOTO	SYSSELECTEND1
GLOBAL	SYSSELECT1CASE4
SYSSELECT1CASE4:
	MOVLW	4
	SUBWF	CURRCHARCOL,W
	BTFSS	STATUS,2
	GOTO	SYSSELECT1CASE5
;Case 4: ReadTable GLCDCharCol6, CharCode, CurrCharVal
	MOVF	CHARCODE,W
	MOVWF	SYSSTRINGA
	FCALL	GLCDCHARCOL6
	MOVWF	CURRCHARVAL
;Case 5: ReadTable GLCDCharCol7, CharCode, CurrCharVal
	GOTO	SYSSELECTEND1
GLOBAL	SYSSELECT1CASE5
SYSSELECT1CASE5:
	MOVLW	5
	SUBWF	CURRCHARCOL,W
	BTFSS	STATUS,2
	GOTO	SYSSELECTEND1
;Case 5: ReadTable GLCDCharCol7, CharCode, CurrCharVal
	MOVF	CHARCODE,W
	MOVWF	SYSSTRINGA
	FCALL	GLCDCHARCOL7
	MOVWF	CURRCHARVAL
;End Select
GLOBAL	SYSSELECTEND1
SYSSELECTEND1:
;Full Memory GLCD mode
;CharRow=0
	CLRF	CHARROW
	CLRF	CHARROW_H
;For CurrCharRow = 1 to 8
;LEGACY METHOD
	CLRF	CURRCHARROW
GLOBAL	SYSFORLOOP8
SYSFORLOOP8:
	INCF	CURRCHARROW,F
;CharColS=0
	CLRF	CHARCOLS
;For Col=1 to GLCDfntDefaultsize
	MOVLW	1
	MOVWF	COL
GLOBAL	SYSFORLOOP9
SYSFORLOOP9:
;CharRowS=0
	CLRF	CHARROWS
;For Row=1 to GLCDfntDefaultsize
	MOVLW	1
	MOVWF	ROW
GLOBAL	SYSFORLOOP10
SYSFORLOOP10:
;if CurrCharVal.0=1 then
	BTFSS	CURRCHARVAL,0
	GOTO	ELSE35_1
;PSet [word]CharLocX + CharCol + CharColS, [word]CharLocY + CharRow + CharRowS, LineColour
	MOVF	CHARCOL,W
	ADDWF	CHARLOCX,W
	MOVWF	SYSTEMP3
	MOVF	CHARCOLS,W
	ADDWF	SYSTEMP3,W
	MOVWF	GLCDX
	MOVF	CHARROW,W
	ADDWF	CHARLOCY,W
	MOVWF	SYSTEMP3
	MOVF	CHARROWS,W
	ADDWF	SYSTEMP3,W
	MOVWF	GLCDY
	MOVF	LINECOLOUR,W
	MOVWF	GLCDCOLOUR
	MOVF	LINECOLOUR_H,W
	MOVWF	GLCDCOLOUR_H
	FCALL	PSET_SSD1306
;Else
	GOTO	ENDIF35
GLOBAL	ELSE35_1
ELSE35_1:
;PSet [word]CharLocX + CharCol + CharColS, [word]CharLocY + CharRow + CharRowS, GLCDBackground
	MOVF	CHARCOL,W
	ADDWF	CHARLOCX,W
	MOVWF	SYSTEMP3
	MOVF	CHARCOLS,W
	ADDWF	SYSTEMP3,W
	MOVWF	GLCDX
	MOVF	CHARROW,W
	ADDWF	CHARLOCY,W
	MOVWF	SYSTEMP3
	MOVF	CHARROWS,W
	ADDWF	SYSTEMP3,W
	MOVWF	GLCDY
	MOVF	GLCDBACKGROUND,W
	MOVWF	GLCDCOLOUR
	MOVF	GLCDBACKGROUND_H,W
	MOVWF	GLCDCOLOUR_H
	FCALL	PSET_SSD1306
;End if
GLOBAL	ENDIF35
ENDIF35:
;Put out a white intercharacter pixel/space
;PSet [word]CharLocX + ( GLCDFontWidth * GLCDfntDefaultsize) , [word]CharLocY + CharRow + CharRowS , GLCDBackground
	MOVF	GLCDFONTWIDTH,W
	MOVWF	SYSBYTETEMPA
	MOVF	GLCDFNTDEFAULTSIZE,W
	MOVWF	SYSBYTETEMPB
	FCALL	SYSMULTSUB
	MOVF	SYSBYTETEMPX,W
	MOVWF	SYSTEMP3
	ADDWF	CHARLOCX,W
	MOVWF	GLCDX
	MOVF	CHARROW,W
	ADDWF	CHARLOCY,W
	MOVWF	SYSTEMP3
	MOVF	CHARROWS,W
	ADDWF	SYSTEMP3,W
	MOVWF	GLCDY
	MOVF	GLCDBACKGROUND,W
	MOVWF	GLCDCOLOUR
	MOVF	GLCDBACKGROUND_H,W
	MOVWF	GLCDCOLOUR_H
	FCALL	PSET_SSD1306
;CharRowS +=1
	INCF	CHARROWS,F
;Next Row
;POSITIVE VALUE STEP HANDLER IN FOR-NEXT STATEMENT :#4P 
	MOVF	ROW,W
	SUBWF	GLCDFNTDEFAULTSIZE,W
	MOVWF	SYSTEMP3
	MOVWF	SYSBYTETEMPA
	CLRF	SYSBYTETEMPB
	FCALL	SYSCOMPEQUAL
	COMF	SYSBYTETEMPX,F
	BTFSS	SYSBYTETEMPX,0
	GOTO	ENDIF36
;SET LOOPVAR TO LOOPVAR + STEPVALUE WHERE STEPVALUE IS A POSITIVE VALUE
	INCF	ROW,F
	GOTO	SYSFORLOOP10
;END IF
GLOBAL	ENDIF36
ENDIF36:
GLOBAL	SYSFORLOOPEND10
SYSFORLOOPEND10:
;CharColS +=1
	INCF	CHARCOLS,F
;Next Col
;POSITIVE VALUE STEP HANDLER IN FOR-NEXT STATEMENT :#4P 
	MOVF	COL,W
	SUBWF	GLCDFNTDEFAULTSIZE,W
	MOVWF	SYSTEMP3
	MOVWF	SYSBYTETEMPA
	CLRF	SYSBYTETEMPB
	FCALL	SYSCOMPEQUAL
	COMF	SYSBYTETEMPX,F
	BTFSS	SYSBYTETEMPX,0
	GOTO	ENDIF37
;SET LOOPVAR TO LOOPVAR + STEPVALUE WHERE STEPVALUE IS A POSITIVE VALUE
	INCF	COL,F
	GOTO	SYSFORLOOP9
;END IF
GLOBAL	ENDIF37
ENDIF37:
GLOBAL	SYSFORLOOPEND9
SYSFORLOOPEND9:
;Rotate CurrCharVal Right
	RRF	CURRCHARVAL,F
;CharRow +=GLCDfntDefaultsize
	MOVF	GLCDFNTDEFAULTSIZE,W
	ADDWF	CHARROW,F
	MOVLW	0
	ADDWFC	CHARROW_H,F
;Next
	MOVLW	8
	SUBWF	CURRCHARROW,W
	BTFSS	STATUS,0
	GOTO	SYSFORLOOP8
GLOBAL	SYSFORLOOPEND8
SYSFORLOOPEND8:
;CharCol +=GLCDfntDefaultsize
	MOVF	GLCDFNTDEFAULTSIZE,W
	ADDWF	CHARCOL,F
	MOVLW	0
	ADDWFC	CHARCOL_H,F
;1.14 Low Memory GLCD mode
;1.12 Character GLCD mode
;Handles specific draw sequence. This caters for write only of a bit value. No read operation.
;Next
	MOVLW	5
	SUBWF	CURRCHARCOL,W
	BTFSS	STATUS,0
	GOTO	SYSFORLOOP7
GLOBAL	SYSFORLOOPEND7
SYSFORLOOPEND7:
;****** OLED Font set handler
;1.14 Added transaction
;Restore
;GLCDBackground = 0
	CLRF	GLCDBACKGROUND
	CLRF	GLCDBACKGROUND_H
;GLCDForeground = 1
	MOVLW	1
	MOVWF	GLCDFOREGROUND
	CLRF	GLCDFOREGROUND_H
	RETURN

;********************************************************************************

;SOURCE: HWI2C.H (709)
GLOBAL	HI2CINIT
HI2CINIT:
;asm showdebug  This method sets the variable `HI2CCurrentMode`, and, if required calls the method `SI2CInit` to set up new MSSP modules - aka K42s family chips
;HI2CCurrentMode = 0
	CLRF	HI2CCURRENTMODE
;Initialise the I2C module
	RETURN

;********************************************************************************

;SOURCE: GLCD_SSD1306.H (317)
GLOBAL	INITGLCD_SSD1306
INITGLCD_SSD1306:
;Colours //Set these first
;GLCDBackground = 0
	CLRF	GLCDBACKGROUND
	CLRF	GLCDBACKGROUND_H
;GLCDForeground = 1
	MOVLW	1
	MOVWF	GLCDFOREGROUND
	CLRF	GLCDFOREGROUND_H
;GLCDFontWidth = 5
	MOVLW	5
	MOVWF	GLCDFONTWIDTH
;GLCDfntDefaultHeight = 7  'used by GLCDPrintString and GLCDPrintStringLn
	MOVLW	7
	MOVWF	GLCDFNTDEFAULTHEIGHT
;dim PrintLocX, PrintLocY as word
;GLCDfntDefault = 0
	CLRF	GLCDFNTDEFAULT
;GLCDfntDefaultsize = 1
	MOVLW	1
	MOVWF	GLCDFNTDEFAULTSIZE
;wait 255 ms             'added to ensure the charge pump and power is operational.
	MOVLW	255
	MOVWF	SYSWAITTEMPMS
	CLRF	SYSWAITTEMPMS_H
	FCALL	DELAY_MS
;HI2CMode Master
	MOVLW	12
	MOVWF	HI2CCURRENTMODE
	FCALL	HI2CMODE
;Wait 15 ms  'wait for power-up and reset
	MOVLW	15
	MOVWF	SYSWAITTEMPMS
	CLRF	SYSWAITTEMPMS_H
	FCALL	DELAY_MS
;Setup code for SSD1306 controllers
;Init sequence for 128x64 OLED module
;Write_Command_SSD1306(SSD1306_DISPLAYOFF)                    ' 0xAE
	MOVLW	174
	MOVWF	SSD1306SENDBYTE
	FCALL	WRITE_COMMAND_SSD1306
;Write_Command_SSD1306(SSD1306_DEACTIVATE_SCROLL)
	MOVLW	46
	MOVWF	SSD1306SENDBYTE
	FCALL	WRITE_COMMAND_SSD1306
;Write_Command_SSD1306(SSD1306_SETDISPLAYCLOCKDIV)            ' 0xD5
	MOVLW	213
	MOVWF	SSD1306SENDBYTE
	FCALL	WRITE_COMMAND_SSD1306
;Write_Command_SSD1306(0x80)                                  ' the suggested ratio 0x80
	MOVLW	128
	MOVWF	SSD1306SENDBYTE
	FCALL	WRITE_COMMAND_SSD1306
;Write_Command_SSD1306(SSD1306_SETMULTIPLEX)                  ' 0xA8
	MOVLW	168
	MOVWF	SSD1306SENDBYTE
	FCALL	WRITE_COMMAND_SSD1306
;Write_Command_SSD1306(0x3f)                                 '64 pixels
	MOVLW	63
	MOVWF	SSD1306SENDBYTE
	FCALL	WRITE_COMMAND_SSD1306
;Write_Command_SSD1306(SSD1306_SETDISPLAYOFFSET)              ' 0xD3
	MOVLW	211
	MOVWF	SSD1306SENDBYTE
	FCALL	WRITE_COMMAND_SSD1306
;Write_Command_SSD1306(0x00)                                   ' no offset
	CLRF	SSD1306SENDBYTE
	FCALL	WRITE_COMMAND_SSD1306
;Write_Command_SSD1306(SSD1306_SETSTARTLINE | 0x00)            ' line #0
	MOVLW	64
	MOVWF	SSD1306SENDBYTE
	FCALL	WRITE_COMMAND_SSD1306
;Write_Command_SSD1306(SSD1306_CHARGEPUMP)                    ' 0x8D
	MOVLW	141
	MOVWF	SSD1306SENDBYTE
	FCALL	WRITE_COMMAND_SSD1306
;if (SSD1306_vccstate = SSD1306_EXTERNALVCC) then
;Write_Command_SSD1306(0x14)
	MOVLW	20
	MOVWF	SSD1306SENDBYTE
	FCALL	WRITE_COMMAND_SSD1306
;end if
;Write_Command_SSD1306(SSD1306_MEMORYMODE)                    ' 0x20
	MOVLW	32
	MOVWF	SSD1306SENDBYTE
	FCALL	WRITE_COMMAND_SSD1306
;Write_Command_SSD1306(0x00)                                  ' 0x00 act like ks0108 - DO NOT SELECT!!
;Write_Command_SSD1306(0x10)                                  ' 0x01 act like PCD8544
	MOVLW	16
	MOVWF	SSD1306SENDBYTE
	FCALL	WRITE_COMMAND_SSD1306
;Write_Command_SSD1306(SSD1306_SEGREMAP | 0x1)
	MOVLW	161
	MOVWF	SSD1306SENDBYTE
	FCALL	WRITE_COMMAND_SSD1306
;Write_Command_SSD1306(SSD1306_COMSCANDEC)
	MOVLW	200
	MOVWF	SSD1306SENDBYTE
	FCALL	WRITE_COMMAND_SSD1306
;Write_Command_SSD1306(SSD1306_SETCOMPINS)                    ' 0xDA
	MOVLW	218
	MOVWF	SSD1306SENDBYTE
	FCALL	WRITE_COMMAND_SSD1306
;Write_Command_SSD1306(0x12)                                 '64 pixels
	MOVLW	18
	MOVWF	SSD1306SENDBYTE
	FCALL	WRITE_COMMAND_SSD1306
;Write_Command_SSD1306(SSD1306_SETCONTRAST)                   ' 0x81
	MOVLW	129
	MOVWF	SSD1306SENDBYTE
	FCALL	WRITE_COMMAND_SSD1306
;if SSD1306_vccstate = SSD1306_EXTERNALVCC then
;Write_Command_SSD1306(0xCF)
	MOVLW	207
	MOVWF	SSD1306SENDBYTE
	FCALL	WRITE_COMMAND_SSD1306
;end if
;Write_Command_SSD1306(SSD1306_SETPRECHARGE)                  ' 0xd9
	MOVLW	217
	MOVWF	SSD1306SENDBYTE
	FCALL	WRITE_COMMAND_SSD1306
;if SSD1306_vccstate = SSD1306_EXTERNALVCC then
;Write_Command_SSD1306(0xF1)
	MOVLW	241
	MOVWF	SSD1306SENDBYTE
	FCALL	WRITE_COMMAND_SSD1306
;end if
;Write_Command_SSD1306(SSD1306_SETVCOMDETECT)                 ' 0xDB
	MOVLW	219
	MOVWF	SSD1306SENDBYTE
	FCALL	WRITE_COMMAND_SSD1306
;Write_Command_SSD1306(0x40)
	MOVLW	64
	MOVWF	SSD1306SENDBYTE
	FCALL	WRITE_COMMAND_SSD1306
;Write_Command_SSD1306(SSD1306_DISPLAYALLON_RESUME)           ' 0xA4
	MOVLW	164
	MOVWF	SSD1306SENDBYTE
	FCALL	WRITE_COMMAND_SSD1306
;Write_Command_SSD1306(SSD1306_NORMALDISPLAY)                 ' 0xA6
	MOVLW	166
	MOVWF	SSD1306SENDBYTE
	FCALL	WRITE_COMMAND_SSD1306
;Clear screen Here
;GLCDCLS_SSD1306
	CALL	GLCDCLS_SSD1306
;Write_Command_SSD1306(SSD1306_DISPLAYON)                     '--turn on oled panel
	MOVLW	175
	MOVWF	SSD1306SENDBYTE
	LJMP	WRITE_COMMAND_SSD1306

;********************************************************************************

;SOURCE: 215_I2C_GLCD_BMP_SSD1306_128_64.GCB (36)
GLOBAL	INITPPS
INITPPS:
;Module: MSSP1
;RA1PPS = 0x001B    'SCK1 > RA1
	MOVLW	27
	BANKSEL	RA1PPS
	MOVWF	RA1PPS
;SSP1CLKPPS = 0x0001    'RA1 > SCK1 (bi-directional)
	MOVLW	1
	BANKSEL	SSP1CLKPPS
	MOVWF	SSP1CLKPPS
;RA4PPS = 0x001C    'SDA1 > RA4
	MOVLW	28
	BANKSEL	RA4PPS
	MOVWF	RA4PPS
;SSP1DATPPS = 0x0004    'RA4 > SDA1 (bi-directional)
	MOVLW	4
	BANKSEL	SSP1DATPPS
	MOVWF	SSP1DATPPS
	BANKSEL	STATUS
	RETURN

;********************************************************************************

;SOURCE: SYSTEM.H (159)
GLOBAL	INITSYS
INITSYS:
;asm showdebug This code block sets the internal oscillator to ChipMHz
;asm showdebug Default settings for microcontrollers with _OSCCON1_
;Default OSCCON1 typically, NOSC HFINTOSC; NDIV 1 - Common as this simply sets the HFINTOSC
;OSCCON1 = 0x60
	MOVLW	96
	BANKSEL	OSCCON1
	MOVWF	OSCCON1
;Default value typically, CSWHOLD may proceed; SOSCPWR Low power
;OSCCON3 = 0x00
	CLRF	OSCCON3
;Default value typically, MFOEN disabled; LFOEN disabled; ADOEN disabled; SOSCEN disabled; EXTOEN disabled; HFOEN disabled
;OSCEN = 0x00
	CLRF	OSCEN
;Default value
;OSCTUNE = 0x00
	CLRF	OSCTUNE
;asm showdebug The MCU is a chip family ChipFamily
;asm showdebug OSCCON type is 102
;Set OSCFRQ values for MCUs with OSCSTAT... the 16F171xx MCU family
;OSCFRQ = 0b00000101
	MOVLW	5
	MOVWF	OSCFRQ
;asm showdebug _Complete_the_chip_setup_of_BSR,ADCs,ANSEL_and_other_key_setup_registers_or_register_bits
;Ensure all ports are set for digital I/O and, turn off A/D
;SET ADFM OFF
	BANKSEL	ADCON0
	BCF	ADCON0,2
;Switch off A/D Var(ADCON0)
;SET ADCON0.ADON OFF
	BCF	ADCON0,7
;ANSELA = 0
	BANKSEL	ANSELA
	CLRF	ANSELA
;ANSELC = 0
	CLRF	ANSELC
;Set comparator register bits for many MCUs with register CM2CON0
;C2EN = 0
	BANKSEL	CM2CON0
	BCF	CM2CON0,7
;C1EN = 0
	BCF	CM1CON0,7
;
;'Turn off all ports
;PORTA = 0
	BANKSEL	PORTA
	CLRF	PORTA
;PORTC = 0
	CLRF	PORTC
	RETURN

;********************************************************************************

;SOURCE: SYSTEM.H (3413)
GLOBAL	SYSCOMPLESSTHAN16
SYSCOMPLESSTHAN16:
;dim SysWordTempA as word
;dim SysWordTempB as word
;dim SysByteTempX as byte
;clrf SysByteTempX
	CLRF	SYSBYTETEMPX
;Test High, exit if more
;movf SysWordTempA_H,W
	MOVF	SYSWORDTEMPA_H,W
;subwf SysWordTempB_H,W
	SUBWF	SYSWORDTEMPB_H,W
;btfss STATUS,C
	BTFSS	STATUS,0
;return
	RETURN
;Test high, exit true if less
;movf SysWordTempB_H,W
	MOVF	SYSWORDTEMPB_H,W
;subwf SysWordTempA_H,W
	SUBWF	SYSWORDTEMPA_H,W
;btfss STATUS,C
	BTFSS	STATUS,0
;goto SCLT16True
	GOTO	SCLT16TRUE
;Test Low, exit if more or equal
;movf SysWordTempB,W
	MOVF	SYSWORDTEMPB,W
;subwf SysWordTempA,W
	SUBWF	SYSWORDTEMPA,W
;btfsc STATUS,C
	BTFSC	STATUS,0
;return
	RETURN
GLOBAL	SCLT16TRUE
SCLT16TRUE:
;comf SysByteTempX,F
	COMF	SYSBYTETEMPX,F
	RETURN

;********************************************************************************

;START OF PROGRAM MEMORY PAGE 1
	PSECT	PROGMEM1,CLASS=CODE,SPACE=SPACE_CODE,DELTA=2, ABS, OVRLD 
	ORG	2048
GLOBAL	ANOBIUMFULL_H
ANOBIUMFULL_H:
	MOVF	SYSSTRINGA,W
	MOVWF	SYSWORDTEMPA
	MOVF	SYSSTRINGA_H,W
	MOVWF	SYSWORDTEMPA_H
	MOVLW	1
	MOVWF	SYSWORDTEMPB
	CLRF	SYSWORDTEMPB_H
	FCALL	SYSCOMPLESSTHAN16
	BTFSS	SYSBYTETEMPX,0
	RETLW	0
	MOVF	SYSSTRINGA, W
	ADDLW	LOW TABLEANOBIUMFULL_H
	MOVWF	SYSSTRINGA
	MOVLW	(HIGH TABLEANOBIUMFULL_H) & 127
	BTFSC	STATUS,0
	ADDLW	1
	ADDWF	SYSSTRINGA_H, W
	MOVWF	PCLATH
	MOVF	SYSSTRINGA, W
	MOVWF	PCL
GLOBAL	TABLEANOBIUMFULL_H
TABLEANOBIUMFULL_H:
	RETLW	4

;********************************************************************************

;SOURCE: GLCD_SSD1306.H (1040)
GLOBAL	CURSOR_POSITION_SSD1306
CURSOR_POSITION_SSD1306:
;dim  PosCharX, PosCharX as Word
;PosCharY = LocY / 8
;faster than /8
;PosCharY = LocY
	MOVF	LOCY,W
	MOVWF	POSCHARY
;Repeat 3
	MOVLW	3
	MOVWF	SYSREPEATTEMP4
GLOBAL	SYSREPEATLOOP4
SYSREPEATLOOP4:
;Set C Off
	BCF	STATUS,0
;Rotate PosCharY Right
	RRF	POSCHARY,F
;End Repeat
	DECFSZ	SYSREPEATTEMP4,F
	GOTO	SYSREPEATLOOP4
GLOBAL	SYSREPEATLOOPEND4
SYSREPEATLOOPEND4:
;Write_Command_SSD1306( 0xB0 + PosCharY )   ' set page address
	MOVLW	176
	ADDWF	POSCHARY,W
	MOVWF	SSD1306SENDBYTE
	CALL	WRITE_COMMAND_SSD1306
;PosCharX = ( LocX  & 0x0f )  ' lower nibble
	MOVLW	15
	ANDWF	LOCX,W
	MOVWF	POSCHARX
	CLRF	POSCHARX_H
;Write_Command_SSD1306( PosCharX )
	MOVF	POSCHARX,W
	MOVWF	SSD1306SENDBYTE
	CALL	WRITE_COMMAND_SSD1306
;PosCharX = LocX
	MOVF	LOCX,W
	MOVWF	POSCHARX
	CLRF	POSCHARX_H
;Repeat 4
	MOVLW	4
	MOVWF	SYSREPEATTEMP4
GLOBAL	SYSREPEATLOOP5
SYSREPEATLOOP5:
;Set C off
	BCF	STATUS,0
;Rotate PosCharX Right
	RRF	POSCHARX_H,F
	RRF	POSCHARX,F
;End Repeat
	DECFSZ	SYSREPEATTEMP4,F
	GOTO	SYSREPEATLOOP5
GLOBAL	SYSREPEATLOOPEND5
SYSREPEATLOOPEND5:
;PosCharX = ( PosCharX & 0x0F ) + 0x10
	MOVLW	15
	ANDWF	POSCHARX,W
	MOVWF	SYSTEMP1
	CLRF	SYSTEMP1_H
	MOVLW	16
	ADDWF	SYSTEMP1,W
	MOVWF	POSCHARX
	MOVLW	0
	ADDWFC	SYSTEMP1_H,W
	MOVWF	POSCHARX_H
;Write_Command_SSD1306 ( PosCharX )
	MOVF	POSCHARX,W
	MOVWF	SSD1306SENDBYTE
	GOTO	WRITE_COMMAND_SSD1306

;********************************************************************************

GLOBAL	DELAY_MS
DELAY_MS:
	INCF	SYSWAITTEMPMS_H, F
GLOBAL	DMS_START
DMS_START:
	MOVLW	14
	MOVWF	DELAYTEMP2
GLOBAL	DMS_OUTER
DMS_OUTER:
	MOVLW	189
	MOVWF	DELAYTEMP
GLOBAL	DMS_INNER
DMS_INNER:
	DECFSZ	DELAYTEMP, F
	GOTO	DMS_INNER
	DECFSZ	DELAYTEMP2, F
	GOTO	DMS_OUTER
	DECFSZ	SYSWAITTEMPMS, F
	GOTO	DMS_START
	DECFSZ	SYSWAITTEMPMS_H, F
	GOTO	DMS_START
	RETURN

;********************************************************************************

GLOBAL	DELAY_S
DELAY_S:
GLOBAL	DS_START
DS_START:
	MOVLW	232
	MOVWF	SYSWAITTEMPMS
	MOVLW	3
	MOVWF	SYSWAITTEMPMS_H
	CALL	DELAY_MS
	DECFSZ	SYSWAITTEMPS, F
	GOTO	DS_START
	RETURN

;********************************************************************************

GLOBAL	GLCDCHARCOL5
GLCDCHARCOL5:
	MOVLW	113
	SUBWF	SYSSTRINGA, W
	BTFSC	STATUS,0
	RETLW	0
	MOVF	SYSSTRINGA, W
	ADDLW	LOW TABLEGLCDCHARCOL5
	MOVWF	SYSSTRINGA
	MOVLW	(HIGH TABLEGLCDCHARCOL5) & 127
	BTFSC	STATUS,0
	ADDLW	1
	MOVWF	PCLATH
	MOVF	SYSSTRINGA, W
	MOVWF	PCL
GLOBAL	TABLEGLCDCHARCOL5
TABLEGLCDCHARCOL5:
	RETLW	112
	RETLW	124
	RETLW	124
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	RETLW	66

;********************************************************************************

GLOBAL	GLCDCHARCOL6
GLCDCHARCOL6:
	MOVLW	113
	SUBWF	SYSSTRINGA, W
	BTFSC	STATUS,0
	RETLW	0
	MOVF	SYSSTRINGA, W
	ADDLW	LOW TABLEGLCDCHARCOL6
	MOVWF	SYSSTRINGA
	MOVLW	(HIGH TABLEGLCDCHARCOL6) & 127
	BTFSC	STATUS,0
	ADDLW	1
	MOVWF	PCLATH
	MOVF	SYSSTRINGA, W
	MOVWF	PCL
GLOBAL	TABLEGLCDCHARCOL6
TABLEGLCDCHARCOL6:
	RETLW	112
	RETLW	56
	RETLW	254
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	RETLW	68

;********************************************************************************

GLOBAL	GLCDCHARCOL7
GLCDCHARCOL7:
	MOVLW	113
	SUBWF	SYSSTRINGA, W
	BTFSC	STATUS,0
	RETLW	0
	MOVF	SYSSTRINGA, W
	ADDLW	LOW TABLEGLCDCHARCOL7
	MOVWF	SYSSTRINGA
	MOVLW	(HIGH TABLEGLCDCHARCOL7) & 127
	BTFSC	STATUS,0
	ADDLW	1
	MOVWF	PCLATH
	MOVF	SYSSTRINGA, W
	MOVWF	PCL
GLOBAL	TABLEGLCDCHARCOL7
TABLEGLCDCHARCOL7:
	RETLW	112
	RETLW	16
	RETLW	0
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	RETLW	120

;********************************************************************************

;OVERLOADED SIGNATURE: WORD:WORD:STRING:, SOURCE: GLCD.H (981)
GLOBAL	GLCDPRINT4
GLCDPRINT4:
;GLCD.h Sub GLCDPrint
;Dim GLCDPrintLoc  as word
;Dim GLCDPrint_String_Counter, GLCDPrintLen as byte
;GLCDPrintLen = LCDPrintData(0)
	MOVF	SYSLCDPRINTDATAHANDLER,W
	MOVWF	FSR0L
	MOVF	SYSLCDPRINTDATAHANDLER_H,W
	MOVWF	FSR0H
	MOVF	INDF0,W
	MOVWF	GLCDPRINTLEN
;If GLCDPrintLen = 0 Then Exit Sub
	MOVF	GLCDPRINTLEN,F
	BTFSC	STATUS,2
;If GLCDPrintLen = 0 Then Exit Sub
	RETURN
;If GLCDPrintLen = 0 Then Exit Sub
;GLCDPrintLoc = PrintLocX
	MOVF	PRINTLOCX,W
	MOVWF	GLCDPRINTLOC
	MOVF	PRINTLOCX_H,W
	MOVWF	GLCDPRINTLOC_H
;Write Data
;For GLCDPrint_String_Counter = 1 To GLCDPrintLen
	MOVLW	1
	MOVWF	GLCDPRINT_STRING_COUNTER
GLOBAL	SYSFORLOOP6
SYSFORLOOP6:
;GLCDDrawChar  GLCDPrintLoc, PrintLocY, LCDPrintData(GLCDPrint_String_Counter)
	MOVF	GLCDPRINTLOC,W
	MOVWF	CHARLOCX
	MOVF	GLCDPRINTLOC_H,W
	MOVWF	CHARLOCX_H
	MOVF	PRINTLOCY,W
	MOVWF	CHARLOCY
	MOVF	PRINTLOCY_H,W
	MOVWF	CHARLOCY_H
	MOVF	GLCDPRINT_STRING_COUNTER,W
	ADDWF	SYSLCDPRINTDATAHANDLER,W
	MOVWF	FSR0L
	MOVLW	0
	ADDWFC	SYSLCDPRINTDATAHANDLER_H,W
	MOVWF	FSR0H
	MOVF	INDF0,W
	MOVWF	CHARCODE
	MOVF	GLCDFOREGROUND,W
	MOVWF	LINECOLOUR
	MOVF	GLCDFOREGROUND_H,W
	MOVWF	LINECOLOUR_H
	FCALL	GLCDDRAWCHAR_SSD1306
;GLCDPrintIncrementPixelPositionMacro
;Macro Source: glcd.h (1219)
;GLCDPrintLoc = GLCDPrintLoc + ( GLCDFontWidth * GLCDfntDefaultsize )+1
	MOVF	GLCDFONTWIDTH,W
	MOVWF	SYSBYTETEMPA
	MOVF	GLCDFNTDEFAULTSIZE,W
	MOVWF	SYSBYTETEMPB
	CALL	SYSMULTSUB
	MOVF	SYSBYTETEMPX,W
	MOVWF	SYSTEMP3
	ADDWF	GLCDPRINTLOC,W
	MOVWF	SYSTEMP1
	MOVLW	0
	ADDWFC	GLCDPRINTLOC_H,W
	MOVWF	SYSTEMP1_H
	MOVLW	1
	ADDWF	SYSTEMP1,W
	MOVWF	GLCDPRINTLOC
	MOVLW	0
	ADDWFC	SYSTEMP1_H,W
	MOVWF	GLCDPRINTLOC_H
;Next
;POSITIVE VALUE STEP HANDLER IN FOR-NEXT STATEMENT :#4P 
	MOVF	GLCDPRINT_STRING_COUNTER,W
	SUBWF	GLCDPRINTLEN,W
	MOVWF	SYSTEMP3
	MOVWF	SYSBYTETEMPA
	CLRF	SYSBYTETEMPB
	CALL	SYSCOMPEQUAL
	COMF	SYSBYTETEMPX,F
	BTFSS	SYSBYTETEMPX,0
	GOTO	ENDIF29
;SET LOOPVAR TO LOOPVAR + STEPVALUE WHERE STEPVALUE IS A POSITIVE VALUE
	INCF	GLCDPRINT_STRING_COUNTER,F
	GOTO	SYSFORLOOP6
;END IF
GLOBAL	ENDIF29
ENDIF29:
GLOBAL	SYSFORLOOPEND6
SYSFORLOOPEND6:
;Update the current X position for GLCDPrintString
;PrintLocX = GLCDPrintLoc
	MOVF	GLCDPRINTLOC,W
	MOVWF	PRINTLOCX
	MOVF	GLCDPRINTLOC_H,W
	MOVWF	PRINTLOCX_H
	RETURN

;********************************************************************************

;SOURCE: GLCD.H (1240)
GLOBAL	GLCDPRINTSTRINGLN
GLCDPRINTSTRINGLN:
;dim PrintLocX, PrintLocY as word
;GLCDPrint( PrintLocX , PrintLocY , LCDPrintData )
	MOVF	SYSLCDPRINTDATAHANDLER,W
	MOVWF	SYSLCDPRINTDATAHANDLER
	MOVF	SYSLCDPRINTDATAHANDLER_H,W
	MOVWF	SYSLCDPRINTDATAHANDLER_H
	CALL	GLCDPRINT4
;Update the current X and Y position
;PrintLocX = 0
	CLRF	PRINTLOCX
	CLRF	PRINTLOCX_H
;When using Transaction  PrintLocY will get incremented. This needs to be protected
;PrintLocY = ( PrintLocY + ( GLCDfntDefaultHeight * GLCDfntDefaultSize ) ) mod GLCD_HEIGHT
	MOVF	GLCDFNTDEFAULTHEIGHT,W
	MOVWF	SYSBYTETEMPA
	MOVF	GLCDFNTDEFAULTSIZE,W
	MOVWF	SYSBYTETEMPB
	CALL	SYSMULTSUB
	MOVF	SYSBYTETEMPX,W
	MOVWF	SYSTEMP3
	ADDWF	PRINTLOCY,W
	MOVWF	SYSTEMP1
	MOVLW	0
	ADDWFC	PRINTLOCY_H,W
	MOVWF	SYSTEMP1_H
	MOVF	SYSTEMP1,W
	MOVWF	SYSWORDTEMPA
	MOVF	SYSTEMP1_H,W
	MOVWF	SYSWORDTEMPA_H
	MOVLW	64
	MOVWF	SYSWORDTEMPB
	CLRF	SYSWORDTEMPB_H
	CALL	SYSDIVSUB16
	MOVF	SYSWORDTEMPX,W
	MOVWF	PRINTLOCY
	MOVF	SYSWORDTEMPX_H,W
	MOVWF	PRINTLOCY_H
	RETURN

;********************************************************************************

;SOURCE: HWI2C.H (257)
GLOBAL	HI2CMODE
HI2CMODE:
;asm showdebug  This method sets the variable `HI2CCurrentMode`, and, if required, sets the SSPCON1.bits
;#ifdef var(SSPCON1) added to separate from newer i2C module which does not have an SSPCON1
;set SSPSTAT.SMP on
	BANKSEL	SSP1STAT
	BSF	SSP1STAT,7
;set SSPCON1.CKP on
	BSF	SSP1CON1,4
;set SSPCON1.WCOL Off
	BCF	SSP1CON1,7
;Select mode and clock
;If HI2CCurrentMode = Master Then
	MOVLW	12
	BANKSEL	HI2CCURRENTMODE
	SUBWF	HI2CCURRENTMODE,W
	BTFSS	STATUS,2
	GOTO	ENDIF40
;set SSPCON1.SSPM3 on
	BANKSEL	SSP1CON1
	BSF	SSP1CON1,3
;set SSPCON1.SSPM2 off
	BCF	SSP1CON1,2
;set SSPCON1.SSPM1 off
	BCF	SSP1CON1,1
;set SSPCON1.SSPM0 off
	BCF	SSP1CON1,0
;SSPADD = HI2C_BAUD_TEMP and 127
	MOVLW	19
	MOVWF	SSP1ADD
;end if
GLOBAL	ENDIF40
ENDIF40:
;if HI2CCurrentMode = Slave then
	BANKSEL	HI2CCURRENTMODE
	MOVF	HI2CCURRENTMODE,F
	BTFSS	STATUS,2
	GOTO	ENDIF41
;set SSPCON1.SSPM3 off
	BANKSEL	SSP1CON1
	BCF	SSP1CON1,3
;set SSPCON1.SSPM2 on
	BSF	SSP1CON1,2
;set SSPCON1.SSPM1 on
	BSF	SSP1CON1,1
;set SSPCON1.SSPM0 off
	BCF	SSP1CON1,0
;end if
GLOBAL	ENDIF41
ENDIF41:
;if HI2CCurrentMode = Slave10 then
	MOVLW	3
	BANKSEL	HI2CCURRENTMODE
	SUBWF	HI2CCURRENTMODE,W
	BTFSS	STATUS,2
	GOTO	ENDIF42
;set SSPCON1.SSPM3 off
	BANKSEL	SSP1CON1
	BCF	SSP1CON1,3
;set SSPCON1.SSPM2 on
	BSF	SSP1CON1,2
;set SSPCON1.SSPM1 on
	BSF	SSP1CON1,1
;set SSPCON1.SSPM0 on
	BSF	SSP1CON1,0
;end if
GLOBAL	ENDIF42
ENDIF42:
;Enable I2C
;set SSPCON1.SSPEN on
	BANKSEL	SSP1CON1
	BSF	SSP1CON1,5
	BANKSEL	STATUS
	RETURN

;********************************************************************************

;SOURCE: HWI2C.H (428)
GLOBAL	HI2CSEND
HI2CSEND:
;asm showdebug  This method sets the registers and register bits to send I2C data
GLOBAL	RETRYHI2CSEND
RETRYHI2CSEND:
;Clear WCOL
;SET SSPCON1.WCOL OFF
	BANKSEL	SSP1CON1
	BCF	SSP1CON1,7
;Load data to send
;SSPBUF = I2CByte
	BANKSEL	I2CBYTE
	MOVF	I2CBYTE,W
	BANKSEL	SSP1BUF
	MOVWF	SSP1BUF
;HI2CWaitMSSP
	BANKSEL	STATUS
	CALL	HI2CWAITMSSP
;if ACKSTAT =  1 then
	BANKSEL	SSP1CON2
	BTFSS	SSP1CON2,6
	GOTO	ELSE22_1
;HI2CAckPollState = true
	MOVLW	255
	BANKSEL	HI2CACKPOLLSTATE
	MOVWF	HI2CACKPOLLSTATE
;else
	GOTO	ENDIF22
GLOBAL	ELSE22_1
ELSE22_1:
;HI2CAckPollState = false
	BANKSEL	HI2CACKPOLLSTATE
	CLRF	HI2CACKPOLLSTATE
;end if
GLOBAL	ENDIF22
ENDIF22:
;If SSPCON1.WCOL = On Then
	BANKSEL	SSP1CON1
	BTFSS	SSP1CON1,7
	GOTO	ENDIF23
;If HI2CCurrentMode <= 10 Then Goto RetryHI2CSend
	BANKSEL	HI2CCURRENTMODE
	MOVF	HI2CCURRENTMODE,W
	SUBLW	10
	BTFSC	STATUS,0
;If HI2CCurrentMode <= 10 Then Goto RetryHI2CSend
	GOTO	RETRYHI2CSEND
;If HI2CCurrentMode <= 10 Then Goto RetryHI2CSend
;End If
GLOBAL	ENDIF23
ENDIF23:
;Release clock (only needed by slave)
;If HI2CCurrentMode <= 10 Then Set SSPCON1.CKP On
	BANKSEL	HI2CCURRENTMODE
	MOVF	HI2CCURRENTMODE,W
	SUBLW	10
	BTFSS	STATUS,0
	GOTO	ENDIF24
;If HI2CCurrentMode <= 10 Then Set SSPCON1.CKP On
	BANKSEL	SSP1CON1
	BSF	SSP1CON1,4
;If HI2CCurrentMode <= 10 Then Set SSPCON1.CKP On
GLOBAL	ENDIF24
ENDIF24:
	BANKSEL	STATUS
	RETURN

;********************************************************************************

;SOURCE: HWI2C.H (312)
GLOBAL	HI2CSTART
HI2CSTART:
;asm showdebug  This method sets the registers and register bits to generate the I2C  START signal
;If HI2CCurrentMode > 10 Then
	MOVF	HI2CCURRENTMODE,W
	SUBLW	10
	BTFSC	STATUS,0
	GOTO	ELSE20_1
;Master_mode operational
;Set SEN On
	BANKSEL	SSP1CON2
	BSF	SSP1CON2,0
;HI2CWaitMSSP
	BANKSEL	STATUS
	CALL	HI2CWAITMSSP
;Else
	GOTO	ENDIF20
GLOBAL	ELSE20_1
ELSE20_1:
;Slave mode operational
;Wait Until SSPSTAT.S = On
GLOBAL	SYSWAITLOOP1
SYSWAITLOOP1:
	BANKSEL	SSP1STAT
	BTFSS	SSP1STAT,3
	GOTO	SYSWAITLOOP1
;End If
GLOBAL	ENDIF20
ENDIF20:
	BANKSEL	STATUS
	RETURN

;********************************************************************************

;SOURCE: HWI2C.H (362)
GLOBAL	HI2CSTOP
HI2CSTOP:
;Master_mode
;If HI2CCurrentMode > 10 Then
	MOVF	HI2CCURRENTMODE,W
	SUBLW	10
	BTFSC	STATUS,0
	GOTO	ELSE21_1
;set SSPIE OFF; disable SSP interrupt, tested by Anobium but not implemented.
;wait while R_NOT_W = 1   'wait for completion of activities
GLOBAL	SYSWAITLOOP2
SYSWAITLOOP2:
	BANKSEL	SSP1STAT
	BTFSC	SSP1STAT,2
	GOTO	SYSWAITLOOP2
;Set SSPCON2.PEN On
	BSF	SSP1CON2,2
;Set SSPCON2.PEN On
	BSF	SSP1CON2,2
;HI2CWaitMSSP
	BANKSEL	STATUS
	FCALL	HI2CWAITMSSP
;Slave mode
;Else
	GOTO	ENDIF21
GLOBAL	ELSE21_1
ELSE21_1:
;Wait Until SSPSTAT.P = On
GLOBAL	SYSWAITLOOP3
SYSWAITLOOP3:
	BANKSEL	SSP1STAT
	BTFSS	SSP1STAT,4
	GOTO	SYSWAITLOOP3
;End If
GLOBAL	ENDIF21
ENDIF21:
	BANKSEL	STATUS
	RETURN

;********************************************************************************

;SOURCE: HWI2C.H (515)
GLOBAL	HI2CWAITMSSP
HI2CWAITMSSP:
;HI2CWaitMSSPTimeout = 0
	CLRF	HI2CWAITMSSPTIMEOUT
GLOBAL	HI2CWAITMSSPWAIT
HI2CWAITMSSPWAIT:
;HI2CWaitMSSPTimeout++
	BANKSEL	HI2CWAITMSSPTIMEOUT
	INCF	HI2CWAITMSSPTIMEOUT,F
;if HI2CWaitMSSPTimeout < 255 then
	MOVLW	255
	SUBWF	HI2CWAITMSSPTIMEOUT,W
	BTFSC	STATUS,0
	GOTO	ENDIF26
;'Support for SSP1IF
;if SSP1IF = 0 then goto HI2CWaitMSSPWait
	BANKSEL	PIR5
	BTFSS	PIR5,2
;if SSP1IF = 0 then goto HI2CWaitMSSPWait
	GOTO	HI2CWAITMSSPWAIT
;if SSP1IF = 0 then goto HI2CWaitMSSPWait
;SSP1IF = 0
	BCF	PIR5,2
;end if
GLOBAL	ENDIF26
ENDIF26:
	BANKSEL	STATUS
	RETURN

;********************************************************************************

;SOURCE: GLCD_SSD1306.H (883)
GLOBAL	PSET_SSD1306
PSET_SSD1306:
;Set pixel at X, Y on LCD to State
;X is 0 to 127
;Y is 0 to 63
;Origin in top left
;anything off screen with be rejected
;if GLCDX => GLCD_WIDTH OR GLCDY => GLCD_HEIGHT Then
	MOVF	GLCDX,W
	MOVWF	SYSBYTETEMPA
	MOVLW	128
	MOVWF	SYSBYTETEMPB
	CALL	SYSCOMPLESSTHAN
	COMF	SYSBYTETEMPX,F
	MOVF	SYSBYTETEMPX,W
	MOVWF	SYSTEMP3
	MOVF	GLCDY,W
	MOVWF	SYSBYTETEMPA
	MOVLW	64
	MOVWF	SYSBYTETEMPB
	CALL	SYSCOMPLESSTHAN
	COMF	SYSBYTETEMPX,F
	MOVF	SYSTEMP3,W
	IORWF	SYSBYTETEMPX,W
	MOVWF	SYSTEMP1
	BTFSC	SYSTEMP1,0
;exit sub
	RETURN
;end if
;1.14 Addresses correct device horizonal page
;don't need to do these calculations for in LOWMEMORY_GLCD_MODE
;SSD1306_BufferLocationCalc = ( GLCDY / 8 )* GLCD_WIDTH
;faster than /8
;SSD1306_BufferLocationCalc = GLCDY
	MOVF	GLCDY,W
	MOVWF	SSD1306_BUFFERLOCATIONCALC
	CLRF	SSD1306_BUFFERLOCATIONCALC_H
;Repeat 3
	MOVLW	3
	MOVWF	SYSREPEATTEMP1
GLOBAL	SYSREPEATLOOP1
SYSREPEATLOOP1:
;Set C Off
	BCF	STATUS,0
;Rotate SSD1306_BufferLocationCalc Right
	RRF	SSD1306_BUFFERLOCATIONCALC_H,F
	RRF	SSD1306_BUFFERLOCATIONCALC,F
;End Repeat
	DECFSZ	SYSREPEATTEMP1,F
	GOTO	SYSREPEATLOOP1
GLOBAL	SYSREPEATLOOPEND1
SYSREPEATLOOPEND1:
;faster than * 128
;Set C Off
	BCF	STATUS,0
;Repeat 7
	MOVLW	7
	MOVWF	SYSREPEATTEMP1
GLOBAL	SYSREPEATLOOP2
SYSREPEATLOOP2:
;Rotate SSD1306_BufferLocationCalc Left
	RLF	SSD1306_BUFFERLOCATIONCALC,F
	RLF	SSD1306_BUFFERLOCATIONCALC_H,F
;End Repeat
	DECFSZ	SYSREPEATTEMP1,F
	GOTO	SYSREPEATLOOP2
GLOBAL	SYSREPEATLOOPEND2
SYSREPEATLOOPEND2:
;SSD1306_BufferLocationCalc = GLCDX + SSD1306_BufferLocationCalc + 1
	MOVF	SSD1306_BUFFERLOCATIONCALC,W
	ADDWF	GLCDX,W
	MOVWF	SYSTEMP1
	CLRF	SYSTEMP3
	MOVF	SSD1306_BUFFERLOCATIONCALC_H,W
	ADDWFC	SYSTEMP3,W
	MOVWF	SYSTEMP1_H
	MOVLW	1
	ADDWF	SYSTEMP1,W
	MOVWF	SSD1306_BUFFERLOCATIONCALC
	MOVLW	0
	ADDWFC	SYSTEMP1_H,W
	MOVWF	SSD1306_BUFFERLOCATIONCALC_H
;anything beyond buffer boundary?
;why? X = 127 and Y = 64 (Y is over 63!) will have passed first check....
;if SSD1306_BufferLocationCalc > GLCD_HEIGHT * GLCD_WIDTH Then
	MOVF	SSD1306_BUFFERLOCATIONCALC,W
	MOVWF	SYSWORDTEMPB
	MOVF	SSD1306_BUFFERLOCATIONCALC_H,W
	MOVWF	SYSWORDTEMPB_H
	CLRF	SYSWORDTEMPA
	MOVLW	32
	MOVWF	SYSWORDTEMPA_H
	FCALL	SYSCOMPLESSTHAN16
	BTFSC	SYSBYTETEMPX,0
;exit sub
	RETURN
;end if
;GLCDDataTemp = SSD1306_BufferAlias(SSD1306_BufferLocationCalc)
	MOVLW	LOW(SSD1306_BUFFERALIAS)
	ADDWF	SSD1306_BUFFERLOCATIONCALC,W
	MOVWF	FSR0L
	MOVLW	HIGH(SSD1306_BUFFERALIAS)
	ADDWFC	SSD1306_BUFFERLOCATIONCALC_H,W
	MOVWF	FSR0H
	MOVF	INDF0,W
	MOVWF	GLCDDATATEMP
;Change data to set/clear pixel
;GLCDBitNo = GLCDY And 7
	MOVLW	7
	ANDWF	GLCDY,W
	MOVWF	GLCDBITNO
;If GLCDColour.0 = 0 Then
	BTFSC	GLCDCOLOUR,0
	GOTO	ELSE13_1
;GLCDChange = 254
	MOVLW	254
	MOVWF	GLCDCHANGE
;Set C On
	BSF	STATUS,0
;Else
	GOTO	ENDIF13
GLOBAL	ELSE13_1
ELSE13_1:
;GLCDChange = 1
	MOVLW	1
	MOVWF	GLCDCHANGE
;Set C Off
	BCF	STATUS,0
;End If
GLOBAL	ENDIF13
ENDIF13:
;Repeat GLCDBitNo
	MOVF	GLCDBITNO,W
	MOVWF	SYSREPEATTEMP1
	BTFSC	STATUS,2
	GOTO	SYSREPEATLOOPEND3
GLOBAL	SYSREPEATLOOP3
SYSREPEATLOOP3:
;Rotate GLCDChange Left
	RLF	GLCDCHANGE,F
;End Repeat
	DECFSZ	SYSREPEATTEMP1,F
	GOTO	SYSREPEATLOOP3
GLOBAL	SYSREPEATLOOPEND3
SYSREPEATLOOPEND3:
;If GLCDColour.0 = 0 Then
	BTFSC	GLCDCOLOUR,0
	GOTO	ELSE14_1
;GLCDDataTemp = GLCDDataTemp And GLCDChange
	MOVF	GLCDDATATEMP,W
	ANDWF	GLCDCHANGE,W
	MOVWF	GLCDDATATEMP
;Else
	GOTO	ENDIF14
GLOBAL	ELSE14_1
ELSE14_1:
;GLCDDataTemp = GLCDDataTemp Or GLCDChange
	MOVF	GLCDDATATEMP,W
	IORWF	GLCDCHANGE,W
	MOVWF	GLCDDATATEMP
;End If
GLOBAL	ENDIF14
ENDIF14:
;added 1.14 to isolate from full glcd mode
;revised 1.14 to isolate from low memory mode
;if SSD1306_BufferAlias(SSD1306_BufferLocationCalc) <> GLCDDataTemp then
	MOVLW	LOW(SSD1306_BUFFERALIAS)
	ADDWF	SSD1306_BUFFERLOCATIONCALC,W
	MOVWF	FSR0L
	MOVLW	HIGH(SSD1306_BUFFERALIAS)
	ADDWFC	SSD1306_BUFFERLOCATIONCALC_H,W
	MOVWF	FSR0H
	MOVF	GLCDDATATEMP,W
	SUBWF	INDF0,W
	BTFSC	STATUS,2
	GOTO	ENDIF15
;SSD1306_BufferAlias(SSD1306_BufferLocationCalc) = GLCDDataTemp
	MOVLW	LOW(SSD1306_BUFFERALIAS)
	ADDWF	SSD1306_BUFFERLOCATIONCALC,W
	MOVWF	FSR0L
	MOVLW	HIGH(SSD1306_BUFFERALIAS)
	ADDWFC	SSD1306_BUFFERLOCATIONCALC_H,W
	MOVWF	FSR0H
	MOVF	GLCDDATATEMP,W
	MOVWF	INDF0
;Cursor_Position_SSD1306 ( GLCDX, GLCDY )
	MOVF	GLCDX,W
	MOVWF	LOCX
	MOVF	GLCDY,W
	MOVWF	LOCY
	CALL	CURSOR_POSITION_SSD1306
;Write_Data_SSD1306 ( GLCDDataTemp )
	MOVF	GLCDDATATEMP,W
	MOVWF	SSD1306SENDBYTE
	CALL	WRITE_DATA_SSD1306
;end if
GLOBAL	ENDIF15
ENDIF15:
	RETURN

;********************************************************************************

;SOURCE: SYSTEM.H (3078)
GLOBAL	SYSCOMPEQUAL
SYSCOMPEQUAL:
;Dim SysByteTempA, SysByteTempB, SysByteTempX as byte
;clrf SysByteTempX
	CLRF	SYSBYTETEMPX
;movf SysByteTempA, W
	MOVF	SYSBYTETEMPA, W
;subwf SysByteTempB, W
	SUBWF	SYSBYTETEMPB, W
;btfsc STATUS, Z
	BTFSC	STATUS,2
;comf SysByteTempX,F
	COMF	SYSBYTETEMPX,F
	RETURN

;********************************************************************************

;SOURCE: SYSTEM.H (3104)
GLOBAL	SYSCOMPEQUAL16
SYSCOMPEQUAL16:
;dim SysWordTempA as word
;dim SysWordTempB as word
;dim SysByteTempX as byte
;clrf SysByteTempX
	CLRF	SYSBYTETEMPX
;Test low, exit if false
;movf SysWordTempA, W
	MOVF	SYSWORDTEMPA, W
;subwf SysWordTempB, W
	SUBWF	SYSWORDTEMPB, W
;btfss STATUS, Z
	BTFSS	STATUS,2
;return
	RETURN
;Test high, exit if false
;movf SysWordTempA_H, W
	MOVF	SYSWORDTEMPA_H, W
;subwf SysWordTempB_H, W
	SUBWF	SYSWORDTEMPB_H, W
;btfss STATUS, Z
	BTFSS	STATUS,2
;return
	RETURN
;comf SysByteTempX,F
	COMF	SYSBYTETEMPX,F
	RETURN

;********************************************************************************

;SOURCE: SYSTEM.H (3383)
GLOBAL	SYSCOMPLESSTHAN
SYSCOMPLESSTHAN:
;Dim SysByteTempA, SysByteTempB, SysByteTempX as byte
;clrf SysByteTempX
	CLRF	SYSBYTETEMPX
;bsf STATUS, C
	BSF	STATUS,0
;movf SysByteTempB, W
	MOVF	SYSBYTETEMPB, W
;subwf SysByteTempA, W
	SUBWF	SYSBYTETEMPA, W
;btfss STATUS, C
	BTFSS	STATUS,0
;comf SysByteTempX,F
	COMF	SYSBYTETEMPX,F
	RETURN

;********************************************************************************

;SOURCE: SYSTEM.H (2861)
GLOBAL	SYSDIVSUB16
SYSDIVSUB16:
;dim SysWordTempA as word
;dim SysWordTempB as word
;dim SysWordTempX as word
;dim SysDivMultA as word
;dim SysDivMultB as word
;dim SysDivMultX as word
;SysDivMultA = SysWordTempA
	MOVF	SYSWORDTEMPA,W
	MOVWF	SYSDIVMULTA
	MOVF	SYSWORDTEMPA_H,W
	MOVWF	SYSDIVMULTA_H
;SysDivMultB = SysWordTempB
	MOVF	SYSWORDTEMPB,W
	MOVWF	SYSDIVMULTB
	MOVF	SYSWORDTEMPB_H,W
	MOVWF	SYSDIVMULTB_H
;SysDivMultX = 0
	CLRF	SYSDIVMULTX
	CLRF	SYSDIVMULTX_H
;Avoid division by zero
;if SysDivMultB = 0 then
	MOVF	SYSDIVMULTB,W
	MOVWF	SYSWORDTEMPA
	MOVF	SYSDIVMULTB_H,W
	MOVWF	SYSWORDTEMPA_H
	CLRF	SYSWORDTEMPB
	CLRF	SYSWORDTEMPB_H
	CALL	SYSCOMPEQUAL16
	BTFSS	SYSBYTETEMPX,0
	GOTO	ENDIF18
;SysWordTempA = 0
	CLRF	SYSWORDTEMPA
	CLRF	SYSWORDTEMPA_H
;exit sub
	RETURN
;end if
GLOBAL	ENDIF18
ENDIF18:
;Main calc routine
;SysDivLoop = 16
	MOVLW	16
	MOVWF	SYSDIVLOOP
GLOBAL	SYSDIV16START
SYSDIV16START:
;set C off
	BCF	STATUS,0
;Rotate SysDivMultA Left
	RLF	SYSDIVMULTA,F
	RLF	SYSDIVMULTA_H,F
;Rotate SysDivMultX Left
	RLF	SYSDIVMULTX,F
	RLF	SYSDIVMULTX_H,F
;SysDivMultX = SysDivMultX - SysDivMultB
	MOVF	SYSDIVMULTB,W
	SUBWF	SYSDIVMULTX,F
	MOVF	SYSDIVMULTB_H,W
	SUBWFB	SYSDIVMULTX_H,F
;Set SysDivMultA.0 On
	BSF	SYSDIVMULTA,0
;If C Off Then
	BTFSC	STATUS,0
	GOTO	ENDIF19
;Set SysDivMultA.0 Off
	BCF	SYSDIVMULTA,0
;SysDivMultX = SysDivMultX + SysDivMultB
	MOVF	SYSDIVMULTB,W
	ADDWF	SYSDIVMULTX,F
	MOVF	SYSDIVMULTB_H,W
	ADDWFC	SYSDIVMULTX_H,F
;End If
GLOBAL	ENDIF19
ENDIF19:
;decfsz SysDivLoop, F
	DECFSZ	SYSDIVLOOP, F
;goto SysDiv16Start
	GOTO	SYSDIV16START
;SysWordTempA = SysDivMultA
	MOVF	SYSDIVMULTA,W
	MOVWF	SYSWORDTEMPA
	MOVF	SYSDIVMULTA_H,W
	MOVWF	SYSWORDTEMPA_H
;SysWordTempX = SysDivMultX
	MOVF	SYSDIVMULTX,W
	MOVWF	SYSWORDTEMPX
	MOVF	SYSDIVMULTX_H,W
	MOVWF	SYSWORDTEMPX_H
	RETURN

;********************************************************************************

;SOURCE: SYSTEM.H (2518)
GLOBAL	SYSMULTSUB
SYSMULTSUB:
;dim SysByteTempA as byte
;dim SysByteTempB as byte
;dim SysByteTempX as byte
;clrf SysByteTempX
	CLRF	SYSBYTETEMPX
GLOBAL	MUL8LOOP
MUL8LOOP:
;movf SysByteTempA, W
	MOVF	SYSBYTETEMPA, W
;btfsc SysByteTempB, 0
	BTFSC	SYSBYTETEMPB, 0
;addwf SysByteTempX, F
	ADDWF	SYSBYTETEMPX, F
;bcf STATUS, C
	BCF	STATUS,0
;rrf SysByteTempB, F
	RRF	SYSBYTETEMPB, F
;bcf STATUS, C
	BCF	STATUS,0
;rlf SysByteTempA, F
	RLF	SYSBYTETEMPA, F
;movf SysByteTempB, F
	MOVF	SYSBYTETEMPB, F
;btfss STATUS, Z
	BTFSS	STATUS,2
;goto MUL8LOOP
	GOTO	MUL8LOOP
	RETURN

;********************************************************************************

;SOURCE: SYSTEM.H (2565)
GLOBAL	SYSMULTSUB16
SYSMULTSUB16:
;dim SysWordTempA as word
;dim SysWordTempB as word
;dim SysWordTempX as word
;dim SysDivMultA as word
;dim SysDivMultB as word
;dim SysDivMultX as word
;SysDivMultA = SysWordTempA
	MOVF	SYSWORDTEMPA,W
	MOVWF	SYSDIVMULTA
	MOVF	SYSWORDTEMPA_H,W
	MOVWF	SYSDIVMULTA_H
;SysDivMultB = SysWordTempB
	MOVF	SYSWORDTEMPB,W
	MOVWF	SYSDIVMULTB
	MOVF	SYSWORDTEMPB_H,W
	MOVWF	SYSDIVMULTB_H
;SysDivMultX = 0
	CLRF	SYSDIVMULTX
	CLRF	SYSDIVMULTX_H
GLOBAL	MUL16LOOP
MUL16LOOP:
;IF SysDivMultB.0 ON then SysDivMultX += SysDivMultA
	BTFSS	SYSDIVMULTB,0
	GOTO	ENDIF16
;IF SysDivMultB.0 ON then SysDivMultX += SysDivMultA
	MOVF	SYSDIVMULTA,W
	ADDWF	SYSDIVMULTX,F
	MOVF	SYSDIVMULTA_H,W
	ADDWFC	SYSDIVMULTX_H,F
;IF SysDivMultB.0 ON then SysDivMultX += SysDivMultA
GLOBAL	ENDIF16
ENDIF16:
;set STATUS.C OFF
	BCF	STATUS,0
;rotate SysDivMultB right
	RRF	SYSDIVMULTB_H,F
	RRF	SYSDIVMULTB,F
;set STATUS.C off
	BCF	STATUS,0
;rotate SysDivMultA left
	RLF	SYSDIVMULTA,F
	RLF	SYSDIVMULTA_H,F
;if SysDivMultB > 0 then goto MUL16LOOP
	MOVF	SYSDIVMULTB,W
	MOVWF	SYSWORDTEMPB
	MOVF	SYSDIVMULTB_H,W
	MOVWF	SYSWORDTEMPB_H
	CLRF	SYSWORDTEMPA
	CLRF	SYSWORDTEMPA_H
	FCALL	SYSCOMPLESSTHAN16
	BTFSC	SYSBYTETEMPX,0
;if SysDivMultB > 0 then goto MUL16LOOP
	GOTO	MUL16LOOP
;if SysDivMultB > 0 then goto MUL16LOOP
;SysWordTempX = SysDivMultX
	MOVF	SYSDIVMULTX,W
	MOVWF	SYSWORDTEMPX
	MOVF	SYSDIVMULTX_H,W
	MOVWF	SYSWORDTEMPX_H
	RETURN

;********************************************************************************

GLOBAL	SYSSTRINGTABLES
SYSSTRINGTABLES:
	MOVF	SYSSTRINGA_H,W
	MOVWF	PCLATH
	MOVF	SYSSTRINGA,W
	INCF	SYSSTRINGA,F
	BTFSC	STATUS,2
	INCF	SYSSTRINGA_H,F
	MOVWF	PCL

GLOBAL	STRINGTABLE2
STRINGTABLE2:
	RETLW	17
	RETLW	65	;A
	RETLW	98	;B
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	RETLW	80	;P


;********************************************************************************

;SOURCE: GLCD_SSD1306.H (224)
GLOBAL	WRITE_COMMAND_SSD1306
WRITE_COMMAND_SSD1306:
;HI2CStart
	CALL	HI2CSTART
;HI2CSend GLCD_I2C_Address
	MOVLW	120
	MOVWF	I2CBYTE
	CALL	HI2CSEND
;HI2CSend 0x00
	CLRF	I2CBYTE
	CALL	HI2CSEND
;HI2CSend SSD1306SendByte
	MOVF	SSD1306SENDBYTE,W
	MOVWF	I2CBYTE
	CALL	HI2CSEND
;HI2CStop
	LJMP	HI2CSTOP

;********************************************************************************

;SOURCE: GLCD_SSD1306.H (270)
GLOBAL	WRITE_DATA_SSD1306
WRITE_DATA_SSD1306:
;HI2CStart
	CALL	HI2CSTART
;HI2CSend GLCD_I2C_Address
	MOVLW	120
	MOVWF	I2CBYTE
	CALL	HI2CSEND
;HI2CSend 0x40
	MOVLW	64
	MOVWF	I2CBYTE
	CALL	HI2CSEND
;HI2CSend SSD1306SendByte
	MOVF	SSD1306SENDBYTE,W
	MOVWF	I2CBYTE
	CALL	HI2CSEND
;HI2CStop
	LJMP	HI2CSTOP

;********************************************************************************

;START OF PROGRAM MEMORY PAGE 2
	PSECT	PROGMEM2,CLASS=CODE,SPACE=SPACE_CODE,DELTA=2, ABS, OVRLD 
	ORG	4096
;START OF PROGRAM MEMORY PAGE 3
	PSECT	PROGMEM3,CLASS=CODE,SPACE=SPACE_CODE,DELTA=2, ABS, OVRLD 
	ORG	6144
;START OF PROGRAM MEMORY PAGE 4
	PSECT	PROGMEM4,CLASS=CODE,SPACE=SPACE_CODE,DELTA=2, ABS, OVRLD 
	ORG	8192
;START OF PROGRAM MEMORY PAGE 5
	PSECT	PROGMEM5,CLASS=CODE,SPACE=SPACE_CODE,DELTA=2, ABS, OVRLD 
	ORG	10240
;START OF PROGRAM MEMORY PAGE 6
	PSECT	PROGMEM6,CLASS=CODE,SPACE=SPACE_CODE,DELTA=2, ABS, OVRLD 
	ORG	12288
;START OF PROGRAM MEMORY PAGE 7
	PSECT	PROGMEM7,CLASS=CODE,SPACE=SPACE_CODE,DELTA=2, ABS, OVRLD 
	ORG	14336
;
; Declare Power-On-Reset entry point
;
 END     RESETVEC
