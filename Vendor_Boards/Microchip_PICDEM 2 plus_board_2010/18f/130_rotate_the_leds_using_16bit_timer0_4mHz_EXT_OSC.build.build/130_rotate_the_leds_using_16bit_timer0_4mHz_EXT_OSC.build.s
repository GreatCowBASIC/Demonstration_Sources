;'Program compiled by GCBASIC (2026.08.07 (Windows 64 bit) : Build 1617) for Microchip PIC-AS using FreeBASIC 1.07.1/2026-08-07 CRC247
;'  Please donate to help support the operational costs of the project.  Donate via https://gcbasic.com/donate/
;'  
;'  See the GCBASIC forums at http://sourceforge.net/projects/gcbasic/forums,
;'  Check the documentation and Help at http://gcbasic.sourceforge.net/help/,
;'or, email:
;'   evanvennn at users dot sourceforge dot net
;'********************************************************************************
;'   Installation Dir : C:\GCstudio\gcbasic
;'   Source file      : D:\GreatCowBASICGits\Demonstration_Sources.git\Vendor_Boards\Microchip_PICDEM 2 plus_board_2010\18f\130_rotate_the_leds_using_16bit_timer0_4mHz_EXT_OSC.build.gcb
;'   Setting file     : C:\GCstudio\gcbasic\use.ini
;'   Preserve mode    : 2
;'   Assembler        : "C:\GCstudio\picas\v4.00\pic-as\bin\pic-as.exe"
;'   Programmer       : C:\GCstudio\gcbasic\..\PICKitPlus\PICKitCommandline.exe
;'   Output file      : D:\GreatCowBASICGits\Demonstration_Sources.git\Vendor_Boards\Microchip_PICDEM 2 plus_board_2010\18f\130_rotate_the_leds_using_16bit_timer0_4mHz_EXT_OSC.build.build\130_rotate_the_leds_using_16bit_timer0_4mHz_EXT_OSC.build.asm
;'   Float Capability : 1
;'********************************************************************************

;'Set up the assembler options (Chip specs and other options)
;'PROCESSOR  18F46Q35
;'PROG       32768
;'RAM        4096
;'EEPROM     256
;'HWBPCOUNT  3
 PAGEWIDTH   180
 RADIX       DEC
 TITLE       "D:\GreatCowBASICGits\Demonstration_Sources.git\Vendor_Boards\Microchip_PICDEM 2 plus_board_2010\18f\130_rotate_the_leds_using_16bit_timer0_4mHz_EXT_OSC.build.gcb"
 SUBTITLE    "08-14-2026 11:06:04"

;' DPF Reverse lookup file(s)
;' C:\Users\admin\.mchp_packs\8bit PIC\PIC18F-Q_DFP\1.30.487\xc8\pic\include\proc\pic18f46q35.inc
;' C:\Users\admin\.mchp_packs\8bit PIC\PIC18F-Q_DFP\1.30.487\xc8\pic\dat\cfgdata\18f46q35.cfgdata
;' DPF PIC file
;'   C:\Users\admin\.mchp_packs\8bit PIC\PIC18F-Q_DFP\1.30.487\edc\PIC18F46Q35.PIC

;'********************************************************************************
;'Explicit PIC-AS constants to resolve the crazyness of the PIC-AS syntax
;'These are therefore the same as MPASM
#define BANKED b
#define ACCESS a
#define UPPER low highword

;'********************************************************************************
;'Explicit CONFIG
 CONFIG CPD=OFF                                  ;C1 Reverselookup  CPD = OFF
 CONFIG CP=OFF                                   ;C1 Reverselookup  CP = OFF
 CONFIG WRTSAF=OFF                               ;C1 Reverselookup  WRTSAF = OFF
 CONFIG WRTD=OFF                                 ;C1 Reverselookup  WRTD = OFF
 CONFIG WRTB=OFF                                 ;C1 Reverselookup  WRTB = OFF
 CONFIG WDTE=OFF                                 ;C1 Reverselookup  WDTE = OFF
 CONFIG XINST=OFF                                ;C1 Reverselookup  XINST = OFF
 CONFIG LVP=OFF                                  ;C1 Reverselookup  LVP = OFF
 CONFIG MVECEN=OFF                               ;C1 Reverselookup  MVECEN = OFF
 CONFIG MCLRE=INTMCLR                            ;C1 Reverselookup  MCLRE = INTMCLR
 CONFIG FCMEN=ON                                 ;C1 Reverselookup  FCMEN = ON
 CONFIG CLKOUTEN=OFF                             ;C1 Reverselookup  CLKOUTEN = OFF
 CONFIG RSTOSC=EXTOSC                            ;C1 Reverselookup  RSTOSC = EXTOSC
 CONFIG FEXTOSC=OFF                              ;C1 Reverselookup  FEXTOSC = OFF
;'Inferred CONFIG
 CONFIG BBEN=OFF                                 ;C1 Reverselookup BBEN=OFF
 CONFIG BBSIZE=BBSIZE_128                        ;C1 Reverselookup BBSIZE=BBSIZE_128
 CONFIG BOREN=OFF                                ;C1 Reverselookup BOREN=OFF
 CONFIG BORV=VBOR_2P85                           ;C1 Reverselookup BORV=VBOR_2P85
 CONFIG CLBSA=MIN                                ;C1 Reverselookup CLBSA=MIN
 CONFIG CLBSU=ON                                 ;C1 Reverselookup CLBSU=ON
 CONFIG CPUHALT=OFF                              ;C1 Reverselookup CPUHALT=OFF
 CONFIG CSWEN=ON                                 ;C1 Reverselookup CSWEN=ON
 CONFIG DEBUG=OFF                                ;C1 Reverselookup DEBUG=OFF
 CONFIG FCMENP=OFF                               ;C1 Reverselookup FCMENP=OFF
 CONFIG FCMENS=OFF                               ;C1 Reverselookup FCMENS=OFF
 CONFIG ICSPDIS=ON                               ;C1 Reverselookup ICSPDIS=ON
 CONFIG IVT1WAY=OFF                              ;C1 Reverselookup IVT1WAY=OFF
 CONFIG LPBOREN=OFF                              ;C1 Reverselookup LPBOREN=OFF
 CONFIG PPS1WAY=OFF                              ;C1 Reverselookup PPS1WAY=OFF
 CONFIG PR1WAY=OFF                               ;C1 Reverselookup PR1WAY=OFF
 CONFIG PWRTS=PWRT_OFF                           ;C1 Reverselookup PWRTS=PWRT_OFF
 CONFIG STVREN=OFF                               ;C1 Reverselookup STVREN=OFF
 CONFIG WDTCCS=LFINTOSC                          ;C1 Reverselookup WDTCCS=LFINTOSC
 CONFIG WDTCPS=WDTCPS_0                          ;C1 Reverselookup WDTCPS=WDTCPS_0
 CONFIG WDTCWS=WDTCWS_0                          ;C1 Reverselookup WDTCWS=WDTCWS_0
 CONFIG WRTAPP=OFF                               ;C1 Reverselookup WRTAPP=OFF
 CONFIG WRTC=OFF                                 ;C1 Reverselookup WRTC=OFF
 CONFIG ZCD1=ON                                  ;C1 Reverselookup ZCD1=ON


;'********************************************************************************
;' The XC8 xc.inc include file.  This MUST be placed after the CONFIG statements.

 #include <xc.inc>

;'********************************************************************************

;'Set aside RAM memory locations for variables. All variables are global.
GLOBAL	COMPORT
 COMPORT                          EQU 1280          ; 0X500 (SA)
GLOBAL	LEDS
 LEDS                             EQU 1281          ; 0X501 (SA)
GLOBAL	PRINTLEN
 PRINTLEN                         EQU 1282          ; 0X502 (SA)
GLOBAL	ROTATECOUNT
 ROTATECOUNT                      EQU 1283          ; 0X503 (SA)
GLOBAL	SERDATA
 SERDATA                          EQU 1284          ; 0X504 (SA)
GLOBAL	STRINGPOINTER
 STRINGPOINTER                    EQU 1289          ; 0X509 (SA)
GLOBAL	SYSCALCTEMPA
 SYSCALCTEMPA                     EQU 1285          ; 0X505 (SA)
GLOBAL	SYSPRINTDATAHANDLER
 SYSPRINTDATAHANDLER              EQU 1290          ; 0X50A (SA)
GLOBAL	SYSPRINTDATAHANDLER_H
 SYSPRINTDATAHANDLER_H            EQU 1291          ; 0X50B (SA)
GLOBAL	SYSPRINTTEMP
 SYSPRINTTEMP                     EQU 1292          ; 0X50C (SA)
GLOBAL	SYSSTRINGA
 SYSSTRINGA                       EQU 1287          ; 0X507 (SA)
GLOBAL	SYSSTRINGA_H
 SYSSTRINGA_H                     EQU 1288          ; 0X508 (SA)
GLOBAL	SYSSTRINGLENGTH
 SYSSTRINGLENGTH                  EQU 1286          ; 0X506 (SA)
GLOBAL	SYSSTRINGPARAM1
 SYSSTRINGPARAM1                  EQU 5373          ; 0X14FD
GLOBAL	SYSTEMP1
 SYSTEMP1                         EQU 1293          ; 0X50D (SA)
GLOBAL	TMRNUMBER
 TMRNUMBER                        EQU 1294          ; 0X50E (SA)
GLOBAL	TMRPOST
 TMRPOST                          EQU 1295          ; 0X50F (SA)
GLOBAL	TMRPRES
 TMRPRES                          EQU 1296          ; 0X510 (SA)
GLOBAL	TMRSOURCE
 TMRSOURCE                        EQU 1297          ; 0X511 (SA)
GLOBAL	TMRVALUE
 TMRVALUE                         EQU 1298          ; 0X512 (SA)
GLOBAL	TMRVALUE_H
 TMRVALUE_H                       EQU 1299          ; 0X513 (SA)

;'********************************************************************************

;'ALIAS VARIABLES
GLOBAL	AFSR0
 AFSR0                            EQU 1257
GLOBAL	AFSR0_H
 AFSR0_H                          EQU 1258

;'********************************************************************************

 PSECT   RESETVEC,delta=1, abs
 RESETVEC:
;'VECTORS
	ORG	0
	GOTO	BASPROGRAMSTART
	ORG	8
	RETFIE

;'********************************************************************************

;'PROGRAM_MEMORY_PAGE: 0
	ORG	12
GLOBAL	BASPROGRAMSTART
BASPROGRAMSTART:
;'CALL INITIALISATION ROUTINES
	RCALL	INITSYS
	RCALL	INITPPS
	RCALL	INITUSART

;'START_OF_THE_MAIN_PROGRAM
;'
;'THIS DEMONSTRATION FLASHES AN LED TO SHOW THE USE OF A 16BIT TIMER 1
;'
;'THIS LESSON CONFIGURES TIMER0 TO COUNT INSTRUCTION CYCLES AND TO SET A FLAG WHEN IT ROLLS
;'OVER. THIS FREES UP THE PROCESSOR TO DO MEANINGFUL WORK RATHER THAN WASTING INSTRUCTION
;'CYCLES IN A TIMING LOOP USING A 16BIT TIMER.
;'USING A COUNTER PROVIDES A CONVENIENT METHOD OF MEASURING TIME OR DELAY LOOPS AS IT
;'ALLOWS THE PROCESSOR TO WORK ON OTHER TASKS RATHER THAN COUNTING INSTRUCTION CYCLES.
;'
;'LEDS SHOULD FLASH  ~1 SECOND.
;'
;'------------------------------------------------------------------------
;'IMPORTANT - POWER CONFIGURATION
;'------------------------------------------------------------------------
;'!! VDDIO2 IS CRITICAL FOR OPERATION !!
;'ON THIS DEVICE FAMILY, VDDIO2 SUPPLIES POWER TO A SECONDARY I/O BANK.
;'IF VDDIO2 IS NOT CORRECTLY CONNECTED TO THE SUPPLY RAIL (PER THE
;'DATASHEET ELECTRICAL AND PIN-OUT SPECIFICATIONS), THE ASSOCIATED I/O
;'PINS WILL NOT FUNCTION CORRECTLY, AND THE CHIP MAY NOT OPERATE
;'RELIABLY EVEN THOUGH THE PRIMARY VDD/VSS PINS ARE POWERED CORRECTLY.
;'ALWAYS VERIFY VDDIO2 IS WIRED TO VDD (OR THE CORRECT SUPPLY LEVEL) ON
;'YOUR BOARD BEFORE TROUBLESHOOTING "DEAD" I/O OR UNEXPECTED RESETS.
;'------------------------------------------------------------------------
;'
;'
;'CHIP SETTINGS
;'! THE TIMER CALCULATIONS ARE BASED ON 4MHZ EXTERNAL OSCILLATOR
;'! YOU WOULD NEED TO RECALCULATE THE TIMER VALUES IF 4MHZ IS NOT USED
;'SET MICROCONTROLLER REQUIRED
;'
;'------------PORTA---------------
;'BIT#:  -7---6---5---4---3---2---1---0---
;'IO:    ------------SW--------------ADC--
;'IO:    ---------------------------------
;'
;'------------PORTB----------------
;'BIT#:  -7---6---5---4---3---2---1---0---
;'IO:    ----------------LED-LED-LED-LED--
;'IO:    ---------------------------------
;'
;'------------PORTC----------------
;'BIT#:  -7---6---5---4---3---2---1---0---
;'IO:    VDD------------------------------
;'IO:    ---------------------------------
;'
;'------------PORTD----------------
;'BIT#:  -7---6---5---4---3---2---1---0---
;'IO:    PWR-EN--RW--RS--DB7-DB6-DB5-DB4--
;'IO:    ---------------------------------
;'
;'------------PORTE----------------
;'BIT#:  -7---6---5---4---3---2---1---0---
;'IO:    ----------------RST---------------
;'IO:    ---------------------------------
;'
;'PIC PPS TOOL VERSION: 0.0.6.5
;'DEFINE CONSTANTS TO MAKE THINGS EASIER. WE CAN REUSE A CONSTANT AT ANY TIME.
;'DIR     LEDD0 OUT
	BANKSEL	TRISB
	BCF	TRISB,0,BANKED
;'DIR     LEDD1 OUT
	BCF	TRISB,1,BANKED
;'DIR     LEDD2 OUT
	BCF	TRISB,2,BANKED
;'DIR     LEDD3 OUT
	BCF	TRISB,3,BANKED
;'THIS IS THE PORTA.0 PORT
;'DIR POTENTIOMETER IN
	BSF	TRISA,0,BANKED
;'DIR     SWITCHIN      IN
	BSF	TRISA,4,BANKED
;'DIR RSTBUTTON IN // THIS IS SET AUTOMATICALLY - AND, YOU CANNOT SET AS AN OUTPUT
	BSF	TRISE,3,BANKED
;'! SPECIFY EXPLICIT OCULAR_OM1614 SUPPORT!!
;'SETUP LCD PARAMETERS
;'DEFINE LCD HARDWARE SETTINGS
;'! REQUIRED FOR OCULAR LCD DRIVER
;'*****************************************************************************************************
;'MAIN PROGRAM COMMENCES HERE.. EVERYTHING BEFORE THIS IS SETUP FOR THE BOARD.
;'INITIALISE THE TIMER.
;'FIRSTLY TELL THE COMPILER TO USE A 16BIT TIMER FOR THIS PROGRAM
;'FOR THIS WE NEED THE FOLLOWING FOR TIMER0
;'FOSC = 4 MHZ � INSTRUCTION CLOCK = FOSC/4 = 1 MHZ � TCY = 1 µS
;'PRESCALER 1:64 � EACH TIMER0 TICK = 64 × 1 µS = 64 µS
;'16-BIT MODE, PRELOAD = 49911 (0XC2B7)
	;COUNTS	,6,625
;'PERIOD = 15,625 × 64 µS = 1,000,000 µS = 1.000 S
;'INITTIMER0 OSC, PRE0_64 + TMR0_FOSC4 ,  POST0_1
	MOVLW	1
	MOVWF	TMRSOURCE,ACCESS
	MOVLW	70
	MOVWF	TMRPRES,ACCESS
	CLRF	TMRPOST,ACCESS
	BANKSEL	0
	RCALL	INITTIMER0199
;'EVERY 1 SEC.
;'SETTIMER ( 0 , 49911 )
	CLRF	TMRNUMBER,ACCESS
	MOVLW	247
	MOVWF	TMRVALUE,ACCESS
	MOVLW	194
	MOVWF	TMRVALUE_H,ACCESS
	RCALL	SETTIMER197
;'START THE TIMER
;'STARTTIMER 0
	CLRF	TMRNUMBER,ACCESS
	RCALL	STARTTIMER
;'CREATE BYTE VARIABLE AS A FLAG
;'DIM TIMEOUT AS BIT
;'INITIALIZE A VARIABLE TO HOLD THE LED STATES
;'DIM LEDS AS BYTE
;'LEDS = 0B0001  // START WITH THE FIRST LED ON
	MOVLW	1
	MOVWF	LEDS,ACCESS
;'INITIALIZE A COUNTER FOR ROTATIONS
;'DIM ROTATECOUNT AS BYTE
;'ROTATECOUNT = 0
	CLRF	ROTATECOUNT,ACCESS
;'DO
GLOBAL	SYSDOLOOP_S1
SYSDOLOOP_S1:
;'WAIT FOR THE EVENT
;'WAIT WHILE TMR0IF = 0
GLOBAL	SYSWAITLOOP1
SYSWAITLOOP1:
	BTFSS	PIR8,3,ACCESS
	BRA	SYSWAITLOOP1
;'CLEARING TIMER 0 FLAG WILL RESET EVENT
;'TMR0IF = 0
	BCF	PIR8,3,ACCESS
;'HSERPRINTSTRINGCRLF "."
	LFSR	1,SYSSTRINGPARAM1
	MOVLW	LOW STRINGTABLE1
	MOVWF	TBLPTR,ACCESS
	MOVLW	HIGH STRINGTABLE1
	MOVWF	TBLPTRH,ACCESS
	MOVLW	UPPER STRINGTABLE1
	MOVWF	TBLPTRU,ACCESS
	RCALL	SYSREADSTRING
	MOVLW	LOW SYSSTRINGPARAM1
	MOVWF	SYSPRINTDATAHANDLER,ACCESS
	MOVLW	HIGH SYSSTRINGPARAM1
	MOVWF	SYSPRINTDATAHANDLER_H,ACCESS
	MOVLW	1
	MOVWF	COMPORT,ACCESS
;'USING SYSSTRINGPARAM1*1
	RCALL	HSERPRINTSTRINGCRLF
;'OUTPUT THE CURRENT STATE TO PORTB
;'LATB = LEDS
	MOVFF	LEDS,LATB
;'ROTATE THE LEDS TO THE LEFT
;'ROTATE LEDS LEFT SIMPLE
	RLNCF	LEDS,F,ACCESS
;'INCREMENT THE ROTATION COUNTER
;'ROTATECOUNT = ROTATECOUNT + 1
	INCF	ROTATECOUNT,F,ACCESS
;'RESET THE LEDS AFTER 4 ROTATIONS
;'IF ROTATECOUNT >= 4 THEN
	MOVLW	4
	SUBWF	ROTATECOUNT,W,ACCESS
	BTFSS	STATUS,0,ACCESS
	BRA	ENDIF1
;'LEDS = 0B0001  // RESET TO INITIAL STATE
	MOVLW	1
	MOVWF	LEDS,ACCESS
;'ROTATECOUNT = 0  // RESET COUNTER
	CLRF	ROTATECOUNT,ACCESS
;'END IF
GLOBAL	ENDIF1
ENDIF1:
;'SET TIMER. THIS VALUE AS CLOSE AS YOU CAN GET TO 1S
;'SETTIMER ( 0 , 49911 )
	CLRF	TMRNUMBER,ACCESS
	MOVLW	247
	MOVWF	TMRVALUE,ACCESS
	MOVLW	194
	MOVWF	TMRVALUE_H,ACCESS
	RCALL	SETTIMER197
;'LOOP
	BRA	SYSDOLOOP_S1
GLOBAL	SYSDOLOOP_E1
SYSDOLOOP_E1:
GLOBAL	BASPROGRAMEND
BASPROGRAMEND:
	SLEEP
	BRA	BASPROGRAMEND

;'********************************************************************************

;'SOURCE: USART.H (3382)
GLOBAL	HSERPRINTSTRINGCRLF
HSERPRINTSTRINGCRLF:
;'PRINTLEN = PRINTDATA(0)
	MOVFF	SYSPRINTDATAHANDLER,FSR0
	MOVFF	SYSPRINTDATAHANDLER_H,FSR0H
	MOVFF	INDF0,PRINTLEN
;'IF PRINTLEN <> 0 THEN
	MOVF	PRINTLEN,F,ACCESS
	BTFSC	STATUS,2,ACCESS
	BRA	ENDIF13
;'WRITE DATA
;'FOR SYSPRINTTEMP = 1 TO PRINTLEN
;'LEGACY METHOD
	CLRF	SYSPRINTTEMP,ACCESS
	MOVLW	1
	SUBWF	PRINTLEN,W,ACCESS
	BTFSS	STATUS,0,ACCESS
	BRA	SYSFORLOOPEND1
GLOBAL	SYSFORLOOP1
SYSFORLOOP1:
	INCF	SYSPRINTTEMP,F,ACCESS
;'HSERSEND(PRINTDATA(SYSPRINTTEMP),COMPORT )
	MOVF	SYSPRINTTEMP,W,ACCESS
	ADDWF	SYSPRINTDATAHANDLER,W,ACCESS
	MOVWF	FSR0,ACCESS
	MOVLW	0
	ADDWFC	SYSPRINTDATAHANDLER_H,W,ACCESS
	MOVWF	FSR0H,ACCESS
	MOVFF	INDF0,SERDATA
	RCALL	HSERSEND345
;'NEXT
	MOVF	PRINTLEN,W,ACCESS
	SUBWF	SYSPRINTTEMP,W,ACCESS
	BTFSS	STATUS,0,ACCESS
	BRA	SYSFORLOOP1
GLOBAL	SYSFORLOOPEND1
SYSFORLOOPEND1:
;'END IF
GLOBAL	ENDIF13
ENDIF13:
;'HSERSEND(13,COMPORT)
	MOVLW	13
	MOVWF	SERDATA,ACCESS
	RCALL	HSERSEND345
;'HSERSEND(10,COMPORT)
	MOVLW	10
	MOVWF	SERDATA,ACCESS
	BRA	HSERSEND345

;'********************************************************************************

;'OVERLOADED SIGNATURE: BYTE:BYTE:, SOURCE: USART.H (2069)
GLOBAL	HSERSEND345
HSERSEND345:
GLOBAL	HSERSENDUSART1HANDLER
HSERSENDUSART1HANDLER:
;'USART_TX_BLOCKING
;'WAIT WHILE TXIF = OFF
GLOBAL	SYSWAITLOOP2
SYSWAITLOOP2:
	BTFSS	PIR5,1,ACCESS
	BRA	SYSWAITLOOP2
;'TXREG = SERDATA
	MOVFF	SERDATA,U1TXB
	RETURN

;'********************************************************************************

;'SOURCE: 130_ROTATE_THE_LEDS_USING_16BIT_TIMER0_4MHZ_EXT_OSC.BUILD.GCB (88)
GLOBAL	INITPPS
INITPPS:
;'MODULE: UART PIN DIRECTIONS
;'DIR PORTC.6 OUT    ' MAKE TX1 PIN AN OUTPUT
	BANKSEL	TRISC
	BCF	TRISC,6,BANKED
;'MODULE: UART1
;'U1RXPPS = 0X15; //RC5->UART1:RX1;
	MOVLW	21
	BANKSEL	U1RXPPS
	MOVWF	U1RXPPS,BANKED
;'RC6PPS = 0X12;  //RC6->UART1:TX1;
	MOVLW	18
	MOVWF	RC6PPS,BANKED
	BANKSEL	0
	RETURN

;'********************************************************************************

;'SOURCE: SYSTEM.H (201)
GLOBAL	INITSYS
INITSYS:
;'CLEAR BSR ON CHIPFAMILY16 MCUS
;'MOVLB 0
	MOVLB	0
;'DEFAULT SETTINGS FOR MICROCONTROLLERS WITH _OSCCON1_
	;DEFAULT	OSCCON1,NOSC HFINTOSC; NDIV 1 - COMMON AS THIS SIMPLY SETS THE HFINTOSC
;'OSCCON1 = 0X60
	MOVLW	96
	MOVWF	OSCCON1,BANKED
;'DEFAULT VALUE TYPICALLY, CSWHOLD MAY PROCEED; SOSCPWR LOW POWER
;'OSCCON3 = 0X00
	CLRF	OSCCON3,BANKED
;'DEFAULT VALUE TYPICALLY, MFOEN DISABLED; LFOEN DISABLED; ADOEN DISABLED; SOSCEN DISABLED; EXTOEN DISABLED; HFOEN DISABLED
;'OSCEN = 0X00
	CLRF	OSCEN,BANKED
;'DEFAULT VALUE
;'OSCTUNE = 0X00
	CLRF	OSCTUNE,BANKED
;'THE MCU IS A CHIP FAMILY 16
;'SECTION SUPPORTS MANY MCUS, 18FXXK40, 18FXXK42 ETC THAT HAVE NDIV3 BIT
;'OSCCON TYPE IS 101
;'OSCCON1 = 0X60          // SETTING OSCCON1 IMPLIES CLEARING CLEAR NDIV3:0
	MOVLW	96
	MOVWF	OSCCON1,BANKED
;'OSCFRQ = 0B00000010    '4MHZ
	MOVLW	2
	MOVWF	OSCFRQ,BANKED
;'_COMPLETE_THE_CHIP_SETUP_OF_BSR_ADCS_ANSEL_AND_OTHER_KEY_SETUP_REGISTERS_OR_REGISTER_BITS
;'CLEAR TBLPTRU ON MCUS WITH THIS BIT AS THIS MUST BE ZERO
;'TBLPTRU = 0
	CLRF	TBLPTRU,ACCESS
;'ENSURE ALL PORTS ARE SET FOR DIGITAL I/O AND, TURN OFF A/D
;'SET ADFM OFF
	BANKSEL	ADCON0
	BCF	ADCON0,2,BANKED
;'SWITCH OFF A/D VAR(ADCON0)
;'SET ADCON0.ADON OFF
	BCF	ADCON0,7,BANKED
;'ANSELA = 0
	BANKSEL	ANSELA
	CLRF	ANSELA,BANKED
;'ANSELB = 0
	CLRF	ANSELB,BANKED
;'ANSELC = 0
	CLRF	ANSELC,BANKED
;'ANSELE = 0
	CLRF	ANSELE,BANKED
;'SET COMPARATOR REGISTER BITS FOR MANY MCUS WITH REGISTER CM2CON0
;'C2EN = 0
	BANKSEL	CM2CON0
	BCF	CM2CON0,7,BANKED
;'C1EN = 0
	BCF	CM1CON0,7,BANKED
;'TURN OFF ALL PORTS
;'PORTA = 0
	BANKSEL	PORTA
	CLRF	PORTA,BANKED
;'PORTB = 0
	CLRF	PORTB,BANKED
;'PORTC = 0
	CLRF	PORTC,BANKED
;'PORTD = 0
	CLRF	PORTD,BANKED
;'PORTE = 0
	CLRF	PORTE,BANKED
	BANKSEL	0
	RETURN

;'********************************************************************************

;'OVERLOADED SIGNATURE: BYTE:BYTE:BYTE:, SOURCE: TIMER.H (1565)
GLOBAL	INITTIMER0199
INITTIMER0199:
;'EQUATE TO      T0CON1 7:5      3:0        T0CON0 3:0
;'ASSUMED FOR CODE BELOW TIMER0 IS 16-BIT CAPABLE AS WE HAVE BEEN PASSED THREE PARAMETERS
;'SET PRESCALER
;'T0CON1 SETS UP  CLK SOURCE (7:5)  SYNC (4) & PRESCALE 3:0
;'T0CON1 POR VAL = B'00000000'
;'RE-USE TMRPRES AS T0CON1 TEMP REGISTER
;'KEEP T0CON1 7:4 AND WRITE BITS 3:0 TO  REGISTER
;'BITS THEREFORE WILL BE CLEARED!
;'TMRPRES = (T0CON1 AND 240 ) OR TMRPRES
	MOVLW	240
	BANKSEL	T0CON1
	ANDWF	T0CON1,W,BANKED
	MOVWF	SYSTEMP1,ACCESS
	IORWF	TMRPRES,F,ACCESS
;'SET THE SOURCE BIT
;'IF TMRSOURCE <> OSC  THEN
	DECF	TMRSOURCE,W,ACCESS
	BTFSC	STATUS,2,ACCESS
	BRA	ELSE12_1
;'SET TMRPOST.5 ON
	BSF	TMRPOST,5,ACCESS
;'ELSE
	BRA	ENDIF12
GLOBAL	ELSE12_1
ELSE12_1:
;'SET TMRPOST.5 OFF
	BCF	TMRPOST,5,ACCESS
;'END IF
GLOBAL	ENDIF12
ENDIF12:
;'WRITE THE TOCON REGISTER
;'T0CON1 = TMRPRES
	MOVFF	TMRPRES,T0CON1
;'ASSUMED FOR CODE BELOW TIMER0 IS 16-BIT CAPABLE
;'SET POSTSCALER
;'RE-USE TMRPOST AS T0CON0 TEMP REGISTER
;'KEEP T0CON0 7:5  AND WRITE BITS 5:0 TO REGISTER
;'BITS THEREFORE WILL BE CLEARED!
;'TMRPOST = (T0CON0 AND 224) OR TMRPOST
	MOVLW	224
	ANDWF	T0CON0,W,BANKED
	MOVWF	SYSTEMP1,ACCESS
	IORWF	TMRPOST,F,ACCESS
;'SET TO16BIT
;'SET TMRPOST.4 ON '16-BIT TIMER0
	BSF	TMRPOST,4,ACCESS
;'WRITE THE TOCON REGISTER
;'T0CON0 = TMRPOST
	MOVFF	TMRPOST,T0CON0
	BANKSEL	0
	RETURN

;'********************************************************************************

;'SOURCE: USART.H (1282)
GLOBAL	INITUSART
INITUSART:
;'SET THE DEFAULT VALUE FOR USART HANDLER - REQUIRED WHEN MORE THAN ONE USART
;'COMPORT = SCRIPT_DEFAULT_COMPORT
	MOVLW	1
	MOVWF	COMPORT,ACCESS
;'PIC USART 1 INIT
;'U1BRGH=SPBRGH_TEMP
	BANKSEL	U1BRGH
	CLRF	U1BRGH,BANKED
;'U1BRGL=SPBRGL_TEMP
	MOVLW	103
	MOVWF	U1BRG,BANKED
;'U1BRGS = BRGS1_SCRIPT
	BSF	U1CON0,7,BANKED
;'U1TXEN=1   'ENABLE TX1
	BSF	U1CON0,5,BANKED
;'U1RXEN=1   'ENABLE RX1
	BSF	U1CON0,4,BANKED
;'ON_U1CON1=1 'ENABLE USART1
	BSF	U1CON1,7,BANKED
	BANKSEL	0
	RETURN

;'********************************************************************************

;'OVERLOADED SIGNATURE: BYTE:WORD:, SOURCE: TIMER.H (1238)
GLOBAL	SETTIMER197
SETTIMER197:
;'IF TMRNUMBER = 0 THEN
	MOVF	TMRNUMBER,F,ACCESS
	BTFSS	STATUS,2,ACCESS
	BRA	ENDIF7
;'HANDLE CHIPS WITH TMR0H
;'TMR0H = TMRVALUE_H
	MOVFF	TMRVALUE_H,TMR0H
;'TMR0L = TMRVALUE
	MOVFF	TMRVALUE,TMR0L
;'EXIT TO PREVENT DEFAULT SETTING TMR0L = TMRVALUE
;'EXIT SUB
	RETURN
;'END IF
GLOBAL	ENDIF7
ENDIF7:
;'IF TMRNUMBER = 1 THEN
	DECF	TMRNUMBER,W,ACCESS
	BTFSS	STATUS,2,ACCESS
	BRA	ENDIF8
;'TMR1H = TMRVALUE_H
	MOVFF	TMRVALUE_H,TMR1H
;'TMR1L = TMRVALUE
	MOVFF	TMRVALUE,TMR1
;'END IF
GLOBAL	ENDIF8
ENDIF8:
;'IF TMRNUMBER = 2 THEN
	MOVLW	2
	SUBWF	TMRNUMBER,W,ACCESS
	BTFSC	STATUS,2,ACCESS
;'TMR2 = TMRVALUE
	MOVFF	TMRVALUE,T2TMR
;'END IF
;'IF TMRNUMBER = 3 THEN
	MOVLW	3
	SUBWF	TMRNUMBER,W,ACCESS
	BTFSS	STATUS,2,ACCESS
	BRA	ENDIF10
;'TMR3H = TMRVALUE_H
	MOVFF	TMRVALUE_H,TMR3H
;'TMR3L = TMRVALUE
	MOVFF	TMRVALUE,TMR3
;'END IF
GLOBAL	ENDIF10
ENDIF10:
;'IF TMRNUMBER = 4 THEN
	MOVLW	4
	SUBWF	TMRNUMBER,W,ACCESS
	BTFSC	STATUS,2,ACCESS
;'TMR4 = TMRVALUE
	MOVFF	TMRVALUE,T4TMR
;'END IF
	RETURN

;'********************************************************************************

;'SOURCE: TIMER.H (886)
GLOBAL	STARTTIMER
STARTTIMER:
;'IF TMRNUMBER = 0 THEN SET T0EN ON
	MOVF	TMRNUMBER,F,ACCESS
	BTFSS	STATUS,2,ACCESS
	BRA	ENDIF2
;'IF TMRNUMBER = 0 THEN SET T0EN ON
	BANKSEL	T0CON0
	BSF	T0CON0,7,BANKED
;'IF TMRNUMBER = 0 THEN SET T0EN ON
GLOBAL	ENDIF2
ENDIF2:
;'IF TMRNUMBER = 1 THEN SET TMR1ON ON
	DECF	TMRNUMBER,W,ACCESS
	BTFSS	STATUS,2,ACCESS
	BRA	ENDIF3
;'IF TMRNUMBER = 1 THEN SET TMR1ON ON
	BANKSEL	T1CON
	BSF	T1CON,0,BANKED
;'IF TMRNUMBER = 1 THEN SET TMR1ON ON
GLOBAL	ENDIF3
ENDIF3:
;'IF TMRNUMBER = 2 THEN SET TMR2ON ON
	MOVLW	2
	SUBWF	TMRNUMBER,W,ACCESS
	BTFSS	STATUS,2,ACCESS
	BRA	ENDIF4
;'IF TMRNUMBER = 2 THEN SET TMR2ON ON
	BANKSEL	T2CON
	BSF	T2CON,7,BANKED
;'IF TMRNUMBER = 2 THEN SET TMR2ON ON
GLOBAL	ENDIF4
ENDIF4:
;'IF TMRNUMBER = 3 THEN SET TMR3ON ON
	MOVLW	3
	SUBWF	TMRNUMBER,W,ACCESS
	BTFSS	STATUS,2,ACCESS
	BRA	ENDIF5
;'IF TMRNUMBER = 3 THEN SET TMR3ON ON
	BANKSEL	T3CON
	BSF	T3CON,0,BANKED
;'IF TMRNUMBER = 3 THEN SET TMR3ON ON
GLOBAL	ENDIF5
ENDIF5:
;'IF TMRNUMBER = 4 THEN SET TMR4ON ON
	MOVLW	4
	SUBWF	TMRNUMBER,W,ACCESS
	BTFSS	STATUS,2,ACCESS
	BRA	ENDIF6
;'IF TMRNUMBER = 4 THEN SET TMR4ON ON
	BANKSEL	T4CON
	BSF	T4CON,7,BANKED
;'IF TMRNUMBER = 4 THEN SET TMR4ON ON
GLOBAL	ENDIF6
ENDIF6:
	BANKSEL	0
	RETURN

;'********************************************************************************

;'SOURCE: SYSTEM.H (1963)
GLOBAL	SYSREADSTRING
SYSREADSTRING:
;'DIM SYSCALCTEMPA AS BYTE
;'DIM SYSSTRINGLENGTH AS BYTE
;'CHIPFAMILY 16 SUPPORT
;'GET LENGTH
;'TBLRD*+
	TBLRD*+
	;MOVFF	TABLAT,SYSCALCTEMPA
	MOVFF	TABLAT,SYSCALCTEMPA
	;MOVFF	TABLAT,INDF1
	MOVFF	TABLAT,INDF1
;'GOTO SYSSTRINGREADCHECK
	BRA	SYSSTRINGREADCHECK
GLOBAL	SYSREADSTRINGPART
SYSREADSTRINGPART:
;'TBLRD*+
	TBLRD*+
	;MOVF	TABLAT,W
	MOVF	TABLAT, W,ACCESS
;'MOVWF SYSCALCTEMPA
	MOVWF	SYSCALCTEMPA,ACCESS
;'ADDWF SYSSTRINGLENGTH,F
	ADDWF	SYSSTRINGLENGTH,F,ACCESS
;'CHECK LENGTH
GLOBAL	SYSSTRINGREADCHECK
SYSSTRINGREADCHECK:
;'IF LENGTH IS 0, EXIT
;'MOVF SYSCALCTEMPA,F
	MOVF	SYSCALCTEMPA,F,ACCESS
	;BTFSC	STATUS,2
	BTFSC	STATUS,2,ACCESS
;'RETURN
	RETURN
;'COPY
GLOBAL	SYSSTRINGREAD
SYSSTRINGREAD:
;'COPY CHAR
;'TBLRD*+
	TBLRD*+
	;MOVFF	TABLAT,PREINC1
	MOVFF	TABLAT,PREINC1
;'DECFSZ SYSCALCTEMPA, F
	DECFSZ	SYSCALCTEMPA, F,ACCESS
;'GOTO SYSSTRINGREAD
	BRA	SYSSTRINGREAD
	RETURN

;'********************************************************************************

GLOBAL	SYSSTRINGTABLES
SYSSTRINGTABLES:

GLOBAL	STRINGTABLE1
STRINGTABLE1:
	DB	1,46

	ALIGN	2;X3

;'********************************************************************************

;'
;' Declare Power-On-Reset entry point
;'
 END     RESETVEC
